## CMakeLists.txt
```
# SPDX-License-Identifier: MIT

cmake_minimum_required(VERSION 3.20.0)

find_package(Zephyr REQUIRED HINTS $ENV{ZEPHYR_BASE})
project(nucode_m29_ble_long_hil)

zephyr_get(M29_LONG_ROLE)
get_filename_component(NUCODE_ROOT "${CMAKE_CURRENT_LIST_DIR}/../../.." ABSOLUTE)

# @brief W02 protocol에 결합할 exact Core revision을 읽습니다.
execute_process(
  COMMAND git -c "safe.directory=${NUCODE_ROOT}" -C "${NUCODE_ROOT}" rev-parse HEAD
  RESULT_VARIABLE revision_result
  OUTPUT_VARIABLE M29_LONG_CORE_REVISION
  ERROR_VARIABLE revision_error
  OUTPUT_STRIP_TRAILING_WHITESPACE
)
string(LENGTH "${M29_LONG_CORE_REVISION}" revision_length)
if(NOT revision_result EQUAL 0 OR NOT revision_length EQUAL 40 OR
   NOT M29_LONG_CORE_REVISION MATCHES "^[0-9a-f]+$")
  message(FATAL_ERROR "M29 W02 Core revision query failed: ${revision_error}")
endif()

target_sources(app PRIVATE
  src/main.cpp
  "${NUCODE_ROOT}/libraries/NUCODE_BLE/src/NUCODE_BLE_GAP.cpp"
  "${NUCODE_ROOT}/libraries/NUCODE_BLE/src/internal/gap/GapValues.cpp"
  "${NUCODE_ROOT}/libraries/NUCODE_BLE/src/internal/gap/GapAdvertising.cpp"
  "${NUCODE_ROOT}/libraries/NUCODE_BLE/src/internal/gap/GapExtendedAdvertising.cpp"
  "${NUCODE_ROOT}/libraries/NUCODE_BLE/src/internal/gap/GapPeriodicAdvertising.cpp"
  "${NUCODE_ROOT}/libraries/NUCODE_BLE/src/internal/gap/GapPawr.cpp"
  "${NUCODE_ROOT}/libraries/NUCODE_BLE/src/internal/gap/GapScanning.cpp"
  "${NUCODE_ROOT}/libraries/NUCODE_BLE/src/internal/gap/GapConnection.cpp"
  "${NUCODE_ROOT}/libraries/NUCODE_BLE/src/NUCODE_BLE_GATT.cpp"
  "${NUCODE_ROOT}/libraries/NUCODE_BLE/src/internal/gatt/GattDatabase.cpp"
  "${NUCODE_ROOT}/libraries/NUCODE_BLE/src/internal/gatt/GattCache.cpp"
  "${NUCODE_ROOT}/libraries/NUCODE_BLE/src/internal/gatt/GattServer.cpp"
  "${NUCODE_ROOT}/libraries/NUCODE_BLE/src/internal/gatt/GattClient.cpp"
  "${NUCODE_ROOT}/libraries/NUCODE_BLE/src/internal/NUCODE_BLE_Stack.cpp"
)
target_include_directories(app PRIVATE
  "${NUCODE_ROOT}/libraries/NUCODE_BLE/src"
)
target_compile_definitions(app PRIVATE
  M29_LONG_CORE_REVISION="${M29_LONG_CORE_REVISION}"
)

if("${M29_LONG_ROLE}" STREQUAL "central")
  target_compile_definitions(app PRIVATE NUCODE_M29_LONG_CENTRAL=1)
elseif(NOT "${M29_LONG_ROLE}" STREQUAL "peripheral")
  message(FATAL_ERROR "M29_LONG_ROLE must be peripheral or central")
endif()
```

## prj.conf
```kconfig
# SPDX-License-Identifier: MIT

CONFIG_CPP=y
CONFIG_STD_CPP17=y
CONFIG_CPP_EXCEPTIONS=n
CONFIG_CPP_RTTI=n

CONFIG_NUCODE_ARDUINO_CORE=y
CONFIG_NUCODE_ARDUINO_RUNTIME=y
CONFIG_NUCODE_ARDUINO_API=y
CONFIG_NUCODE_ARDUINO_GPIO=n
CONFIG_NUCODE_ARDUINO_INTERRUPTS=n
CONFIG_NUCODE_ARDUINO_TIME=y
CONFIG_NUCODE_ARDUINO_SERIAL=y
CONFIG_NUCODE_ARDUINO_WIRE=n
CONFIG_NUCODE_ARDUINO_SPI=n
CONFIG_NUCODE_ARDUINO_ADC=n
CONFIG_NUCODE_ARDUINO_PWM=n

CONFIG_BT=y
CONFIG_BT_PERIPHERAL=y
CONFIG_BT_CENTRAL=y
CONFIG_BT_MAX_CONN=2
CONFIG_BT_CTLR_SDC_PERIPHERAL_COUNT=1
CONFIG_BT_DEVICE_NAME_DYNAMIC=y
CONFIG_BT_DEVICE_NAME_MAX=32
CONFIG_BT_GATT_CLIENT=y
CONFIG_BT_GATT_DYNAMIC_DB=y
CONFIG_BT_USER_PHY_UPDATE=y
CONFIG_BT_BUF_ACL_RX_SIZE=251
CONFIG_BT_BUF_ACL_TX_SIZE=251
CONFIG_BT_L2CAP_TX_MTU=247
CONFIG_BT_ATT_TX_COUNT=4

CONFIG_NUCODE_BLE_CORE=y
CONFIG_NUCODE_BLE_NUS=n
CONFIG_NUCODE_BLE_CORE_EVENT_QUEUE_SIZE=24
CONFIG_NUCODE_BLE_SCAN_RESULT_QUEUE_SIZE=8
CONFIG_NUCODE_BLE_GATT=y
CONFIG_NUCODE_BLE_GATT_MAX_SERVICES=2
CONFIG_NUCODE_BLE_GATT_MAX_CHARACTERISTICS_PER_SERVICE=8
CONFIG_NUCODE_BLE_GATT_EVENT_QUEUE_SIZE=24

CONFIG_BOOT_BANNER=n
CONFIG_NCS_BOOT_BANNER=n
CONFIG_LOG=n
CONFIG_HEAP_MEM_POOL_SIZE=8192
CONFIG_COMMON_LIBC_MALLOC_ARENA_SIZE=8192
CONFIG_MAIN_STACK_SIZE=8192
CONFIG_SYSTEM_WORKQUEUE_STACK_SIZE=4096
```

## src/main.cpp
```c
/**
 * @file main.cpp
 * @brief 두 NU54DK로 M29-W02의 512-byte long read를 반복 검증합니다.
 *
 * SPDX-License-Identifier: MIT
 */

#include <Arduino.h>
#include <NUCODE_BLE.h>

#include <zephyr/kernel.h>

#include <cstddef>
#include <cstdint>
#include <string.h>

#ifndef M29_LONG_CORE_REVISION
#error "M29_LONG_CORE_REVISION is required"
#endif

static_assert(nucode::ble::BLECharacteristic::maximum_value_length == 512U);
static_assert(CONFIG_BT_MAX_CONN == 2);
static_assert(CONFIG_BT_CTLR_SDC_PERIPHERAL_COUNT == 1);
static_assert(CONFIG_BT_L2CAP_TX_MTU == 247);

namespace
{

    constexpr char protocol[] = "M29W02|1";
    constexpr char start_prefix[] = "M29W02|1|START|nonce=";
    constexpr char core_field[] = "|core=";
    constexpr char peer_name[] = "NU54-M29-LONG";
    constexpr char service_text[] = "8e7e2901-7d8c-4c1a-9d2d-8b6519f77410";
    constexpr char characteristic_text[] = "8e7e2902-7d8c-4c1a-9d2d-8b6519f77410";
    constexpr std::size_t nonce_text_length = 32U;
    constexpr std::size_t nonce_binary_length = 16U;
    constexpr std::size_t payload_length = 512U;
    constexpr std::uint32_t required_reads = 100U;
    constexpr std::int64_t protocol_timeout_ms = 240000;

    enum class Phase : std::uint8_t
    {
        waiting,
        scanning,
        connecting,
        mtu,
        discovering,
        reading,
        complete,
    };

    const nucode::ble::BLEUuid service_uuid(service_text);
    const nucode::ble::BLEUuid characteristic_uuid(characteristic_text);
    nucode::ble::BLEService test_service(service_uuid);
    nucode::ble::BLECharacteristic test_characteristic(
        characteristic_uuid, nucode::ble::BLEProperty::read,
        nucode::ble::BLEPermission::read, payload_length);

    char nonce[nonce_text_length + 1U] = {};
    std::uint8_t nonce_binary[nonce_binary_length] = {};
    std::uint8_t expected_payload[payload_length] = {};
    char command[128] = {};
    std::size_t command_length = 0U;
    bool protocol_started = false;
    bool protocol_finished = false;
    bool callback_context_valid = true;
    bool link_reported = false;
    Phase phase = Phase::waiting;
    struct k_thread *setup_thread = nullptr;
    std::int64_t protocol_deadline = 0;
    nucode::ble::BLEConnectionHandle connection_handle;
    [[maybe_unused]] std::uint32_t completed_reads = 0U;
    [[maybe_unused]] std::uint32_t corrupt_reads = 0U;

    /** @brief 현재 image의 고정 role 이름을 반환합니다. */
    const char *roleName()
    {
#if defined(NUCODE_M29_LONG_CENTRAL)
        return "central";
#else
        return "peripheral";
#endif
    }

    /** @brief 모든 결과 record에 exact nonce와 Core revision을 붙입니다. */
    void printSuffix()
    {
        Serial.print("|nonce=");
        Serial.print(nonce);
        Serial.print("|core=");
        Serial.print(M29_LONG_CORE_REVISION);
    }

    /** @brief 첫 실패를 고정 protocol로 출력하고 추가 동작을 중단합니다. */
    void fail(const char *stage, int code = 0)
    {
        if (protocol_finished)
        {
            return;
        }
        Serial.print(protocol);
        Serial.print("|FAIL|role=");
        Serial.print(roleName());
        Serial.print("|stage=");
        Serial.print(stage == nullptr ? "unknown" : stage);
        Serial.print("|code=");
        Serial.print(code);
        printSuffix();
        Serial.println();
        protocol_finished = true;
    }

    /** @brief callback이 Arduino main thread에서 실행됐는지 누적 확인합니다. */
    void checkCallbackContext()
    {
        if (k_current_get() != setup_thread)
        {
            callback_context_valid = false;
            fail("callback_context");
        }
    }

    /** @brief 소문자 hexadecimal nibble을 binary 값으로 변환합니다. */
    std::uint8_t hexNibble(char value)
    {
        return static_cast<std::uint8_t>(value <= '9' ? value - '0' : value - 'a' + 10);
    }

    /** @brief nonce로 512-byte deterministic payload를 구성합니다. */
    void buildPayload()
    {
        for (std::size_t index = 0U; index < nonce_binary_length; ++index)
        {
            nonce_binary[index] = static_cast<std::uint8_t>(
                (hexNibble(nonce[index * 2U]) << 4U) |
                hexNibble(nonce[index * 2U + 1U]));
        }
        for (std::size_t index = 0U; index < payload_length; ++index)
        {
            expected_payload[index] = index < nonce_binary_length
                                          ? nonce_binary[index]
                                          : static_cast<std::uint8_t>(
                                                nonce_binary[index % nonce_binary_length] ^
                                                static_cast<std::uint8_t>(index) ^
                                                static_cast<std::uint8_t>(index >> 8U));
        }
    }

    /** @brief Host start record의 문법·nonce·exact revision을 엄격히 검증합니다. */
    bool acceptStartCommand()
    {
        const std::size_t prefix_length = ::strlen(start_prefix);
        if (::strncmp(command, start_prefix, prefix_length) != 0)
        {
            return false;
        }
        const char *nonce_text = command + prefix_length;
        for (std::size_t index = 0U; index < nonce_text_length; ++index)
        {
            const char value = nonce_text[index];
            if (!((value >= '0' && value <= '9') || (value >= 'a' && value <= 'f')))
            {
                return false;
            }
        }
        const char *revision_field = nonce_text + nonce_text_length;
        if (::strncmp(revision_field, core_field, ::strlen(core_field)) != 0 ||
            ::strcmp(revision_field + ::strlen(core_field), M29_LONG_CORE_REVISION) != 0)
        {
            return false;
        }
        ::memcpy(nonce, nonce_text, nonce_text_length);
        nonce[nonce_text_length] = '\0';
        buildPayload();
        return true;
    }

    /** @brief READY 뒤 검증 session 시작 record를 출력합니다. */
    void printBegin()
    {
        Serial.print(protocol);
        Serial.print("|BEGIN|role=");
        Serial.print(roleName());
        printSuffix();
        Serial.println();
    }

    /** @brief 실제 negotiated ATT MTU를 고정 LINK record로 출력합니다. */
    void printLink()
    {
        Serial.print(protocol);
        Serial.print("|LINK|role=");
        Serial.print(roleName());
        Serial.print("|mtu=");
        Serial.print(BLEConnection.mtu(connection_handle));
        printSuffix();
        Serial.println();
        link_reported = true;
    }

    /** @brief role별 정량 결과와 END를 고정 순서로 출력합니다. */
    void printResultAndEnd()
    {
        Serial.print(protocol);
        Serial.print("|RESULT|role=");
        Serial.print(roleName());
#if defined(NUCODE_M29_LONG_CENTRAL)
        Serial.print("|reads=");
        Serial.print(completed_reads);
        Serial.print("|bytes=");
        Serial.print(payload_length);
        Serial.print("|corrupt=");
        Serial.print(corrupt_reads);
        Serial.print("|stale=0|callback_context=");
        Serial.print(callback_context_valid ? "pass" : "fail");
#else
        Serial.print("|peer_disconnect=pass|callback_context=");
        Serial.print(callback_context_valid ? "pass" : "fail");
#endif
        printSuffix();
        Serial.println();
        Serial.print(protocol);
        Serial.print("|END|role=");
        Serial.print(roleName());
        Serial.print("|status=pass");
        printSuffix();
        Serial.println();
        protocol_finished = true;
        phase = Phase::complete;
    }

#if defined(NUCODE_M29_LONG_CENTRAL)
    /** @brief exact service UUID가 포함된 connectable report 하나만 연결합니다. */
    void onScanResult(const nucode::ble::BLEScanResult &result, void *context)
    {
        static_cast<void>(context);
        checkCallbackContext();
        if (protocol_finished || phase != Phase::scanning || !result.connectable ||
            result.scan_response)
        {
            return;
        }
        if (!BLEScan.stop())
        {
            fail("scan_stop");
            return;
        }
        Serial.print(protocol);
        Serial.print("|SCAN|role=central|status=pass");
        printSuffix();
        Serial.println();
        phase = Phase::connecting;
        if (!BLEConnection.connect(result.address, connection_handle))
        {
            fail("connect_start");
        }
    }

    /** @brief 512-byte payload를 byte 단위로 검증합니다. */
    bool validPayload(const std::uint8_t *data, std::size_t length)
    {
        return data != nullptr && length == payload_length &&
               ::memcmp(data, expected_payload, payload_length) == 0;
    }

    /** @brief discovery 뒤 100회의 long read를 같은 exact handle에서 직렬 진행합니다. */
    void onClientEvent(const nucode::ble::BLEGattClientEventInfo &information, void *context)
    {
        static_cast<void>(context);
        checkCallbackContext();
        if (protocol_finished)
        {
            return;
        }
        if (information.connection != connection_handle)
        {
            fail("cross_link_event");
            return;
        }
        if (information.event == nucode::ble::BLEGattClientEvent::operation_failed)
        {
            fail("gatt_operation", information.status);
            return;
        }
        if (phase == Phase::discovering)
        {
            if (information.event != nucode::ble::BLEGattClientEvent::discovery_complete ||
                !BLEClient.discovered(connection_handle))
            {
                fail("discovery_result");
                return;
            }
            phase = Phase::reading;
            if (!BLEClient.read(connection_handle))
            {
                fail("read_start");
            }
            return;
        }
        if (phase != Phase::reading ||
            information.event != nucode::ble::BLEGattClientEvent::read_complete)
        {
            fail("unexpected_client_event");
            return;
        }
        if (!validPayload(information.data, information.length))
        {
            ++corrupt_reads;
            fail("read_payload");
            return;
        }
        ++completed_reads;
        if (completed_reads < required_reads)
        {
            if (!BLEClient.read(connection_handle))
            {
                fail("read_repeat");
            }
            return;
        }
        if (!BLEConnection.disconnect(connection_handle))
        {
            fail("disconnect");
            return;
        }
        printResultAndEnd();
    }
#endif

    /** @brief GAP detailed event에서 exact link와 MTU·disconnect 경계를 검증합니다. */
    void onBleEvent(const nucode::ble::BLEEventInfo &information, void *context)
    {
        static_cast<void>(context);
        checkCallbackContext();
        if (!protocol_started || protocol_finished)
        {
            return;
        }
        if (information.event == nucode::ble::BLEEvent::error)
        {
            fail("gap_error", BLEDevice.lastDriverError());
            return;
        }
        if (information.event == nucode::ble::BLEEvent::connected)
        {
            connection_handle = information.connection;
            if (!connection_handle.valid())
            {
                fail("connection_handle");
                return;
            }
#if defined(NUCODE_M29_LONG_CENTRAL)
            if (information.role != nucode::ble::BLELinkRole::central)
#else
            if (information.role != nucode::ble::BLELinkRole::peripheral)
#endif
            {
                fail("connection_role");
                return;
            }
            phase = Phase::mtu;
#if defined(NUCODE_M29_LONG_CENTRAL)
            if (!BLEConnection.requestMtu(connection_handle))
            {
                fail("mtu_request");
            }
#endif
            return;
        }
        if (information.connection != connection_handle)
        {
            return;
        }
        if (information.event == nucode::ble::BLEEvent::mtu_changed && !link_reported)
        {
            if (BLEConnection.mtu(connection_handle) != 247U)
            {
                fail("mtu_value", static_cast<int>(BLEConnection.mtu(connection_handle)));
                return;
            }
            printLink();
#if defined(NUCODE_M29_LONG_CENTRAL)
            phase = Phase::discovering;
            if (!BLEClient.discover(connection_handle, service_uuid, characteristic_uuid))
            {
                fail("discovery_start");
            }
#endif
            return;
        }
        if (information.event == nucode::ble::BLEEvent::disconnected)
        {
#if defined(NUCODE_M29_LONG_CENTRAL)
            fail("early_disconnect");
#else
            if (!link_reported)
            {
                fail("disconnect_without_mtu");
                return;
            }
            printResultAndEnd();
#endif
        }
    }

    /** @brief 검증된 start record에서 role별 advertising 또는 scan을 시작합니다. */
    void startProtocol()
    {
        if (!acceptStartCommand())
        {
            fail("start_record");
            return;
        }
        protocol_started = true;
        protocol_deadline = k_uptime_get() + protocol_timeout_ms;
        printBegin();
#if defined(NUCODE_M29_LONG_CENTRAL)
        phase = Phase::scanning;
        if (!BLEScan.clearFilters() || !BLEScan.filterServiceUuid(service_uuid) ||
            !BLEScan.start(true))
        {
            fail("scan_start");
        }
#else
        if (!test_characteristic.setValue(expected_payload, sizeof(expected_payload)))
        {
            fail("payload_seed");
            return;
        }
        phase = Phase::connecting;
        if (!BLEAdvertising.clear() || !BLEAdvertising.setConnectable(true) ||
            !BLEAdvertising.addServiceUuid(service_uuid) ||
            !BLEAdvertising.setScanResponseName(true) || !BLEAdvertising.start())
        {
            fail("advertising_start");
            return;
        }
        Serial.print(protocol);
        Serial.print("|ADVERTISE|role=peripheral|status=pass");
        printSuffix();
        Serial.println();
#endif
    }

    /** @brief Host의 bounded 한 줄 start command만 수집합니다. */
    void pollHostCommand()
    {
        while (Serial.available() > 0 && !protocol_started && !protocol_finished)
        {
            const int incoming = Serial.read();
            if (incoming < 0)
            {
                return;
            }
            const char value = static_cast<char>(incoming);
            if (value == '\r')
            {
                continue;
            }
            if (value == '\n')
            {
                command[command_length] = '\0';
                startProtocol();
                return;
            }
            if (command_length + 1U >= sizeof(command))
            {
                fail("command_overflow");
                return;
            }
            command[command_length++] = value;
        }
    }

} // namespace

void setup()
{
    setup_thread = k_current_get();
    Serial.begin(115200);
    const std::int64_t deadline = k_uptime_get() + 5000;
    while (!Serial && k_uptime_get() < deadline)
    {
        delay(10);
    }
#if !defined(NUCODE_M29_LONG_CENTRAL)
    if (!test_service.addCharacteristic(test_characteristic) ||
        !BLEDevice.addService(test_service))
    {
        fail("schema");
        return;
    }
#endif
    BLEDevice.onEventInfo(onBleEvent);
#if defined(NUCODE_M29_LONG_CENTRAL)
    BLEScan.onResult(onScanResult);
    BLEClient.onDetailedEvent(onClientEvent);
#endif
    if (!BLEDevice.begin(peer_name))
    {
        fail("device_begin", BLEDevice.lastDriverError());
        return;
    }
    Serial.print(protocol);
    Serial.print("|READY|role=");
    Serial.print(roleName());
    Serial.print("|core=");
    Serial.println(M29_LONG_CORE_REVISION);
}

void loop()
{
    pollHostCommand();
    BLEDevice.poll();
    if (protocol_started && !protocol_finished && k_uptime_get() >= protocol_deadline)
    {
        fail("timeout");
    }
    delay(1);
}
```
