## CMakeLists.txt
```
# SPDX-License-Identifier: MIT

cmake_minimum_required(VERSION 3.20.0)

find_package(Zephyr REQUIRED HINTS $ENV{ZEPHYR_BASE})
project(nucode_m32_mesh_management_contract)

get_filename_component(NUCODE_ROOT "${CMAKE_CURRENT_LIST_DIR}/../../.." ABSOLUTE)
target_sources(app PRIVATE
    src/main.cpp
    "${NUCODE_ROOT}/libraries/NUCODE_BLE_Mesh/src/NUCODE_BLE_Mesh.cpp"
    "${NUCODE_ROOT}/libraries/NUCODE_BLE_Mesh/src/NUCODE_BLE_Mesh_Composition.c"
    "${NUCODE_ROOT}/libraries/NUCODE_BLE_Mesh_Management/src/NUCODE_BLE_Mesh_Management.cpp"
)
target_include_directories(app PRIVATE
    "${NUCODE_ROOT}/libraries/NUCODE_BLE_Mesh/src"
    "${NUCODE_ROOT}/libraries/NUCODE_BLE_Mesh_Management/src"
)
```

## prj.conf
```kconfig
# SPDX-License-Identifier: MIT

CONFIG_CPP=y
CONFIG_STD_CPP17=y
CONFIG_CPP_EXCEPTIONS=n
CONFIG_CPP_RTTI=n

CONFIG_NUCODE_ARDUINO_CORE=y
CONFIG_NUCODE_ARDUINO_RUNTIME=n
CONFIG_NUCODE_ARDUINO_API=y
CONFIG_NUCODE_ARDUINO_GPIO=n
CONFIG_NUCODE_ARDUINO_INTERRUPTS=n
CONFIG_NUCODE_ARDUINO_TIME=n
CONFIG_NUCODE_ARDUINO_SERIAL=n
CONFIG_NUCODE_ARDUINO_WIRE=n
CONFIG_NUCODE_ARDUINO_SPI=n
CONFIG_NUCODE_ARDUINO_ADC=n
CONFIG_NUCODE_ARDUINO_PWM=n

CONFIG_BT=y
CONFIG_BT_CENTRAL=y
CONFIG_BT_PERIPHERAL=y
CONFIG_BT_OBSERVER=y
CONFIG_BT_BROADCASTER=y
CONFIG_BT_MAX_CONN=2
CONFIG_BT_CTLR_SDC_PERIPHERAL_COUNT=1
CONFIG_BT_BUF_ACL_TX_COUNT=8
CONFIG_BT_BUF_ACL_RX_COUNT_EXTRA=7
CONFIG_BT_MESH=y
CONFIG_BT_MESH_PB_ADV=y
CONFIG_BT_MESH_PB_GATT=y
CONFIG_BT_MESH_PB_GATT_CLIENT=y
CONFIG_BT_MESH_PROVISIONER=y
CONFIG_BT_MESH_CDB=y
CONFIG_BT_MESH_CDB_KEY_SYNC=y
CONFIG_BT_MESH_CDB_NODE_COUNT=2
CONFIG_BT_MESH_CDB_APP_KEY_COUNT=2
CONFIG_BT_MESH_CFG_CLI=y
CONFIG_BT_MESH_HEALTH_CLI=y
CONFIG_BT_MESH_RELAY=y
CONFIG_BT_MESH_FRIEND=y
CONFIG_BT_MESH_LOW_POWER=y
CONFIG_BT_MESH_GATT_PROXY=y
CONFIG_BT_MESH_TX_SEG_MAX=16
CONFIG_BT_MESH_RX_SEG_MAX=16
CONFIG_BT_MESH_ADV_BUF_COUNT=16
CONFIG_BT_MESH_RX_SEG_MSG_COUNT=2
CONFIG_BT_MESH_TX_SEG_MSG_COUNT=2
CONFIG_BT_SETTINGS=y
CONFIG_SETTINGS=y
CONFIG_SETTINGS_ZMS=y
CONFIG_SETTINGS_ZMS_LOAD_SUBTREE_PATH=y
CONFIG_FLASH=y
CONFIG_FLASH_MAP=y
CONFIG_ZMS=y
CONFIG_NUCODE_BLE_MESH=y
CONFIG_NUCODE_BLE_MESH_EVENT_QUEUE_SIZE=16
CONFIG_NUCODE_BLE_MESH_MANAGEMENT=y
CONFIG_NUCODE_BLE_MESH_MANAGEMENT_EVENT_QUEUE_SIZE=16
CONFIG_BT_MESH_MODEL_EXTENSIONS=y
CONFIG_BT_MESH_RPR_CLI=y
CONFIG_BT_MESH_RPR_SRV=y
CONFIG_BT_MESH_RPR_AD_TYPES_MAX=4
CONFIG_BT_MESH_RPR_SRV_SCANNED_ITEMS_MAX=4
CONFIG_BT_MESH_RPR_SRV_AD_DATA_MAX=31
CONFIG_BT_MESH_SAR_CFG_CLI=y
CONFIG_BT_MESH_SAR_CFG_SRV=y
CONFIG_BT_MESH_OP_AGG_CLI=y
CONFIG_BT_MESH_OP_AGG_SRV=y
CONFIG_BT_MESH_LARGE_COMP_DATA_CLI=y
CONFIG_BT_MESH_LARGE_COMP_DATA_SRV=y
CONFIG_BT_MESH_MODELS_METADATA_PAGE_LEN=150
CONFIG_BT_MESH_PRIV_BEACONS=y
CONFIG_BT_MESH_PRIV_BEACON_CLI=y
CONFIG_BT_MESH_PRIV_BEACON_SRV=y
CONFIG_BT_MESH_OD_PRIV_PROXY_CLI=y
CONFIG_BT_MESH_OD_PRIV_PROXY_SRV=y
CONFIG_BT_MESH_SOL_PDU_RPL_CLI=y
CONFIG_BT_MESH_PROXY_SRPL_SIZE=10
CONFIG_BT_MESH_BRG_CFG_CLI=y
CONFIG_BT_MESH_BRG_CFG_SRV=y
CONFIG_BT_MESH_BRG_TABLE_ITEMS_MAX=16
CONFIG_HEAP_MEM_POOL_SIZE=4096
CONFIG_SYSTEM_WORKQUEUE_STACK_SIZE=2048
```

## src/main.cpp
```c
/**
 * @file main.cpp
 * @brief M32-W07 Mesh 1.1 관리 API target compile 계약입니다.
 *
 * SPDX-License-Identifier: MIT
 */

#include <NUCODE_BLE_Mesh_Management.h>

using namespace nucode::mesh;

/** @brief 공개 구조와 API signature를 target compiler로 확인합니다. */
int main()
{
    ManagementTarget target{};
    target.address = 0x0002U;
    SarTransmitter transmitter{};
    SarReceiver receiver{};
    LargeDataChunk chunk{};
    BridgeEntry bridge{};
    RemoteDevice remote{};

    std::uint8_t uuid[16]{};
    volatile bool execute_contract = false;
    if (execute_contract)
    {
        static_cast<void>(NUCODEMeshManagement.begin(5000U));
        static_cast<void>(NUCODEMeshManagement.startRemoteScan(target, 1U, 1U, uuid));
        static_cast<void>(NUCODEMeshManagement.stopRemoteScan(target));
        static_cast<void>(NUCODEMeshManagement.closeRemoteLink(target));
        static_cast<void>(NUCODEMeshManagement.provisionRemote(target, uuid));
        static_cast<void>(NUCODEMeshManagement.getSarTransmitter(target, transmitter));
        static_cast<void>(NUCODEMeshManagement.setSarTransmitter(target, transmitter));
        static_cast<void>(NUCODEMeshManagement.getSarReceiver(target, receiver));
        static_cast<void>(NUCODEMeshManagement.setSarReceiver(target, receiver));
        static_cast<void>(NUCODEMeshManagement.beginOpcodeSequence(target, 0U,
                                                                    target.address));
        static_cast<void>(NUCODEMeshManagement.opcodeSequenceTailroom());
        static_cast<void>(NUCODEMeshManagement.sendOpcodeSequence());
        NUCODEMeshManagement.abortOpcodeSequence();
        static_cast<void>(NUCODEMeshManagement.readLargeComposition(target, 0U, 0U,
                                                                     chunk));
        static_cast<void>(NUCODEMeshManagement.readModelsMetadata(target, 0U, 0U,
                                                                   chunk));
        static_cast<void>(NUCODEMeshManagement.setPrivateBeacon(target, true, 1U));
        static_cast<void>(NUCODEMeshManagement.setPrivateGattProxy(target, true));
        static_cast<void>(NUCODEMeshManagement.setPrivateNodeIdentity(target, 0U, true));
        static_cast<void>(NUCODEMeshManagement.setOnDemandPrivateProxy(target, 10U));
        static_cast<void>(NUCODEMeshManagement.solicit(0U));
        static_cast<void>(NUCODEMeshManagement.clearSolicitationReplay(target, 1U, 2U));
        static_cast<void>(NUCODEMeshManagement.setSubnetBridge(target, true));
        static_cast<void>(NUCODEMeshManagement.addBridgeEntry(target, bridge));
        static_cast<void>(NUCODEMeshManagement.removeBridgeEntry(target, bridge));
    }
    (void)remote;
    return 0;
}
```
