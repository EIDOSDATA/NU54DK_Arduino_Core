## CMakeLists.txt
```
# SPDX-License-Identifier: MIT

cmake_minimum_required(VERSION 3.20.0)

find_package(Zephyr REQUIRED HINTS $ENV{ZEPHYR_BASE})
project(nucode_m4_api_contract)

target_sources(app PRIVATE
  src/main.cpp
  src/sketch.cpp
)
```

## prj.conf
```kconfig
CONFIG_CPP=y
CONFIG_STD_CPP17=y
CONFIG_CPP_EXCEPTIONS=n
CONFIG_CPP_RTTI=n
CONFIG_NUCODE_ARDUINO_CORE=y
CONFIG_NUCODE_ARDUINO_API=y
CONFIG_NUCODE_ARDUINO_GPIO=n
CONFIG_NUCODE_ARDUINO_INTERRUPTS=n
CONFIG_NUCODE_ARDUINO_TIME=n
CONFIG_NUCODE_ARDUINO_SERIAL=n

CONFIG_MAIN_STACK_SIZE=2048
CONFIG_HEAP_MEM_POOL_SIZE=0
CONFIG_COMMON_LIBC_MALLOC=y
CONFIG_COMMON_LIBC_MALLOC_ARENA_SIZE=8192
```

## src/main.cpp
```c
/**
 * @file main.cpp
 * @brief ArduinoCore-API 1.5.2의 NU54DK target compile 계약을 검증합니다.
 *
 * SPDX-License-Identifier: MIT
 */

#include <api/ArduinoAPI.h>
#include <api/HardwareSerial.h>

namespace
{

    template <typename Left, typename Right> inline constexpr bool same_type = false;

    template <typename Value> inline constexpr bool same_type<Value, Value> = true;

} // namespace

static_assert(ARDUINO_API_VERSION == 10502, "고정한 ArduinoCore-API 버전이 변경되었습니다.");
static_assert(same_type<pin_size_t, uint8_t>, "M4의 기본 Arduino 논리 핀 ABI는 8-bit여야 합니다.");
static_assert(__is_abstract(arduino::HardwareSerial),
              "HardwareSerial은 M6 backend가 구현할 추상 계약이어야 합니다.");
static_assert(__is_base_of(arduino::Stream, arduino::HardwareSerial),
              "HardwareSerial은 Arduino Stream 계약을 따라야 합니다.");
static_assert(same_type<decltype(arduino::String{}), arduino::String>,
              "Arduino String 공개 생성자 계약을 찾을 수 없습니다.");

using AttachInterruptSignature = void (*)(pin_size_t, voidFuncPtr, PinStatus);

static_assert(same_type<decltype(static_cast<AttachInterruptSignature>(&attachInterrupt)),
                        AttachInterruptSignature>,
              "기본 attachInterrupt 함수 계약이 변경되었습니다.");
```

## src/sketch.cpp
```c
/**
 * @file sketch.cpp
 * @brief 기존 M3 Arduino.h 런타임 계약과 M4 API header 시험을 함께 link합니다.
 *
 * SPDX-License-Identifier: MIT
 */

#include <Arduino.h>

/**
 * @brief Build-only 계약 시험의 Sketch 초기화 자리표시자입니다.
 */
void setup(void)
{
}

/**
 * @brief Build-only 계약 시험의 Sketch 반복 자리표시자입니다.
 */
void loop(void)
{
}
```
