## CMakeLists.txt
```
# SPDX-License-Identifier: MIT

cmake_minimum_required(VERSION 3.20.0)

find_package(Zephyr REQUIRED HINTS $ENV{ZEPHYR_BASE})
project(nucode_m28_ble_link_contract)

get_filename_component(NUCODE_ROOT "${CMAKE_CURRENT_LIST_DIR}/../../.." ABSOLUTE)
target_sources(app PRIVATE
  src/main.cpp
  "${NUCODE_ROOT}/libraries/NUCODE_BLE/src/NUCODE_BLE_GAP.cpp"
  "${NUCODE_ROOT}/libraries/NUCODE_BLE/src/internal/gap/GapValues.cpp"
  "${NUCODE_ROOT}/libraries/NUCODE_BLE/src/internal/gap/GapAdvertising.cpp"
  "${NUCODE_ROOT}/libraries/NUCODE_BLE/src/internal/gap/GapExtendedAdvertising.cpp"
  "${NUCODE_ROOT}/libraries/NUCODE_BLE/src/internal/gap/GapPeriodicAdvertising.cpp"
  "${NUCODE_ROOT}/libraries/NUCODE_BLE/src/internal/gap/GapPawr.cpp"
  "${NUCODE_ROOT}/libraries/NUCODE_BLE/src/internal/gap/GapScanning.cpp"
  "${NUCODE_ROOT}/libraries/NUCODE_BLE/src/internal/gap/GapConnection.cpp"
  "${NUCODE_ROOT}/libraries/NUCODE_BLE/src/internal/NUCODE_BLE_Stack.cpp"
)
target_include_directories(app PRIVATE
  "${NUCODE_ROOT}/libraries/NUCODE_BLE/src"
)
```

## prj.conf
```kconfig
# SPDX-License-Identifier: MIT

CONFIG_CPP=y
CONFIG_STD_CPP17=y
CONFIG_CPP_EXCEPTIONS=n
CONFIG_CPP_RTTI=n

CONFIG_NUCODE_ARDUINO_CORE=y
CONFIG_NUCODE_ARDUINO_RUNTIME=n
CONFIG_NUCODE_ARDUINO_API=y
CONFIG_NUCODE_ARDUINO_GPIO=n
CONFIG_NUCODE_ARDUINO_INTERRUPTS=n
CONFIG_NUCODE_ARDUINO_TIME=n
CONFIG_NUCODE_ARDUINO_SERIAL=n
CONFIG_NUCODE_ARDUINO_WIRE=n
CONFIG_NUCODE_ARDUINO_SPI=n
CONFIG_NUCODE_ARDUINO_ADC=n
CONFIG_NUCODE_ARDUINO_PWM=n

CONFIG_BT=y
CONFIG_BT_PERIPHERAL=y
CONFIG_BT_CENTRAL=y
CONFIG_BT_MAX_CONN=2
CONFIG_BT_CTLR_SDC_PERIPHERAL_COUNT=1
CONFIG_BT_DEVICE_NAME_DYNAMIC=y
CONFIG_BT_DEVICE_NAME_MAX=32
CONFIG_BT_GATT_CLIENT=y
CONFIG_BT_USER_PHY_UPDATE=y
CONFIG_BT_AUTO_PHY_CENTRAL_NONE=y
CONFIG_BT_AUTO_PHY_PERIPHERAL_NONE=y

CONFIG_NUCODE_BLE_CORE=y
CONFIG_NUCODE_BLE_CORE_EVENT_QUEUE_SIZE=24
CONFIG_NUCODE_BLE_SCAN_RESULT_QUEUE_SIZE=8
CONFIG_HEAP_MEM_POOL_SIZE=4096
CONFIG_SYSTEM_WORKQUEUE_STACK_SIZE=2048
CONFIG_COMMON_LIBC_MALLOC_ARENA_SIZE=8192
```

## src/main.cpp
```c
/**
 * @file main.cpp
 * @brief M28 고정 2-slot과 generation handle의 target compile/link 계약입니다.
 *
 * SPDX-License-Identifier: MIT
 */

#include <NUCODE_BLE_GAP.h>

#include <cstdint>

static_assert(CONFIG_BT_MAX_CONN == 2);
static_assert(CONFIG_BT_CTLR_SDC_PERIPHERAL_COUNT == 1);
static_assert(nucode::ble::Device::maximumConnections() == 2U);

/** @brief 기존 callback signature의 source 호환을 고정합니다. */
void onLegacyEvent(nucode::ble::BLEEvent event, void *context)
{
    auto *value = static_cast<volatile std::uint8_t *>(context);
    if (value != nullptr)
    {
        *value = static_cast<std::uint8_t>(event);
    }
}

/** @brief link handle과 역할을 포함하는 상세 callback signature를 고정합니다. */
void onDetailedEvent(const nucode::ble::BLEEventInfo &information, void *context)
{
    auto *value = static_cast<volatile std::uint8_t *>(context);
    if (value != nullptr && information.connection.valid())
    {
        *value = static_cast<std::uint8_t>(information.role);
    }
}

int main()
{
    volatile std::uint8_t observed = 0U;
    nucode::ble::BLEConnectionHandle central;
    const nucode::ble::BLEAddress address("C0:12:34:56:78:9A",
                                          nucode::ble::BLEAddress::Type::random_address);

    BLEDevice.onEvent(onLegacyEvent, const_cast<std::uint8_t *>(&observed));
    BLEDevice.onEventInfo(onDetailedEvent, const_cast<std::uint8_t *>(&observed));
    static_cast<void>(BLEConnection.connect(address, central));
    static_cast<void>(BLEConnection.connecting(central));
    static_cast<void>(BLEConnection.connected(central));
    static_cast<void>(BLEConnection.count());
    static_cast<void>(BLEConnection.handle(nucode::ble::BLELinkRole::central));
    static_cast<void>(BLEConnection.role(central));
    static_cast<void>(BLEConnection.peerAddress(central));
    static_cast<void>(BLEConnection.mtu(central));
    static_cast<void>(BLEConnection.requestMtu(central));
    static_cast<void>(BLEConnection.phy(central));
    static_cast<void>(BLEConnection.requestPhy(central, true, true));
    std::int8_t power = 0;
    static_cast<void>(BLEConnection.txPower(central, power));
    static_cast<void>(BLEConnection.requestParameters(central, 24U, 40U, 0U, 400U));
    static_cast<void>(BLEConnection.disconnect(central));
    static_cast<void>(BLEConnection.reconnect(central));
    return 0;
}
```
