## CMakeLists.txt
```
# SPDX-License-Identifier: MIT

cmake_minimum_required(VERSION 3.20.0)

get_filename_component(NUCODE_ROOT "${CMAKE_CURRENT_LIST_DIR}/../../.." ABSOLUTE)

find_package(Zephyr REQUIRED HINTS $ENV{ZEPHYR_BASE})
project(nucode_m30_mcuboot_hil)

# @brief HIL protocol을 exact source revision에 결합합니다.
execute_process(
  COMMAND git -c "safe.directory=${NUCODE_ROOT}" -C "${NUCODE_ROOT}" rev-parse HEAD
  RESULT_VARIABLE revision_result
  OUTPUT_VARIABLE M30_BOOT_CORE_REVISION
  ERROR_VARIABLE revision_error
  OUTPUT_STRIP_TRAILING_WHITESPACE
)
string(LENGTH "${M30_BOOT_CORE_REVISION}" revision_length)
if(NOT revision_result EQUAL 0 OR NOT revision_length EQUAL 40 OR
   NOT M30_BOOT_CORE_REVISION MATCHES "^[0-9a-f]+$")
  message(FATAL_ERROR "M30 boot Core revision query failed: ${revision_error}")
endif()

target_sources(app PRIVATE src/main.cpp)
target_compile_definitions(app PRIVATE
  M30_BOOT_CORE_REVISION="${M30_BOOT_CORE_REVISION}"
)
```

## prj.conf
```kconfig
# SPDX-License-Identifier: MIT

CONFIG_CPP=y
CONFIG_STD_CPP17=y
CONFIG_CPP_EXCEPTIONS=n
CONFIG_CPP_RTTI=n

CONFIG_NUCODE_ARDUINO_CORE=y
CONFIG_NUCODE_ARDUINO_RUNTIME=y
CONFIG_NUCODE_ARDUINO_API=y
CONFIG_NUCODE_ARDUINO_GPIO=n
CONFIG_NUCODE_ARDUINO_INTERRUPTS=n
CONFIG_NUCODE_ARDUINO_TIME=y
CONFIG_NUCODE_ARDUINO_SERIAL=y
CONFIG_NUCODE_ARDUINO_WIRE=n
CONFIG_NUCODE_ARDUINO_SPI=n
CONFIG_NUCODE_ARDUINO_ADC=n
CONFIG_NUCODE_ARDUINO_PWM=n

CONFIG_BOOTLOADER_MCUBOOT=y
CONFIG_STREAM_FLASH=y
CONFIG_IMG_MANAGER=y
CONFIG_MCUBOOT_IMG_MANAGER=y
CONFIG_MCUBOOT_EXTRA_IMGTOOL_ARGS="--security-counter 1"

CONFIG_FLASH=y
CONFIG_FLASH_MAP=y
CONFIG_SERIAL=y
CONFIG_CONSOLE=y
CONFIG_UART_CONSOLE=y
CONFIG_PRINTK=y
CONFIG_REBOOT=y

CONFIG_BOOT_BANNER=n
CONFIG_NCS_BOOT_BANNER=n
CONFIG_LOG=n
CONFIG_MAIN_STACK_SIZE=4096
```

## src/main.c
```c
/**
 * @file main.c
 * @brief M30 MCUboot 서명·boot·negative image HIL 명령을 제공합니다.
 *
 * SPDX-License-Identifier: MIT
 */

#include <zephyr/device.h>
#include <zephyr/dfu/mcuboot.h>
#include <zephyr/devicetree.h>
#include <zephyr/drivers/uart.h>
#include <zephyr/kernel.h>
#include <zephyr/storage/flash_map.h>
#include <zephyr/sys/printk.h>
#include <zephyr/sys/reboot.h>

#include <stdbool.h>
#include <stddef.h>
#include <string.h>

/** @brief protocol 입력 한 줄의 최대 크기입니다. */
#define M30_BOOT_COMMAND_CAPACITY 192U

static const struct device *const console = DEVICE_DT_GET(DT_CHOSEN(zephyr_console));

/** @brief exact revision을 포함한 protocol suffix를 출력합니다. */
static void print_suffix(void)
{
	printk("|core=%s\n", M30_BOOT_CORE_REVISION);
}

/** @brief 현재 MCUboot 상태를 직렬 protocol로 출력합니다. */
static void print_ready(int confirm_result)
{
	struct mcuboot_img_header header = {0};
	const int header_result = boot_read_bank_header(
		PARTITION_ID(slot0_partition), &header, sizeof(header));

	if (header_result != 0 || header.mcuboot_version != 1U)
	{
		printk("M30BOOT|1|FAIL|reason=active-header|rc=%d", header_result);
		print_suffix();
		return;
	}
	printk("M30BOOT|1|READY|active_slot=%u|confirmed=%u|confirm_rc=%d"
	       "|version=%u.%u.%u+%u",
	       boot_fetch_active_slot(), boot_is_img_confirmed() ? 1U : 0U,
	       confirm_result, header.h.v1.sem_ver.major, header.h.v1.sem_ver.minor,
	       header.h.v1.sem_ver.revision, header.h.v1.sem_ver.build_num);
	print_suffix();
}

/** @brief 검증 runner가 요청한 warm reboot를 수행합니다. */
static void reboot_target(void)
{
	printk("M30BOOT|1|REBOOTING");
	print_suffix();
	k_msleep(50);
	sys_reboot(SYS_REBOOT_WARM);
}

/** @brief 한 줄 command를 fail-closed 방식으로 처리합니다. */
static void process_command(const char *command)
{
	if (strcmp(command, "M30BOOT|1|PING") == 0)
	{
		print_ready(0);
	}
	else if (strcmp(command, "M30BOOT|1|REBOOT") == 0)
	{
		reboot_target();
	}
	else if (strcmp(command, "M30BOOT|1|REQUEST_TEST") == 0)
	{
		const int result = boot_request_upgrade(BOOT_UPGRADE_TEST);

		printk("M30BOOT|1|REQUEST_TEST|rc=%d", result);
		print_suffix();
	}
	else
	{
		printk("M30BOOT|1|FAIL|reason=unknown-command");
		print_suffix();
	}
}

/** @brief UART에서 CR/LF로 끝나는 한 줄을 수신합니다. */
static void poll_commands(void)
{
	char command[M30_BOOT_COMMAND_CAPACITY] = {0};
	size_t length = 0U;

	while (true)
	{
		unsigned char value = 0U;

		if (uart_poll_in(console, &value) != 0)
		{
			k_msleep(2);
			continue;
		}
		if (value == '\r' || value == '\n')
		{
			if (length != 0U)
			{
				command[length] = '\0';
				process_command(command);
				length = 0U;
			}
			continue;
		}
		if (length + 1U >= sizeof(command))
		{
			length = 0U;
			printk("M30BOOT|1|FAIL|reason=command-too-long");
			print_suffix();
			continue;
		}
		command[length] = (char)value;
		length++;
	}
}

/** @brief 실행 image를 confirm하고 boot 검증 protocol을 시작합니다. */
int main(void)
{
	int confirm_result;

	if (!device_is_ready(console))
	{
		return 1;
	}
	confirm_result = boot_write_img_confirmed();
	print_ready(confirm_result);
	poll_commands();
	return 0;
}
```

## src/main.cpp
```c
/**
 * @file main.cpp
 * @brief M30 MCUboot 서명·boot·negative image HIL 명령을 제공합니다.
 *
 * SPDX-License-Identifier: MIT
 */

#include <Arduino.h>

#include <zephyr/dfu/mcuboot.h>
#include <zephyr/kernel.h>
#include <zephyr/storage/flash_map.h>
#include <zephyr/sys/reboot.h>

#include <stddef.h>
#include <string.h>

namespace
{
    /** @brief protocol 입력 한 줄의 최대 크기입니다. */
    constexpr size_t command_capacity = 192U;
    char command[command_capacity] = {};
    size_t command_length = 0U;

    /** @brief exact revision을 포함한 protocol suffix를 출력합니다. */
    void printSuffix()
    {
        Serial.print("|core=");
        Serial.println(M30_BOOT_CORE_REVISION);
    }

    /** @brief 현재 MCUboot 상태를 직렬 protocol로 출력합니다. */
    void printReady(int confirm_result)
    {
        struct mcuboot_img_header header = {};
        const int header_result = boot_read_bank_header(
            PARTITION_ID(slot0_partition), &header, sizeof(header));

        if ((header_result != 0) || (header.mcuboot_version != 1U))
        {
            Serial.print("M30BOOT|1|FAIL|reason=active-header|rc=");
            Serial.print(header_result);
            printSuffix();
            return;
        }
        Serial.print("M30BOOT|1|READY|active_slot=");
        Serial.print(static_cast<unsigned int>(boot_fetch_active_slot()));
        Serial.print("|confirmed=");
        Serial.print(boot_is_img_confirmed() ? 1U : 0U);
        Serial.print("|confirm_rc=");
        Serial.print(confirm_result);
        Serial.print("|version=");
        Serial.print(static_cast<unsigned int>(header.h.v1.sem_ver.major));
        Serial.print('.');
        Serial.print(static_cast<unsigned int>(header.h.v1.sem_ver.minor));
        Serial.print('.');
        Serial.print(static_cast<unsigned int>(header.h.v1.sem_ver.revision));
        Serial.print('+');
        Serial.print(static_cast<unsigned long>(header.h.v1.sem_ver.build_num));
        printSuffix();
    }

    /** @brief 검증 runner가 요청한 warm reboot를 수행합니다. */
    void rebootTarget()
    {
        Serial.print("M30BOOT|1|REBOOTING");
        printSuffix();
        Serial.flush();
        k_msleep(50);
        sys_reboot(SYS_REBOOT_WARM);
    }

    /** @brief 한 줄 command를 fail-closed 방식으로 처리합니다. */
    void processCommand(const char *line)
    {
        if (::strcmp(line, "M30BOOT|1|PING") == 0)
        {
            printReady(0);
        }
        else if (::strcmp(line, "M30BOOT|1|REBOOT") == 0)
        {
            rebootTarget();
        }
        else if (::strcmp(line, "M30BOOT|1|REQUEST_TEST") == 0)
        {
            const int result = boot_request_upgrade(BOOT_UPGRADE_TEST);

            Serial.print("M30BOOT|1|REQUEST_TEST|rc=");
            Serial.print(result);
            printSuffix();
        }
        else
        {
            Serial.print("M30BOOT|1|FAIL|reason=unknown-command");
            printSuffix();
        }
    }

    /** @brief VCOM에서 CR/LF로 끝나는 한 줄을 수신합니다. */
    void pollCommands()
    {
        while (Serial.available() > 0)
        {
            const int incoming = Serial.read();
            if (incoming < 0)
            {
                return;
            }
            const char value = static_cast<char>(incoming);
            if (value == '\r')
            {
                continue;
            }
            if (value == '\n')
            {
                if (command_length != 0U)
                {
                    command[command_length] = '\0';
                    processCommand(command);
                    command_length = 0U;
                }
                continue;
            }
            if (command_length + 1U >= sizeof(command))
            {
                command_length = 0U;
                Serial.print("M30BOOT|1|FAIL|reason=command-too-long");
                printSuffix();
                continue;
            }
            command[command_length] = value;
            command_length++;
        }
    }
} // namespace

/** @brief 실행 image를 confirm하고 boot 검증 protocol을 시작합니다. */
void setup()
{
    Serial.begin(115200);
    const int confirm_result = boot_write_img_confirmed();

    printReady(confirm_result);
}

/** @brief bounded UART command polling을 계속 수행합니다. */
void loop()
{
    pollCommands();
    k_msleep(2);
}
```
