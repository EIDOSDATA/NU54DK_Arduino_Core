## CMakeLists.txt
```
# SPDX-License-Identifier: MIT

cmake_minimum_required(VERSION 3.20.0)

find_package(Zephyr REQUIRED HINTS $ENV{ZEPHYR_BASE})
project(nucode_m20_ble_gatt_contract)

get_filename_component(NUCODE_ROOT "${CMAKE_CURRENT_LIST_DIR}/../../.." ABSOLUTE)
target_sources(app PRIVATE
  src/main.cpp
  "${NUCODE_ROOT}/libraries/NUCODE_BLE/src/NUCODE_BLE.cpp"
  "${NUCODE_ROOT}/libraries/NUCODE_BLE/src/NUCODE_BLE_GAP.cpp"
  "${NUCODE_ROOT}/libraries/NUCODE_BLE/src/internal/gap/GapValues.cpp"
  "${NUCODE_ROOT}/libraries/NUCODE_BLE/src/internal/gap/GapAdvertising.cpp"
  "${NUCODE_ROOT}/libraries/NUCODE_BLE/src/internal/gap/GapExtendedAdvertising.cpp"
  "${NUCODE_ROOT}/libraries/NUCODE_BLE/src/internal/gap/GapPeriodicAdvertising.cpp"
  "${NUCODE_ROOT}/libraries/NUCODE_BLE/src/internal/gap/GapPawr.cpp"
  "${NUCODE_ROOT}/libraries/NUCODE_BLE/src/internal/gap/GapScanning.cpp"
  "${NUCODE_ROOT}/libraries/NUCODE_BLE/src/internal/gap/GapConnection.cpp"
  "${NUCODE_ROOT}/libraries/NUCODE_BLE/src/NUCODE_BLE_GATT.cpp"
  "${NUCODE_ROOT}/libraries/NUCODE_BLE/src/internal/gatt/GattDatabase.cpp"
  "${NUCODE_ROOT}/libraries/NUCODE_BLE/src/internal/gatt/GattServer.cpp"
  "${NUCODE_ROOT}/libraries/NUCODE_BLE/src/internal/gatt/GattClient.cpp"
  "${NUCODE_ROOT}/libraries/NUCODE_BLE/src/internal/NUCODE_BLE_Stack.cpp"
)
target_include_directories(app PRIVATE
  "${NUCODE_ROOT}/libraries/NUCODE_BLE/src"
)
```

## prj.conf
```kconfig
CONFIG_CPP=y
CONFIG_STD_CPP17=y
CONFIG_CPP_EXCEPTIONS=n
CONFIG_CPP_RTTI=n

CONFIG_NUCODE_ARDUINO_CORE=y
CONFIG_NUCODE_ARDUINO_RUNTIME=n
CONFIG_NUCODE_ARDUINO_API=y
CONFIG_NUCODE_ARDUINO_GPIO=n
CONFIG_NUCODE_ARDUINO_INTERRUPTS=n
CONFIG_NUCODE_ARDUINO_TIME=n
CONFIG_NUCODE_ARDUINO_SERIAL=n
CONFIG_NUCODE_ARDUINO_WIRE=n
CONFIG_NUCODE_ARDUINO_SPI=n
CONFIG_NUCODE_ARDUINO_ADC=n
CONFIG_NUCODE_ARDUINO_PWM=n

CONFIG_BT=y
CONFIG_BT_PERIPHERAL=y
CONFIG_BT_CENTRAL=y
CONFIG_BT_MAX_CONN=1
CONFIG_BT_DEVICE_NAME_DYNAMIC=y
CONFIG_BT_DEVICE_NAME_MAX=32
CONFIG_BT_GATT_CLIENT=y
CONFIG_BT_GATT_DYNAMIC_DB=y
CONFIG_BT_USER_PHY_UPDATE=y
CONFIG_BT_NUS=y
CONFIG_BT_NUS_CLIENT=y
CONFIG_BT_GATT_DM=y
CONFIG_HEAP_MEM_POOL_SIZE=4096
CONFIG_SYSTEM_WORKQUEUE_STACK_SIZE=2048

CONFIG_NUCODE_BLE_CORE=y
CONFIG_NUCODE_BLE_NUS=y
CONFIG_NUCODE_BLE_CORE_EVENT_QUEUE_SIZE=24
CONFIG_NUCODE_BLE_SCAN_RESULT_QUEUE_SIZE=8
CONFIG_NUCODE_BLE_GATT=y
CONFIG_NUCODE_BLE_GATT_MAX_SERVICES=4
CONFIG_NUCODE_BLE_GATT_MAX_CHARACTERISTICS_PER_SERVICE=8
CONFIG_NUCODE_BLE_GATT_EVENT_QUEUE_SIZE=8
CONFIG_COMMON_LIBC_MALLOC_ARENA_SIZE=8192
```

## src/main.cpp
```c
/**
 * @file main.cpp
 * @brief M20 범용 GATT server/client 공개 API의 target 계약을 검증합니다.
 *
 * SPDX-License-Identifier: MIT
 */

#include <NUCODE_BLE.h>

#include <cstdint>

const nucode::ble::BLEUuid service_uuid("12345678-1234-5678-1234-56789abcdef0");
const nucode::ble::BLEUuid characteristic_uuid("12345678-1234-5678-1234-56789abcdef1");
nucode::ble::BLEService service(service_uuid);
nucode::ble::BLECharacteristic characteristic(
    characteristic_uuid,
    nucode::ble::BLEProperty::read | nucode::ble::BLEProperty::write |
        nucode::ble::BLEProperty::write_without_response |
        nucode::ble::BLEProperty::notify | nucode::ble::BLEProperty::indicate,
    nucode::ble::BLEPermission::read | nucode::ble::BLEPermission::write, 64U);

/** @brief server callback signature를 target compiler에 고정합니다. */
void onCharacteristic(nucode::ble::BLECharacteristic &owner,
                      const nucode::ble::BLECharacteristicEventInfo &event,
                      void *context)
{
    static_cast<void>(owner);
    static_cast<void>(event);
    static_cast<void>(context);
}

/** @brief generic client callback signature를 target compiler에 고정합니다. */
void onClient(nucode::ble::BLEGattClientEvent event, const std::uint8_t *data,
              std::size_t length, void *context)
{
    static_cast<void>(event);
    static_cast<void>(data);
    static_cast<void>(length);
    static_cast<void>(context);
}

int main()
{
    const std::uint8_t initial[] = {0x10U, 0x20U};
    characteristic.onEvent(onCharacteristic);
    BLEClient.onEvent(onClient);
    static_cast<void>(characteristic.setValue(initial, sizeof(initial)));
    static_cast<void>(service.addCharacteristic(characteristic));
    static_cast<void>(BLEDevice.addService(service));
    static_cast<void>(BLEClient.remoteService());
    static_cast<void>(BLEClient.remoteCharacteristic());
    static_cast<void>(BLEClient.lastAttError());
    return 0;
}
```
