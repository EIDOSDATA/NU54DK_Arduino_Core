## CMakeLists.txt
```
# SPDX-License-Identifier: MIT

cmake_minimum_required(VERSION 3.20.0)

find_package(Zephyr REQUIRED HINTS $ENV{ZEPHYR_BASE})
project(nucode_m32_mesh_update_contract)

get_filename_component(NUCODE_ROOT "${CMAKE_CURRENT_LIST_DIR}/../../.." ABSOLUTE)
target_sources(app PRIVATE
    src/main.cpp
    "${NUCODE_ROOT}/libraries/NUCODE_BLE_Mesh/src/NUCODE_BLE_Mesh.cpp"
    "${NUCODE_ROOT}/libraries/NUCODE_BLE_Mesh/src/NUCODE_BLE_Mesh_Composition.c"
    "${NUCODE_ROOT}/libraries/NUCODE_BLE_Mesh_Update/src/NUCODE_BLE_Mesh_Update.cpp"
)
target_include_directories(app PRIVATE
    "${NUCODE_ROOT}/libraries/NUCODE_BLE_Mesh/src"
    "${NUCODE_ROOT}/libraries/NUCODE_BLE_Mesh_Update/src"
)
```

## prj.conf
```kconfig
# SPDX-License-Identifier: MIT

CONFIG_CPP=y
CONFIG_STD_CPP17=y
CONFIG_CPP_EXCEPTIONS=n
CONFIG_CPP_RTTI=n

CONFIG_NUCODE_ARDUINO_CORE=y
CONFIG_NUCODE_ARDUINO_RUNTIME=n
CONFIG_NUCODE_ARDUINO_API=y
CONFIG_NUCODE_ARDUINO_GPIO=n
CONFIG_NUCODE_ARDUINO_INTERRUPTS=n
CONFIG_NUCODE_ARDUINO_TIME=n
CONFIG_NUCODE_ARDUINO_SERIAL=n
CONFIG_NUCODE_ARDUINO_WIRE=n
CONFIG_NUCODE_ARDUINO_SPI=n
CONFIG_NUCODE_ARDUINO_ADC=n
CONFIG_NUCODE_ARDUINO_PWM=n

CONFIG_BT=y
CONFIG_BT_CENTRAL=y
CONFIG_BT_PERIPHERAL=y
CONFIG_BT_OBSERVER=y
CONFIG_BT_BROADCASTER=y
CONFIG_BT_MAX_CONN=2
CONFIG_BT_CTLR_SDC_PERIPHERAL_COUNT=1
CONFIG_BT_BUF_ACL_TX_COUNT=8
CONFIG_BT_BUF_ACL_RX_COUNT_EXTRA=7
CONFIG_BT_MESH=y
CONFIG_BT_MESH_PB_ADV=y
CONFIG_BT_MESH_PB_GATT=y
CONFIG_BT_MESH_PB_GATT_CLIENT=y
CONFIG_BT_MESH_PROVISIONER=y
CONFIG_BT_MESH_CDB=y
CONFIG_BT_MESH_CDB_KEY_SYNC=y
CONFIG_BT_MESH_CDB_NODE_COUNT=4
CONFIG_BT_MESH_CDB_APP_KEY_COUNT=2
CONFIG_BT_MESH_CFG_CLI=y
CONFIG_BT_MESH_HEALTH_CLI=y
CONFIG_BT_MESH_RELAY=y
CONFIG_BT_MESH_FRIEND=y
CONFIG_BT_MESH_LOW_POWER=y
CONFIG_BT_MESH_GATT_PROXY=y
CONFIG_BT_MESH_TX_SEG_MAX=16
CONFIG_BT_MESH_RX_SEG_MAX=16
CONFIG_BT_MESH_ADV_BUF_COUNT=16
CONFIG_BT_MESH_RX_SEG_MSG_COUNT=2
CONFIG_BT_MESH_TX_SEG_MSG_COUNT=2
CONFIG_BT_SETTINGS=y
CONFIG_SETTINGS=y
CONFIG_SETTINGS_ZMS=y
CONFIG_SETTINGS_ZMS_LOAD_SUBTREE_PATH=y
CONFIG_FLASH=y
CONFIG_FLASH_MAP=y
CONFIG_ZMS=y
CONFIG_NUCODE_BLE_MESH=y
CONFIG_NUCODE_BLE_MESH_EVENT_QUEUE_SIZE=16

CONFIG_NUCODE_BLE_MESH_UPDATE=y
CONFIG_BOOTLOADER_MCUBOOT=y
CONFIG_STREAM_FLASH=y
CONFIG_IMG_MANAGER=y
CONFIG_MCUBOOT_IMG_MANAGER=y
CONFIG_IMG_ENABLE_IMAGE_CHECK=y
CONFIG_REBOOT=y
CONFIG_BT_MESH_MODEL_EXTENSIONS=y
CONFIG_BT_MESH_MODEL_EXTENSION_LIST_SIZE=4
CONFIG_BT_MESH_BLOB_SRV=y
CONFIG_BT_MESH_BLOB_CLI=y
CONFIG_BT_MESH_BLOB_IO_FLASH=y
CONFIG_BT_MESH_BLOB_SIZE_MAX=720896
CONFIG_BT_MESH_BLOB_BLOCK_SIZE_MIN=4096
CONFIG_BT_MESH_BLOB_BLOCK_SIZE_MAX=4096
CONFIG_BT_MESH_BLOB_CHUNK_COUNT_MAX=32
CONFIG_BT_MESH_ALIGN_CHUNK_SIZE_TO_MAX_SEGMENT=n
CONFIG_BT_MESH_RX_BLOB_CHUNK_SIZE=128
CONFIG_BT_MESH_TX_BLOB_CHUNK_SIZE=128
CONFIG_BT_MESH_BLOB_CLI_BLOCK_RETRIES=3
CONFIG_BT_MESH_DFU_SRV=y
CONFIG_BT_MESH_DFU_CLI=y
CONFIG_BT_MESH_DFU_METADATA=y
CONFIG_BT_MESH_DFU_FWID_MAXLEN=16
CONFIG_BT_MESH_DFU_METADATA_MAXLEN=32
CONFIG_BT_MESH_DFU_SLOTS=y
CONFIG_BT_MESH_DFU_SLOT_CNT=1
CONFIG_BT_MESH_DFD_SRV=y
CONFIG_BT_MESH_DFD_SRV_SLOT_MAX_SIZE=720896
CONFIG_BT_MESH_DFD_SRV_SLOT_SPACE=720896
CONFIG_BT_MESH_DFD_SRV_TARGETS_MAX=4
CONFIG_SYSTEM_WORKQUEUE_STACK_SIZE=4096
CONFIG_BT_RX_STACK_SIZE=5120
CONFIG_HEAP_MEM_POOL_SIZE=4096
```

## src/main.cpp
```c
/**
 * @file main.cpp
 * @brief M32-W08 Mesh BLOB·DFU 공개 API target compile 계약입니다.
 *
 * SPDX-License-Identifier: MIT
 */

#include <NUCODE_BLE_Mesh_Update.h>

using namespace nucode::mesh;

/** @brief 공개 구조와 API signature를 target compiler로 확인합니다. */
int main()
{
    const BlobTarget targets[] = {{0x0002U}, {0x0003U}};
    BlobTransfer transfer{};
    transfer.id = 0x4E553534424C4F42ULL;
    transfer.size = 4096U;
    transfer.targets = targets;
    transfer.target_count = sizeof(targets) / sizeof(targets[0]);
    transfer.mode = BlobTransferMode::pull;
    std::uint8_t digest[32]{};

    volatile bool execute_contract = false;
    if (execute_contract)
    {
        static_cast<void>(NUCODEMeshUpdate.begin());
        static_cast<void>(NUCODEMeshUpdate.prepareBlobReceive(transfer.id));
        static_cast<void>(NUCODEMeshUpdate.sendBlob(transfer));
        static_cast<void>(NUCODEMeshUpdate.suspendBlob());
        static_cast<void>(NUCODEMeshUpdate.resumeBlob());
        NUCODEMeshUpdate.cancelBlob();
        static_cast<void>(NUCODEMeshUpdate.clientProgress());
        static_cast<void>(NUCODEMeshUpdate.serverProgress());
        static_cast<void>(NUCODEMeshUpdate.expectImageDigest(digest, transfer.size));
        static_cast<void>(NUCODEMeshUpdate.verifyStagedDigest(digest, transfer.size));
        static_cast<void>(NUCODEMeshUpdate.requestTestUpgrade());
        static_cast<void>(NUCODEMeshUpdate.confirmRunningImage());
        NUCODEMeshUpdate.rebootToApply();
        static_cast<void>(NUCODEMeshUpdate.phase());
        static_cast<void>(NUCODEMeshUpdate.distributionPhase());
    }
    return 0;
}
```
