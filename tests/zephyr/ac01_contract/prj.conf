## CMakeLists.txt
```
# SPDX-License-Identifier: MIT

cmake_minimum_required(VERSION 3.20.0)

find_package(Zephyr REQUIRED HINTS $ENV{ZEPHYR_BASE})
project(nucode_ac01_contract)

target_sources(app PRIVATE
  src/main.cpp
)
```

## prj.conf
```kconfig
CONFIG_CPP=y
CONFIG_STD_CPP17=y
CONFIG_CPP_EXCEPTIONS=n
CONFIG_CPP_RTTI=n

CONFIG_NUCODE_ARDUINO_CORE=y
CONFIG_NUCODE_ARDUINO_RUNTIME=n
CONFIG_NUCODE_ARDUINO_API=y
CONFIG_NUCODE_ARDUINO_GPIO=y
CONFIG_NUCODE_ARDUINO_CONNECTOR_GPIO=y
CONFIG_NUCODE_ARDUINO_INTERRUPTS=y
CONFIG_NUCODE_ARDUINO_TIME=y
CONFIG_NUCODE_ARDUINO_SERIAL=n
CONFIG_NUCODE_ARDUINO_WIRE=n
CONFIG_NUCODE_ARDUINO_SPI=n
CONFIG_NUCODE_ARDUINO_ADC=n
CONFIG_NUCODE_ARDUINO_PWM=n

CONFIG_ZTEST=y
CONFIG_LOG=n
CONFIG_MAIN_STACK_SIZE=4096
CONFIG_HEAP_MEM_POOL_SIZE=0
CONFIG_COMMON_LIBC_MALLOC=y
CONFIG_COMMON_LIBC_MALLOC_ARENA_SIZE=8192
```

## app.overlay
```dts
/**
 * @file app.overlay
 * @brief AC-01 connector GPIO alias를 production target 시험에 추가합니다.
 * SPDX-License-Identifier: MIT
 */

#include <nucode/nu54dk-arduino-connectors.dtsi>
#include <nucode/nu54dk-arduino-pins.dtsi>
```

## src/main.cpp
```c
/**
 * @file main.cpp
 * @brief AC-01 공개 API와 negative 의미를 production DTS에서 검증합니다.
 *
 * SPDX-License-Identifier: MIT
 */

#include <Arduino.h>

#include <zephyr/devicetree.h>
#include <zephyr/ztest.h>

#include "internal/pin_description.h"

namespace
{
	using nucode::arduino::internal::GpioError;
	using nucode::arduino::internal::hasPinCapability;
	using nucode::arduino::internal::lastGpioError;
	using nucode::arduino::internal::PinCapability;
	using nucode::arduino::internal::pinDescription;
	using nucode::arduino::internal::PinOwnership;

	static_assert(NUCODE_NU54DK_HAS_CONNECTOR_GPIO == 1,
				  "AC-01 target에는 connector alias 두 개가 필요합니다.");
	static_assert(PIN_GPIO0 == 10U && PIN_GPIO1 == 11U,
				  "기존 v0.2.0 논리 ID 뒤에 connector GPIO를 추가해야 합니다.");
	static_assert(NUM_DIGITAL_PINS == 32U && NUM_DIGITAL_CAPABLE_PINS == 20U &&
					  NUM_PIN_ROLES == 32U && NUM_PHYSICAL_PINS == 31U,
				  "AC-01 profile의 공개 pin 범위와 descriptor 수가 다릅니다.");
	static_assert(D10 == PIN_GPIO0 && D11 == PIN_GPIO1,
				  "connector GPIO의 Arduino digital 별칭이 다릅니다.");
	static_assert(digitalPinToInterrupt(PIN_GPIO0) == NOT_AN_INTERRUPT &&
					  digitalPinToInterrupt(PIN_GPIO1) == NOT_AN_INTERRUPT &&
					  digitalPinToInterrupt(LED_BUILTIN) == NOT_AN_INTERRUPT &&
					  digitalPinToInterrupt(PIN_LED2) == NOT_AN_INTERRUPT &&
					  digitalPinToInterrupt(PIN_LED1) == PIN_PWM0 &&
					  digitalPinToInterrupt(PIN_LED3) == PIN_LED3 &&
					  digitalPinToInterrupt(PIN_BUTTON0) == PIN_BUTTON0,
				  "GPIO2는 IRQ에서 제외하고 GPIOTE pin은 유지해야 합니다.");
}

ZTEST(ac01_contract, test_connector_descriptors_are_alias_owned_and_open_drain_capable)
{
	const auto *const gpio0 = pinDescription(PIN_GPIO0);
	const auto *const gpio1 = pinDescription(PIN_GPIO1);
	zassert_not_null(gpio0, "PIN_GPIO0 descriptor가 없습니다.");
	zassert_not_null(gpio1, "PIN_GPIO1 descriptor가 없습니다.");
	zassert_equal(gpio0->gpio.port, DEVICE_DT_GET(DT_NODELABEL(gpio2)),
				  "PIN_GPIO0 controller가 profile alias와 다릅니다.");
	zassert_equal(gpio0->gpio.pin, 5U, "PIN_GPIO0 physical pin이 다릅니다.");
	zassert_equal(gpio1->gpio.pin, 6U, "PIN_GPIO1 physical pin이 다릅니다.");
	zassert_equal(gpio0->ownership, PinOwnership::connector_gpio,
				  "PIN_GPIO0 ownership이 connector_gpio가 아닙니다.");
	zassert_true(hasPinCapability(gpio0->capabilities, PinCapability::digital_input),
				 "connector input capability가 없습니다.");
	zassert_true(hasPinCapability(gpio0->capabilities, PinCapability::digital_output),
				 "connector output capability가 없습니다.");
	zassert_false(hasPinCapability(gpio0->capabilities, PinCapability::interrupt),
				  "GPIOTE가 없는 P2 connector에 interrupt capability를 노출했습니다.");
	zassert_true(hasPinCapability(gpio0->capabilities, PinCapability::open_drain),
				 "connector open-drain capability가 없습니다.");
}

ZTEST(ac01_contract, test_gpio2_leds_do_not_expose_interrupt_capability)
{
	const auto *const led0 = pinDescription(LED_BUILTIN);
	const auto *const led2 = pinDescription(PIN_LED2);
	const auto *const led3 = pinDescription(PIN_LED3);
	zassert_not_null(led0, "LED0 descriptor가 없습니다.");
	zassert_not_null(led2, "LED2 descriptor가 없습니다.");
	zassert_not_null(led3, "LED3 descriptor가 없습니다.");
	zassert_false(hasPinCapability(led0->capabilities, PinCapability::interrupt),
				  "GPIO2 LED0에 interrupt capability를 노출했습니다.");
	zassert_false(hasPinCapability(led2->capabilities, PinCapability::interrupt),
				  "GPIO2 LED2에 interrupt capability를 노출했습니다.");
	zassert_true(hasPinCapability(led3->capabilities, PinCapability::interrupt),
				 "GPIO1 LED3의 interrupt capability가 없습니다.");
}

ZTEST(ac01_contract, test_open_drain_is_limited_to_connector_gpio)
{
	pinMode(PIN_GPIO0, OUTPUT_OPENDRAIN);
	zassert_equal(lastGpioError(), GpioError::none,
				  "connector open-drain 구성이 실패했습니다.");

	pinMode(LED_BUILTIN, OUTPUT_OPENDRAIN);
	zassert_equal(lastGpioError(), GpioError::unsupported_capability,
				  "board LED의 open-drain 요청을 거부하지 않았습니다.");
}

ZTEST(ac01_contract, test_pulse_and_shift_negative_contract)
{
	pinMode(PIN_GPIO0, OUTPUT);
	zassert_equal(pulseIn(PIN_GPIO0, HIGH, 100U), 0UL,
				  "output pin pulse 측정을 허용했습니다.");
	zassert_equal(lastGpioError(), GpioError::wrong_mode,
				  "output pin pulse 오류가 wrong_mode가 아닙니다.");

	pinMode(PIN_GPIO1, INPUT_PULLUP);
	zassert_equal(pulseIn(PIN_GPIO1, 2U, 100U), 0UL,
				  "잘못된 pulse state를 허용했습니다.");
	zassert_equal(lastGpioError(), GpioError::invalid_value,
				  "잘못된 pulse state 진단이 다릅니다.");

	shiftOut(PIN_GPIO0, PIN_GPIO0, MSBFIRST, 0x5aU);
	zassert_equal(lastGpioError(), GpioError::ownership_conflict,
				  "data/clock 중복 pin을 거부하지 않았습니다.");
}

ZTEST(ac01_contract, test_interrupt_mask_is_nested_and_unbalanced_restore_is_rejected)
{
	noInterrupts();
	zassert_equal(lastGpioError(), GpioError::none, "첫 callback mask가 실패했습니다.");
	noInterrupts();
	zassert_equal(lastGpioError(), GpioError::none, "중첩 callback mask가 실패했습니다.");
	interrupts();
	zassert_equal(lastGpioError(), GpioError::none, "첫 중첩 복원이 실패했습니다.");
	interrupts();
	zassert_equal(lastGpioError(), GpioError::none, "마지막 중첩 복원이 실패했습니다.");
	interrupts();
	zassert_equal(lastGpioError(), GpioError::interrupt_restore_without_disable,
				  "짝이 없는 interrupts()를 안전하게 거부하지 않았습니다.");
}

ZTEST_SUITE(ac01_contract, nullptr, nullptr, nullptr, nullptr, nullptr);
```
