## tests/zephyr/m32_ble_resource_contract/testcase.yaml
```yaml
tests:
  nucode.m32.ble.resource.c1p1:
    platform_allow:
      - nrf54l15dk/nrf54l15/cpuapp/nu54dk
    integration_platforms:
      - nrf54l15dk/nrf54l15/cpuapp/nu54dk
    extra_args:
      - EXTRA_CONF_FILE=c1p1.conf
    tags:
      - nucode
      - m32
      - bluetooth
  nucode.m32.ble.resource.c2p0:
    platform_allow:
      - nrf54l15dk/nrf54l15/cpuapp/nu54dk
    integration_platforms:
      - nrf54l15dk/nrf54l15/cpuapp/nu54dk
    extra_args:
      - EXTRA_CONF_FILE=c2p0.conf
    tags:
      - nucode
      - m32
      - bluetooth
  nucode.m32.ble.resource.c0p2:
    platform_allow:
      - nrf54l15dk/nrf54l15/cpuapp/nu54dk
    integration_platforms:
      - nrf54l15dk/nrf54l15/cpuapp/nu54dk
    extra_args:
      - EXTRA_CONF_FILE=c0p2.conf
    tags:
      - nucode
      - m32
      - bluetooth
```

## tests/zephyr/m32_ble_timing_contract/testcase.yaml
```yaml
tests:
  nucode.m32.ble_timing_contract:
    tags:
      - nucode
      - arduino
      - m32
      - bluetooth
      - timing
      - features
    build_only: true
    sysbuild: false
    platform_allow:
      - nrf54l15dk/nrf54l15/cpuapp/nu54dk
    integration_platforms:
      - nrf54l15dk/nrf54l15/cpuapp/nu54dk
```

## tests/zephyr/m32_ble_timing_hil/testcase.yaml
```yaml
tests:
  nucode.m32.ble_timing_hil.central:
    build_only: true
    extra_args:
      - M32_TIMING_ROLE=central
    platform_allow:
      - nrf54l15dk/nrf54l15/cpuapp/nu54dk
    integration_platforms:
      - nrf54l15dk/nrf54l15/cpuapp/nu54dk
    tags:
      - bluetooth
      - m32
      - timing
      - feature
      - hil
  nucode.m32.ble_timing_hil.peripheral:
    build_only: true
    extra_args:
      - M32_TIMING_ROLE=peripheral
    platform_allow:
      - nrf54l15dk/nrf54l15/cpuapp/nu54dk
    integration_platforms:
      - nrf54l15dk/nrf54l15/cpuapp/nu54dk
    tags:
      - bluetooth
      - m32
      - timing
      - feature
      - hil
```

## tests/zephyr/m32_coexistence_contract/testcase.yaml
```yaml
tests:
  nucode.m32.coexistence.ble_mesh:
    platform_allow:
      - nrf54l15dk/nrf54l15/cpuapp/nu54dk
    extra_args:
      - EXTRA_CONF_FILE=ble_mesh.conf
  nucode.m32.coexistence.ble_154:
    platform_allow:
      - nrf54l15dk/nrf54l15/cpuapp/nu54dk
    extra_args:
      - EXTRA_CONF_FILE=ble_154.conf
  nucode.m32.coexistence.ble_esb:
    platform_allow:
      - nrf54l15dk/nrf54l15/cpuapp/nu54dk
    extra_args:
      - EXTRA_CONF_FILE=ble_esb.conf
  nucode.m32.coexistence.external_one_wire:
    platform_allow:
      - nrf54l15dk/nrf54l15/cpuapp/nu54dk
    extra_args:
      - EXTRA_CONF_FILE=external.conf
      - DTC_OVERLAY_FILE=external.overlay
```

## tests/zephyr/m32_coexistence_hil/testcase.yaml
```yaml
tests:
  nucode.m32.coexistence_hil.ble_154.dut:
    build_only: true
    extra_args: [M32_COEX_SCENARIO=ble_154, M32_COEX_ROLE=dut, EXTRA_CONF_FILE=ble_154_dut.conf]
    platform_allow: [nrf54l15dk/nrf54l15/cpuapp/nu54dk]
    integration_platforms: [nrf54l15dk/nrf54l15/cpuapp/nu54dk]
    tags: [bluetooth, radio, m32, hil]
  nucode.m32.coexistence_hil.ble_154.radio_peer:
    build_only: true
    extra_args: [M32_COEX_SCENARIO=ble_154, M32_COEX_ROLE=radio_peer, EXTRA_CONF_FILE=radio154_peer.conf]
    platform_allow: [nrf54l15dk/nrf54l15/cpuapp/nu54dk]
    integration_platforms: [nrf54l15dk/nrf54l15/cpuapp/nu54dk]
    tags: [bluetooth, radio, m32, hil]
  nucode.m32.coexistence_hil.ble_154.ble_peer:
    build_only: true
    extra_args: [M32_COEX_SCENARIO=ble_154, M32_COEX_ROLE=ble_peer, EXTRA_CONF_FILE=ble.conf]
    platform_allow: [nrf54l15dk/nrf54l15/cpuapp/nu54dk]
    integration_platforms: [nrf54l15dk/nrf54l15/cpuapp/nu54dk]
    tags: [bluetooth, radio, m32, hil]
  nucode.m32.coexistence_hil.ble_esb.dut:
    build_only: true
    extra_args: [M32_COEX_SCENARIO=ble_esb, M32_COEX_ROLE=dut, EXTRA_CONF_FILE=ble_esb_dut.conf]
    platform_allow: [nrf54l15dk/nrf54l15/cpuapp/nu54dk]
    integration_platforms: [nrf54l15dk/nrf54l15/cpuapp/nu54dk]
    tags: [bluetooth, radio, m32, hil]
  nucode.m32.coexistence_hil.ble_esb.radio_peer:
    build_only: true
    extra_args: [M32_COEX_SCENARIO=ble_esb, M32_COEX_ROLE=radio_peer, EXTRA_CONF_FILE=esb_peer.conf]
    platform_allow: [nrf54l15dk/nrf54l15/cpuapp/nu54dk]
    integration_platforms: [nrf54l15dk/nrf54l15/cpuapp/nu54dk]
    tags: [bluetooth, radio, m32, hil]
  nucode.m32.coexistence_hil.ble_esb.ble_peer:
    build_only: true
    extra_args: [M32_COEX_SCENARIO=ble_esb, M32_COEX_ROLE=ble_peer, EXTRA_CONF_FILE=ble.conf]
    platform_allow: [nrf54l15dk/nrf54l15/cpuapp/nu54dk]
    integration_platforms: [nrf54l15dk/nrf54l15/cpuapp/nu54dk]
    tags: [bluetooth, radio, m32, hil]
  nucode.m32.coexistence_hil.ble_mesh.dut:
    build_only: true
    extra_args: [M32_COEX_SCENARIO=ble_mesh, M32_COEX_ROLE=dut, EXTRA_CONF_FILE=ble_mesh_dut.conf]
    platform_allow: [nrf54l15dk/nrf54l15/cpuapp/nu54dk]
    integration_platforms: [nrf54l15dk/nrf54l15/cpuapp/nu54dk]
    tags: [bluetooth, mesh, m32, hil]
  nucode.m32.coexistence_hil.ble_mesh.mesh_peer:
    build_only: true
    extra_args: [M32_COEX_SCENARIO=ble_mesh, M32_COEX_ROLE=mesh_peer, EXTRA_CONF_FILE=mesh_peer.conf]
    platform_allow: [nrf54l15dk/nrf54l15/cpuapp/nu54dk]
    integration_platforms: [nrf54l15dk/nrf54l15/cpuapp/nu54dk]
    tags: [bluetooth, mesh, m32, hil]
  nucode.m32.coexistence_hil.ble_mesh.ble_peer:
    build_only: true
    extra_args: [M32_COEX_SCENARIO=ble_mesh, M32_COEX_ROLE=ble_peer, EXTRA_CONF_FILE=ble.conf]
    platform_allow: [nrf54l15dk/nrf54l15/cpuapp/nu54dk]
    integration_platforms: [nrf54l15dk/nrf54l15/cpuapp/nu54dk]
    tags: [bluetooth, mesh, m32, hil]
```

## tests/zephyr/m32_esb_contract/testcase.yaml
```yaml
tests:
  nucode.m32.esb_contract:
    build_only: true
    platform_allow:
      - nrf54l15dk/nrf54l15/cpuapp/nu54dk
    integration_platforms:
      - nrf54l15dk/nrf54l15/cpuapp/nu54dk
    tags:
      - esb
      - radio
      - m32
```

## tests/zephyr/m32_esb_hil/testcase.yaml
```yaml
tests:
  nucode.m32.esb_hil.ptx:
    build_only: true
    extra_args: [M32_ESB_ROLE=ptx]
    platform_allow: [nrf54l15dk/nrf54l15/cpuapp/nu54dk]
    integration_platforms: [nrf54l15dk/nrf54l15/cpuapp/nu54dk]
    tags: [m32, radio, esb, hil]
  nucode.m32.esb_hil.prx:
    build_only: true
    extra_args: [M32_ESB_ROLE=prx]
    platform_allow: [nrf54l15dk/nrf54l15/cpuapp/nu54dk]
    integration_platforms: [nrf54l15dk/nrf54l15/cpuapp/nu54dk]
    tags: [m32, radio, esb, hil]
```

## tests/zephyr/m32_mesh_contract/testcase.yaml
```yaml
tests:
  nucode.m32.mesh.contract:
    build_only: true
    platform_allow:
      - nrf54l15dk/nrf54l15/cpuapp/nu54dk
    integration_platforms:
      - nrf54l15dk/nrf54l15/cpuapp/nu54dk
    tags:
      - bluetooth
      - mesh
      - m32
```

## tests/zephyr/m32_mesh_dfu_hil/testcase.yaml
```yaml
tests:
  nucode.m32.mesh_dfu_hil.distributor:
    tags: [nucode, arduino, m32, bluetooth, mesh, dfu, hil]
    build_only: true
    sysbuild: true
    extra_args:
      - M32_MDFU_ROLE=distributor
      - M32_MDFU_CANDIDATE_SHA256=0000000000000000000000000000000000000000000000000000000000000000
      - M32_MDFU_CANDIDATE_SIZE=1
      - EXTRA_CONF_FILE=mesh.conf
    platform_allow: [nrf54l15dk/nrf54l15/cpuapp/nu54dk]
    integration_platforms: [nrf54l15dk/nrf54l15/cpuapp/nu54dk]
  nucode.m32.mesh_dfu_hil.target_a:
    tags: [nucode, arduino, m32, bluetooth, mesh, dfu, hil]
    build_only: true
    sysbuild: true
    extra_args:
      - M32_MDFU_ROLE=target_a
      - M32_MDFU_CANDIDATE_SHA256=0000000000000000000000000000000000000000000000000000000000000000
      - M32_MDFU_CANDIDATE_SIZE=1
      - EXTRA_CONF_FILE=mesh.conf
    platform_allow: [nrf54l15dk/nrf54l15/cpuapp/nu54dk]
    integration_platforms: [nrf54l15dk/nrf54l15/cpuapp/nu54dk]
  nucode.m32.mesh_dfu_hil.target_b:
    tags: [nucode, arduino, m32, bluetooth, mesh, dfu, hil]
    build_only: true
    sysbuild: true
    extra_args:
      - M32_MDFU_ROLE=target_b
      - M32_MDFU_CANDIDATE_SHA256=0000000000000000000000000000000000000000000000000000000000000000
      - M32_MDFU_CANDIDATE_SIZE=1
      - EXTRA_CONF_FILE=mesh.conf
    platform_allow: [nrf54l15dk/nrf54l15/cpuapp/nu54dk]
    integration_platforms: [nrf54l15dk/nrf54l15/cpuapp/nu54dk]
  nucode.m32.mesh_dfu_hil.candidate:
    tags: [nucode, arduino, m32, bluetooth, mesh, dfu, hil]
    build_only: true
    sysbuild: true
    extra_args:
      - M32_MDFU_ROLE=candidate
      - EXTRA_CONF_FILE=candidate.conf
    platform_allow: [nrf54l15dk/nrf54l15/cpuapp/nu54dk]
    integration_platforms: [nrf54l15dk/nrf54l15/cpuapp/nu54dk]
```

## tests/zephyr/m32_mesh_hil/testcase.yaml
```yaml
tests:
  nucode.m32.mesh_hil.provisioner:
    build_only: true
    extra_args: [M32_MESH_ROLE=provisioner]
    platform_allow: [nrf54l15dk/nrf54l15/cpuapp/nu54dk]
    integration_platforms: [nrf54l15dk/nrf54l15/cpuapp/nu54dk]
    tags: [bluetooth, mesh, m32, hil]
  nucode.m32.mesh_hil.node_a:
    build_only: true
    extra_args: [M32_MESH_ROLE=node_a]
    platform_allow: [nrf54l15dk/nrf54l15/cpuapp/nu54dk]
    integration_platforms: [nrf54l15dk/nrf54l15/cpuapp/nu54dk]
    tags: [bluetooth, mesh, m32, hil]
  nucode.m32.mesh_hil.node_b:
    build_only: true
    extra_args: [M32_MESH_ROLE=node_b]
    platform_allow: [nrf54l15dk/nrf54l15/cpuapp/nu54dk]
    integration_platforms: [nrf54l15dk/nrf54l15/cpuapp/nu54dk]
    tags: [bluetooth, mesh, m32, hil]
```

## tests/zephyr/m32_mesh_management_contract/testcase.yaml
```yaml
tests:
  nucode.m32.mesh_management_contract:
    build_only: true
    platform_allow:
      - nrf54l15dk/nrf54l15/cpuapp/nu54dk
    integration_platforms:
      - nrf54l15dk/nrf54l15/cpuapp/nu54dk
    tags:
      - nucode
      - bluetooth
      - mesh
      - m32
```

## tests/zephyr/m32_mesh_management_hil/testcase.yaml
```yaml
tests:
  nucode.m32.mesh_management_hil.client:
    build_only: true
    extra_args: [M32_MESH11_ROLE=client]
    platform_allow: [nrf54l15dk/nrf54l15/cpuapp/nu54dk]
    integration_platforms: [nrf54l15dk/nrf54l15/cpuapp/nu54dk]
    tags: [bluetooth, mesh, m32, hil]
  nucode.m32.mesh_management_hil.server:
    build_only: true
    extra_args: [M32_MESH11_ROLE=server]
    platform_allow: [nrf54l15dk/nrf54l15/cpuapp/nu54dk]
    integration_platforms: [nrf54l15dk/nrf54l15/cpuapp/nu54dk]
    tags: [bluetooth, mesh, m32, hil]
  nucode.m32.mesh_management_hil.target:
    build_only: true
    extra_args: [M32_MESH11_ROLE=target]
    platform_allow: [nrf54l15dk/nrf54l15/cpuapp/nu54dk]
    integration_platforms: [nrf54l15dk/nrf54l15/cpuapp/nu54dk]
    tags: [bluetooth, mesh, m32, hil]
```

## tests/zephyr/m32_mesh_update_hil/testcase.yaml
```yaml
tests:
  nucode.m32.mesh_update_hil.blob_client:
    build_only: true
    sysbuild: true
    extra_args: [M32_MESH_UPDATE_ROLE=blob_client]
    platform_allow: [nrf54l15dk/nrf54l15/cpuapp/nu54dk]
    integration_platforms: [nrf54l15dk/nrf54l15/cpuapp/nu54dk]
    tags: [bluetooth, mesh, m32, hil]
  nucode.m32.mesh_update_hil.target_a:
    build_only: true
    sysbuild: true
    extra_args: [M32_MESH_UPDATE_ROLE=target_a]
    platform_allow: [nrf54l15dk/nrf54l15/cpuapp/nu54dk]
    integration_platforms: [nrf54l15dk/nrf54l15/cpuapp/nu54dk]
    tags: [bluetooth, mesh, m32, hil]
  nucode.m32.mesh_update_hil.target_b:
    build_only: true
    sysbuild: true
    extra_args: [M32_MESH_UPDATE_ROLE=target_b]
    platform_allow: [nrf54l15dk/nrf54l15/cpuapp/nu54dk]
    integration_platforms: [nrf54l15dk/nrf54l15/cpuapp/nu54dk]
    tags: [bluetooth, mesh, m32, hil]
```

## tests/zephyr/m32_radio154_contract/testcase.yaml
```yaml
tests:
  nucode.m32.radio154_contract:
    build_only: true
    platform_allow:
      - nrf54l15dk/nrf54l15/cpuapp/nu54dk
    integration_platforms:
      - nrf54l15dk/nrf54l15/cpuapp/nu54dk
    tags:
      - ieee802154
      - radio
      - m32
```

## tests/zephyr/m32_radio154_hil/testcase.yaml
```yaml
tests:
  nucode.m32.radio154_hil.transmitter:
    build_only: true
    extra_args: [M32_RADIO154_ROLE=transmitter]
    platform_allow: [nrf54l15dk/nrf54l15/cpuapp/nu54dk]
    integration_platforms: [nrf54l15dk/nrf54l15/cpuapp/nu54dk]
    tags: [m32, radio, ieee802154, hil]
  nucode.m32.radio154_hil.receiver:
    build_only: true
    extra_args: [M32_RADIO154_ROLE=receiver]
    platform_allow: [nrf54l15dk/nrf54l15/cpuapp/nu54dk]
    integration_platforms: [nrf54l15dk/nrf54l15/cpuapp/nu54dk]
    tags: [m32, radio, ieee802154, hil]
```

## tests/zephyr/m32_regression_soak_hil/testcase.yaml
```yaml
tests:
  nucode.m32.regression_soak_hil.peripheral:
    build_only: true
    extra_args: [M32_W11_ROLE=peripheral]
    platform_allow: [nrf54l15dk/nrf54l15/cpuapp/nu54dk]
    integration_platforms: [nrf54l15dk/nrf54l15/cpuapp/nu54dk]
    tags: [bluetooth, m32, regression, soak, hil]
  nucode.m32.regression_soak_hil.mixed:
    build_only: true
    extra_args: [M32_W11_ROLE=mixed]
    platform_allow: [nrf54l15dk/nrf54l15/cpuapp/nu54dk]
    integration_platforms: [nrf54l15dk/nrf54l15/cpuapp/nu54dk]
    tags: [bluetooth, m32, regression, soak, hil]
  nucode.m32.regression_soak_hil.central:
    build_only: true
    extra_args: [M32_W11_ROLE=central]
    platform_allow: [nrf54l15dk/nrf54l15/cpuapp/nu54dk]
    integration_platforms: [nrf54l15dk/nrf54l15/cpuapp/nu54dk]
    tags: [bluetooth, m32, regression, soak, hil]
```

## tests/zephyr/m33_ecosystem_hil/testcase.yaml
```yaml
tests:
  nucode.m33.ecosystem.client:
    build_only: true
    extra_args:
      - COMPANION_ROLE=client
    platform_allow:
      - nrf54l15dk/nrf54l15/cpuapp/nu54dk
    tags:
      - bluetooth
      - m33
      - hil
  nucode.m33.ecosystem.peer:
    build_only: true
    extra_args:
      - COMPANION_ROLE=peer
    platform_allow:
      - nrf54l15dk/nrf54l15/cpuapp/nu54dk
    tags:
      - bluetooth
      - m33
      - hil
```

## tests/zephyr/m3_runtime/testcase.yaml
```yaml
tests:
  nucode.m3.runtime:
    tags:
      - nucode
      - arduino
      - m3
      - gpio
      - timing
    harness: ztest
    sysbuild: false
    platform_allow:
      - nrf54l15dk/nrf54l15/cpuapp/nu54dk
    integration_platforms:
      - nrf54l15dk/nrf54l15/cpuapp/nu54dk
```

## tests/zephyr/m4_api_contract/testcase.yaml
```yaml
tests:
  nucode.m4.api_contract:
    build_only: true
    tags:
      - nucode
      - arduino
      - m4
      - api
    sysbuild: false
    platform_allow:
      - nrf54l15dk/nrf54l15/cpuapp/nu54dk
    integration_platforms:
      - nrf54l15dk/nrf54l15/cpuapp/nu54dk
```

## tests/zephyr/m6_core_api/testcase.yaml
```yaml
tests:
  nucode.m6.core_api:
    tags:
      - nucode
      - arduino
      - m6
      - api
      - serial
      - interrupt
    harness: ztest
    sysbuild: false
    platform_allow:
      - nrf54l15dk/nrf54l15/cpuapp/nu54dk
    integration_platforms:
      - nrf54l15dk/nrf54l15/cpuapp/nu54dk
```

## tests/zephyr/m7_core_api/testcase.yaml
```yaml
tests:
  nucode.m7.core_api:
    tags:
      - nucode
      - arduino
      - m7
      - wire
      - spi
      - adc
      - pwm
    harness: ztest
    sysbuild: false
    platform_allow:
      - nrf54l15dk/nrf54l15/cpuapp/nu54dk
    integration_platforms:
      - nrf54l15dk/nrf54l15/cpuapp/nu54dk
```
