## tests/zephyr/r01_serial/testcase.yaml
```yaml
common:
  platform_allow: [nrf54l15dk/nrf54l15/cpuapp/nu54dk]
  build_only: true
  tags: [nucode, r01, serial, source_contract]
tests:
  nucode.r01.none: {}
  nucode.r01.uarte:
    extra_configs: [CONFIG_NUCODE_ARDUINO_SERIAL_FABRIC_UARTE=y]
  nucode.r01.spim:
    extra_configs: [CONFIG_NUCODE_ARDUINO_SERIAL_FABRIC_SPIM=y]
  nucode.r01.spis:
    extra_configs: [CONFIG_NUCODE_ARDUINO_SERIAL_FABRIC_SPIS=y]
  nucode.r01.twim:
    extra_configs: [CONFIG_NUCODE_ARDUINO_SERIAL_FABRIC_TWIM=y]
  nucode.r01.twis:
    extra_configs: [CONFIG_NUCODE_ARDUINO_SERIAL_FABRIC_TWIS=y]
  nucode.r01.all:
    extra_configs:
      - CONFIG_NUCODE_ARDUINO_SERIAL_FABRIC_UARTE=y
      - CONFIG_NUCODE_ARDUINO_SERIAL_FABRIC_SPIM=y
      - CONFIG_NUCODE_ARDUINO_SERIAL_FABRIC_SPIS=y
      - CONFIG_NUCODE_ARDUINO_SERIAL_FABRIC_TWIM=y
      - CONFIG_NUCODE_ARDUINO_SERIAL_FABRIC_TWIS=y
```

## tests/zephyr/t16_peripheral_profile_contract/testcase.yaml
```yaml
tests:
  nucode.t16.peripheral_profile:
    tags: [nucode, arduino, t16, peripheral, profile]
    platform_allow: [nrf54l15dk/nrf54l15/cpuapp/nu54dk]
    build_only: true
```

## tests/zephyr/v04_pair_hil/testcase.yaml
```yaml
tests:
  nucode.v04.pair_dut:
    platform_allow: nrf54l15dk/nrf54l15/cpuapp/nu54dk
    build_only: true
    tags: [nucode, v04, hil]
    extra_configs:
      - CONFIG_NUCODE_V04_HIL_ROLE=1
  nucode.v04.pair_peer:
    platform_allow: nrf54l15dk/nrf54l15/cpuapp/nu54dk
    build_only: true
    tags: [nucode, v04, hil]
    extra_configs:
      - CONFIG_NUCODE_V04_HIL_ROLE=2
```

## tests/zephyr/v04_t13_hil/Kconfig
```kconfig
mainmenu "NU54DK T13 S/U HIL"
source "Kconfig.zephyr"
config NUCODE_V04_HIL_ROLE
    int "Physical role: 1 DUT, 2 peer"
    range 1 2
    default 1
config NUCODE_T13_HARNESS
    int "Compiled harness: 2 S, 3 U"
    range 2 3
    default 2
config NUCODE_T13_POWER
    bool "S UART relay and System OFF verification image"
    default n
    select POWEROFF
    select HWINFO
    select RETAINED_MEM
config NUCODE_T13_UART_TRACE
    bool "Diagnostic UART callback and DMA buffer history"
    depends on !NUCODE_T13_POWER
    default n
```
