## CMakeLists.txt
```
# SPDX-License-Identifier: MIT

cmake_minimum_required(VERSION 3.20.0)

find_package(Zephyr REQUIRED HINTS $ENV{ZEPHYR_BASE})
project(nucode_m32_mesh_contract)

get_filename_component(NUCODE_ROOT "${CMAKE_CURRENT_LIST_DIR}/../../.." ABSOLUTE)
target_sources(app PRIVATE
    src/main.cpp
    "${NUCODE_ROOT}/libraries/NUCODE_BLE_Mesh/src/NUCODE_BLE_Mesh.cpp"
    "${NUCODE_ROOT}/libraries/NUCODE_BLE_Mesh/src/NUCODE_BLE_Mesh_Composition.c"
)
target_include_directories(app PRIVATE
    "${NUCODE_ROOT}/libraries/NUCODE_BLE_Mesh/src"
)
```

## prj.conf
```kconfig
# SPDX-License-Identifier: MIT

CONFIG_CPP=y
CONFIG_STD_CPP17=y
CONFIG_CPP_EXCEPTIONS=n
CONFIG_CPP_RTTI=n

CONFIG_NUCODE_ARDUINO_CORE=y
CONFIG_NUCODE_ARDUINO_RUNTIME=n
CONFIG_NUCODE_ARDUINO_API=y
CONFIG_NUCODE_ARDUINO_GPIO=n
CONFIG_NUCODE_ARDUINO_INTERRUPTS=n
CONFIG_NUCODE_ARDUINO_TIME=n
CONFIG_NUCODE_ARDUINO_SERIAL=n
CONFIG_NUCODE_ARDUINO_WIRE=n
CONFIG_NUCODE_ARDUINO_SPI=n
CONFIG_NUCODE_ARDUINO_ADC=n
CONFIG_NUCODE_ARDUINO_PWM=n

CONFIG_BT=y
CONFIG_BT_CENTRAL=y
CONFIG_BT_PERIPHERAL=y
CONFIG_BT_OBSERVER=y
CONFIG_BT_BROADCASTER=y
CONFIG_BT_MAX_CONN=2
CONFIG_BT_CTLR_SDC_PERIPHERAL_COUNT=1
CONFIG_BT_BUF_ACL_TX_COUNT=8
CONFIG_BT_BUF_ACL_RX_COUNT_EXTRA=7
CONFIG_BT_MESH=y
CONFIG_BT_MESH_PB_ADV=y
CONFIG_BT_MESH_PB_GATT=y
CONFIG_BT_MESH_PB_GATT_CLIENT=y
CONFIG_BT_MESH_PROVISIONER=y
CONFIG_BT_MESH_CDB=y
CONFIG_BT_MESH_CDB_KEY_SYNC=y
CONFIG_BT_MESH_CDB_NODE_COUNT=3
CONFIG_BT_MESH_CDB_APP_KEY_COUNT=2
CONFIG_BT_MESH_CFG_CLI=y
CONFIG_BT_MESH_HEALTH_CLI=y
CONFIG_BT_MESH_RELAY=y
CONFIG_BT_MESH_RELAY_ENABLED=n
CONFIG_BT_MESH_FRIEND=y
CONFIG_BT_MESH_FRIEND_ENABLED=n
CONFIG_BT_MESH_LOW_POWER=y
CONFIG_BT_MESH_GATT_PROXY=y
CONFIG_BT_MESH_GATT_PROXY_ENABLED=n
CONFIG_BT_MESH_TX_SEG_MAX=16
CONFIG_BT_MESH_RX_SEG_MAX=16
CONFIG_BT_MESH_ADV_BUF_COUNT=16
CONFIG_BT_MESH_RX_SEG_MSG_COUNT=2
CONFIG_BT_MESH_TX_SEG_MSG_COUNT=2
CONFIG_BT_SETTINGS=y
CONFIG_SETTINGS=y
CONFIG_SETTINGS_ZMS=y
CONFIG_SETTINGS_ZMS_LOAD_SUBTREE_PATH=y
CONFIG_FLASH=y
CONFIG_FLASH_MAP=y
CONFIG_ZMS=y
CONFIG_NUCODE_BLE_MESH=y
CONFIG_NUCODE_BLE_MESH_EVENT_QUEUE_SIZE=16
CONFIG_HEAP_MEM_POOL_SIZE=4096
CONFIG_SYSTEM_WORKQUEUE_STACK_SIZE=2048
```

## src/main.cpp
```c
/** @file @brief M32-W06 Mesh 공개 API의 target link 계약을 검사합니다. */

#include <NUCODE_BLE_Mesh.h>

using namespace nucode::mesh;

/** @brief 공개 callback signature를 target compiler에 고정합니다. */
void onMeshEvent(const EventRecord &, void *)
{
}

/** @brief provisioning, 역할과 모든 표준 model entry point를 link합니다. */
int main()
{
    Configuration configuration{};
    configuration.role = Role::node;
    configuration.bearers = Bearer::all;
    Destination destination{};
    destination.force_segment_acknowledgment = true;
    const std::uint8_t app_key[16]{};
    HealthFaults faults{};
    Publication publication{};

    NUCODEMesh.onEvent(onMeshEvent);
    static_cast<void>(NUCODEMesh.provisioned());
    static_cast<void>(NUCODEMesh.configureAppKey(0x0002U, app_key));
    static_cast<void>(NUCODEMesh.updateKeys(0x0002U, app_key, app_key));
    static_cast<void>(NUCODEMesh.transitionKeyRefresh(
        0x0002U, KeyRefreshTransition::use_new_keys));
    static_cast<void>(NUCODEMesh.bindModel(0x0002U, 0x0002U, Model::generic_on_off));
    static_cast<void>(NUCODEMesh.subscribeModel(0x0002U, 0x0002U,
                                                Model::generic_on_off, 0xC000U));
    static_cast<void>(NUCODEMesh.configurePublication(0x0002U, 0x0002U,
                                                      Model::generic_on_off,
                                                      publication));
    static_cast<void>(NUCODEMesh.readHealthFaults(destination, 0x0054U, faults));
    static_cast<void>(NUCODEMesh.sendOnOff(destination, true, true));
    static_cast<void>(NUCODEMesh.setLocalOnOff(true, false));
    static_cast<void>(NUCODEMesh.localOnOff());
    static_cast<void>(NUCODEMesh.sendLevel(destination, 0, false));
    static_cast<void>(NUCODEMesh.sendLightness(destination, 0x8000U, true));
    static_cast<void>(NUCODEMesh.requestSensor(destination));
    static_cast<void>(NUCODEMesh.requestTime(destination));
    static_cast<void>(NUCODEMesh.recallScene(destination, 1U, true));
    static_cast<void>(NUCODEMesh.requestSchedule(destination));
    static_cast<void>(NUCODEMesh.droppedEvents());
    static_cast<void>(NUCODEMesh.lastError());
    static_cast<void>(NUCODEMesh.lastDriverError());
    static_cast<void>(NUCODEMesh.lastConfigurationStatus());
    return 0;
}
```
