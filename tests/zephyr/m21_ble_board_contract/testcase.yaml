## tests/zephyr/m21_ble_board_contract/testcase.yaml
```yaml
tests:
  nucode.m21.ble_board_contract:
    tags:
      - nucode
      - arduino
      - m21
      - bluetooth
      - security
      - board
    build_only: true
    sysbuild: false
    platform_allow:
      - nrf54l15dk/nrf54l15/cpuapp/nu54dk
    integration_platforms:
      - nrf54l15dk/nrf54l15/cpuapp/nu54dk
```

## tests/zephyr/m21_ble_contract/testcase.yaml
```yaml
tests:
  nucode.m21.ble_security_contract:
    tags:
      - nucode
      - arduino
      - m21
      - bluetooth
      - security
      - hids
    build_only: true
    sysbuild: false
    platform_allow:
      - nrf54l15dk/nrf54l15/cpuapp/nu54dk
    integration_platforms:
      - nrf54l15dk/nrf54l15/cpuapp/nu54dk
```

## tests/zephyr/m21_ble_hil/testcase.yaml
```yaml
tests:
  nucode.m21.ble_security_hil_peripheral:
    tags:
      - nucode
      - arduino
      - m21
      - bluetooth
      - security
      - hid
      - hil
    build_only: true
    extra_args:
      - M21_ROLE=peripheral
    platform_allow:
      - nrf54l15dk/nrf54l15/cpuapp/nu54dk
    integration_platforms:
      - nrf54l15dk/nrf54l15/cpuapp/nu54dk
  nucode.m21.ble_security_hil_central:
    tags:
      - nucode
      - arduino
      - m21
      - bluetooth
      - security
      - hid
      - hil
    build_only: true
    extra_args:
      - M21_ROLE=central
    platform_allow:
      - nrf54l15dk/nrf54l15/cpuapp/nu54dk
    integration_platforms:
      - nrf54l15dk/nrf54l15/cpuapp/nu54dk
```

## tests/zephyr/m23_inventory_contract/testcase.yaml
```yaml
tests:
  nucode.m23.inventory_contract:
    tags:
      - nucode
      - arduino
      - m23
      - inventory
      - ownership
      - dma
    harness: ztest
    sysbuild: false
    platform_allow:
      - nrf54l15dk/nrf54l15/cpuapp/nu54dk
    integration_platforms:
      - nrf54l15dk/nrf54l15/cpuapp/nu54dk
```

## tests/zephyr/m24_serial_fabric_contract/testcase.yaml
```yaml
tests:
  nucode.m24.fabric:
    tags:
      - nucode
      - arduino
      - m24
      - serial-fabric
      - dma
    harness: ztest
    sysbuild: false
    platform_allow:
      - nrf54l15dk/nrf54l15/cpuapp/nu54dk
    integration_platforms:
      - nrf54l15dk/nrf54l15/cpuapp/nu54dk
```

## tests/zephyr/m24_spi_driver_contract/testcase.yaml
```yaml
tests:
  nucode.m24.spi:
    tags: [nucode, arduino, m24, spi, spim, spis]
    platform_allow: [nrf54l15dk/nrf54l15/cpuapp/nu54dk]
    build_only: true
```

## tests/zephyr/m24_twi_driver_contract/testcase.yaml
```yaml
tests:
  nucode.m24.twi:
    tags: [nucode, arduino, m24, i2c, twim, twis]
    platform_allow: [nrf54l15dk/nrf54l15/cpuapp/nu54dk]
    build_only: true
```

## tests/zephyr/m24_twim_onboard_hil/testcase.yaml
```yaml
tests:
  nucode.m24.twim20_hil:
    tags: [nucode, arduino, m24, twim, hil, onboard]
    platform_allow: [nrf54l15dk/nrf54l15/cpuapp/nu54dk]
    build_only: true
    extra_configs:
      - CONFIG_NUCODE_M24_TWIM_HIL_INSTANCE=20
  nucode.m24.twim21_hil:
    tags: [nucode, arduino, m24, twim, hil, onboard]
    platform_allow: [nrf54l15dk/nrf54l15/cpuapp/nu54dk]
    build_only: true
    extra_configs:
      - CONFIG_NUCODE_M24_TWIM_HIL_INSTANCE=21
  nucode.m24.twim22_hil:
    tags: [nucode, arduino, m24, twim, hil, onboard]
    platform_allow: [nrf54l15dk/nrf54l15/cpuapp/nu54dk]
    build_only: true
    extra_configs:
      - CONFIG_NUCODE_M24_TWIM_HIL_INSTANCE=22
```

## tests/zephyr/m24_uarte_driver_contract/testcase.yaml
```yaml
tests:
  nucode.m24.uarte:
    tags:
      - nucode
      - arduino
      - m24
      - uarte
    platform_allow:
      - nrf54l15dk/nrf54l15/cpuapp/nu54dk
    build_only: true
```

## tests/zephyr/m24_uarte_onboard_hil/testcase.yaml
```yaml
tests:
  nucode.m24.uarte20_hil:
    tags: [nucode, arduino, m24, uarte, hil]
    platform_allow: [nrf54l15dk/nrf54l15/cpuapp/nu54dk]
    build_only: true
    extra_configs:
      - CONFIG_NUCODE_M24_UARTE_HIL_INSTANCE=20
  nucode.m24.uarte21_hil:
    tags: [nucode, arduino, m24, uarte, hil]
    platform_allow: [nrf54l15dk/nrf54l15/cpuapp/nu54dk]
    build_only: true
    extra_configs:
      - CONFIG_NUCODE_M24_UARTE_HIL_INSTANCE=21
  nucode.m24.uarte22_hil:
    tags: [nucode, arduino, m24, uarte, hil]
    platform_allow: [nrf54l15dk/nrf54l15/cpuapp/nu54dk]
    build_only: true
    extra_configs:
      - CONFIG_NUCODE_M24_UARTE_HIL_INSTANCE=22
  nucode.m24.uarte30_hil:
    tags: [nucode, arduino, m24, uarte, hil]
    platform_allow: [nrf54l15dk/nrf54l15/cpuapp/nu54dk]
    build_only: true
    extra_configs:
      - CONFIG_NUCODE_M24_UARTE_HIL_INSTANCE=30
```

## tests/zephyr/m25_analog_fabric_contract/testcase.yaml
```yaml
tests:
  nucode.m25.analog:
    tags: [nucode, arduino, m25, saadc, pwm, dma]
    platform_allow: [nrf54l15dk/nrf54l15/cpuapp/nu54dk]
    build_only: true
```

## tests/zephyr/m25_event_fabric_contract/testcase.yaml
```yaml
tests:
  nucode.m25.event:
    tags: [nucode, arduino, m25, timer, gpiote, dppi, ppib]
    platform_allow: [nrf54l15dk/nrf54l15/cpuapp/nu54dk]
    build_only: true
```

## tests/zephyr/m25_onboard_hil/testcase.yaml
```yaml
tests:
  nucode.m25.onboard_hil:
    tags: [nucode, arduino, m25, analog, event, hil, onboard]
    platform_allow: [nrf54l15dk/nrf54l15/cpuapp/nu54dk]
    build_only: true
```

## tests/zephyr/m25_stream_fabric_contract/testcase.yaml
```yaml
tests:
  nucode.m25.stream:
    platform_allow:
      - nrf54l15dk/nrf54l15/cpuapp/nu54dk
    build_only: true
    tags:
      - nucode
      - m25
      - stream
      - pdm
      - i2s
      - qdec
```

## tests/zephyr/m26_onboard_hil/testcase.yaml
```yaml
tests:
  nucode.m26.onboard_hil:
    tags: [nucode, arduino, m26, system, temp, watchdog, hil, onboard]
    platform_allow: [nrf54l15dk/nrf54l15/cpuapp/nu54dk]
    build_only: true
```

## tests/zephyr/m26_system_fabric_contract/testcase.yaml
```yaml
tests:
  nucode.m26.system:
    tags: [nucode, arduino, m26, temp, watchdog]
    platform_allow: [nrf54l15dk/nrf54l15/cpuapp/nu54dk]
    build_only: true
```

## tests/zephyr/m28_ble_2board_hil/testcase.yaml
```yaml
tests:
  nucode.m28.b2p:
    tags:
      - nucode
      - arduino
      - m28
      - bluetooth
      - hil
    build_only: true
    extra_args:
      - M28_B2_ROLE=peripheral
    platform_allow:
      - nrf54l15dk/nrf54l15/cpuapp/nu54dk
    integration_platforms:
      - nrf54l15dk/nrf54l15/cpuapp/nu54dk
  nucode.m28.b2c:
    tags:
      - nucode
      - arduino
      - m28
      - bluetooth
      - hil
    build_only: true
    extra_args:
      - M28_B2_ROLE=central
    platform_allow:
      - nrf54l15dk/nrf54l15/cpuapp/nu54dk
    integration_platforms:
      - nrf54l15dk/nrf54l15/cpuapp/nu54dk
```

## tests/zephyr/m28_ble_3board_hil/testcase.yaml
```yaml
tests:
  nucode.m28.b3.link.peripheral:
    tags: [nucode, arduino, m28, bluetooth, hil]
    build_only: true
    extra_args: [M28_B3_TEST=link, M28_B3_ROLE=peripheral]
    platform_allow: [nrf54l15dk/nrf54l15/cpuapp/nu54dk]
    integration_platforms: [nrf54l15dk/nrf54l15/cpuapp/nu54dk]
  nucode.m28.b3.link.mixed:
    tags: [nucode, arduino, m28, bluetooth, hil]
    build_only: true
    extra_args: [M28_B3_TEST=link, M28_B3_ROLE=mixed]
    platform_allow: [nrf54l15dk/nrf54l15/cpuapp/nu54dk]
    integration_platforms: [nrf54l15dk/nrf54l15/cpuapp/nu54dk]
  nucode.m28.b3.link.central:
    tags: [nucode, arduino, m28, bluetooth, hil]
    build_only: true
    extra_args: [M28_B3_TEST=link, M28_B3_ROLE=central]
    platform_allow: [nrf54l15dk/nrf54l15/cpuapp/nu54dk]
    integration_platforms: [nrf54l15dk/nrf54l15/cpuapp/nu54dk]
  nucode.m28.b3.periodic.peripheral:
    tags: [nucode, arduino, m28, bluetooth, hil]
    build_only: true
    extra_args: [M28_B3_TEST=periodic, M28_B3_ROLE=peripheral]
    platform_allow: [nrf54l15dk/nrf54l15/cpuapp/nu54dk]
    integration_platforms: [nrf54l15dk/nrf54l15/cpuapp/nu54dk]
  nucode.m28.b3.periodic.mixed:
    tags: [nucode, arduino, m28, bluetooth, hil]
    build_only: true
    extra_args: [M28_B3_TEST=periodic, M28_B3_ROLE=mixed]
    platform_allow: [nrf54l15dk/nrf54l15/cpuapp/nu54dk]
    integration_platforms: [nrf54l15dk/nrf54l15/cpuapp/nu54dk]
  nucode.m28.b3.periodic.central:
    tags: [nucode, arduino, m28, bluetooth, hil]
    build_only: true
    extra_args: [M28_B3_TEST=periodic, M28_B3_ROLE=central]
    platform_allow: [nrf54l15dk/nrf54l15/cpuapp/nu54dk]
    integration_platforms: [nrf54l15dk/nrf54l15/cpuapp/nu54dk]
  nucode.m28.b3.control.peripheral:
    tags: [nucode, arduino, m28, bluetooth, hil]
    build_only: true
    extra_args: [M28_B3_TEST=control, M28_B3_ROLE=peripheral]
    platform_allow: [nrf54l15dk/nrf54l15/cpuapp/nu54dk]
    integration_platforms: [nrf54l15dk/nrf54l15/cpuapp/nu54dk]
  nucode.m28.b3.control.mixed:
    tags: [nucode, arduino, m28, bluetooth, hil]
    build_only: true
    extra_args: [M28_B3_TEST=control, M28_B3_ROLE=mixed]
    platform_allow: [nrf54l15dk/nrf54l15/cpuapp/nu54dk]
    integration_platforms: [nrf54l15dk/nrf54l15/cpuapp/nu54dk]
  nucode.m28.b3.control.central:
    tags: [nucode, arduino, m28, bluetooth, hil]
    build_only: true
    extra_args: [M28_B3_TEST=control, M28_B3_ROLE=central]
    platform_allow: [nrf54l15dk/nrf54l15/cpuapp/nu54dk]
    integration_platforms: [nrf54l15dk/nrf54l15/cpuapp/nu54dk]
  nucode.m28.b3.soak.peripheral:
    tags: [nucode, arduino, m28, bluetooth, hil]
    build_only: true
    extra_args: [M28_B3_TEST=soak, M28_B3_ROLE=peripheral]
    platform_allow: [nrf54l15dk/nrf54l15/cpuapp/nu54dk]
    integration_platforms: [nrf54l15dk/nrf54l15/cpuapp/nu54dk]
  nucode.m28.b3.soak.mixed:
    tags: [nucode, arduino, m28, bluetooth, hil]
    build_only: true
    extra_args: [M28_B3_TEST=soak, M28_B3_ROLE=mixed]
    platform_allow: [nrf54l15dk/nrf54l15/cpuapp/nu54dk]
    integration_platforms: [nrf54l15dk/nrf54l15/cpuapp/nu54dk]
  nucode.m28.b3.soak.central:
    tags: [nucode, arduino, m28, bluetooth, hil]
    build_only: true
    extra_args: [M28_B3_TEST=soak, M28_B3_ROLE=central]
    platform_allow: [nrf54l15dk/nrf54l15/cpuapp/nu54dk]
    integration_platforms: [nrf54l15dk/nrf54l15/cpuapp/nu54dk]
```

## tests/zephyr/m28_ble_capability/testcase.yaml
```yaml
tests:
  nucode.m28.ble_capability:
    tags:
      - nucode
      - arduino
      - m28
      - bluetooth
      - capability
      - hil
    build_only: true
    platform_allow:
      - nrf54l15dk/nrf54l15/cpuapp/nu54dk
    integration_platforms:
      - nrf54l15dk/nrf54l15/cpuapp/nu54dk
```

## tests/zephyr/m28_ble_extended_contract/testcase.yaml
```yaml
tests:
  nucode.m28.ble_extended_contract:
    tags:
      - nucode
      - arduino
      - m28
      - bluetooth
      - extended
    build_only: true
    sysbuild: false
    platform_allow:
      - nrf54l15dk/nrf54l15/cpuapp/nu54dk
    integration_platforms:
      - nrf54l15dk/nrf54l15/cpuapp/nu54dk
```

## tests/zephyr/m28_ble_link_contract/testcase.yaml
```yaml
tests:
  nucode.m28.ble_link_contract:
    tags:
      - nucode
      - arduino
      - m28
      - bluetooth
      - link
    build_only: true
    sysbuild: false
    platform_allow:
      - nrf54l15dk/nrf54l15/cpuapp/nu54dk
    integration_platforms:
      - nrf54l15dk/nrf54l15/cpuapp/nu54dk
```

## tests/zephyr/m28_ble_pawr_contract/testcase.yaml
```yaml
tests:
  nucode.m28.ble_pawr_contract:
    tags:
      - nucode
      - arduino
      - m28
      - bluetooth
      - pawr
    build_only: true
    sysbuild: false
    platform_allow:
      - nrf54l15dk/nrf54l15/cpuapp/nu54dk
    integration_platforms:
      - nrf54l15dk/nrf54l15/cpuapp/nu54dk
```

## tests/zephyr/m28_ble_periodic_contract/testcase.yaml
```yaml
tests:
  nucode.m28.ble_periodic_contract:
    tags:
      - nucode
      - arduino
      - m28
      - bluetooth
      - periodic
      - past
    build_only: true
    sysbuild: false
    platform_allow:
      - nrf54l15dk/nrf54l15/cpuapp/nu54dk
    integration_platforms:
      - nrf54l15dk/nrf54l15/cpuapp/nu54dk
```

## tests/zephyr/m28_ble_privacy_control_contract/testcase.yaml
```yaml
tests:
  nucode.m28.privacy_control:
    tags:
      - nucode
      - arduino
      - m28
      - bluetooth
      - privacy
    build_only: true
    sysbuild: false
    platform_allow:
      - nrf54l15dk/nrf54l15/cpuapp/nu54dk
    integration_platforms:
      - nrf54l15dk/nrf54l15/cpuapp/nu54dk
```

## tests/zephyr/m29_ble_cache_hil/testcase.yaml
```yaml
tests:
  nucode.m29.ble_cache_peripheral:
    tags:
      - nucode
      - arduino
      - m29
      - bluetooth
      - cache
      - hil
    build_only: true
    extra_args:
      - M29_CACHE_ROLE=peripheral
    platform_allow:
      - nrf54l15dk/nrf54l15/cpuapp/nu54dk
    integration_platforms:
      - nrf54l15dk/nrf54l15/cpuapp/nu54dk
  nucode.m29.ble_cache_central:
    tags:
      - nucode
      - arduino
      - m29
      - bluetooth
      - cache
      - hil
    build_only: true
    extra_args:
      - M29_CACHE_ROLE=central
    platform_allow:
      - nrf54l15dk/nrf54l15/cpuapp/nu54dk
    integration_platforms:
      - nrf54l15dk/nrf54l15/cpuapp/nu54dk
```
