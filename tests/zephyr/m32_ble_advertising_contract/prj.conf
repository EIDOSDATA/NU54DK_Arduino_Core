## CMakeLists.txt
```
# SPDX-License-Identifier: MIT

cmake_minimum_required(VERSION 3.20.0)

find_package(Zephyr REQUIRED HINTS $ENV{ZEPHYR_BASE})
project(nucode_m32_ble_advertising_contract)

get_filename_component(NUCODE_ROOT "${CMAKE_CURRENT_LIST_DIR}/../../.." ABSOLUTE)
target_sources(app PRIVATE
    src/main.cpp
    "${NUCODE_ROOT}/libraries/NUCODE_BLE/src/NUCODE_BLE_GAP.cpp"
    "${NUCODE_ROOT}/libraries/NUCODE_BLE/src/internal/gap/GapValues.cpp"
    "${NUCODE_ROOT}/libraries/NUCODE_BLE/src/internal/gap/GapAdvertising.cpp"
    "${NUCODE_ROOT}/libraries/NUCODE_BLE/src/internal/gap/GapExtendedAdvertising.cpp"
    "${NUCODE_ROOT}/libraries/NUCODE_BLE/src/internal/gap/GapPeriodicAdvertising.cpp"
    "${NUCODE_ROOT}/libraries/NUCODE_BLE/src/internal/gap/GapPawr.cpp"
    "${NUCODE_ROOT}/libraries/NUCODE_BLE/src/internal/gap/GapScanning.cpp"
    "${NUCODE_ROOT}/libraries/NUCODE_BLE/src/internal/gap/GapConnection.cpp"
    "${NUCODE_ROOT}/libraries/NUCODE_BLE/src/internal/NUCODE_BLE_Stack.cpp"
)
target_include_directories(app PRIVATE
    "${NUCODE_ROOT}/libraries/NUCODE_BLE/src"
)
```

## prj.conf
```kconfig
# SPDX-License-Identifier: MIT

CONFIG_CPP=y
CONFIG_STD_CPP17=y
CONFIG_CPP_EXCEPTIONS=n
CONFIG_CPP_RTTI=n

CONFIG_NUCODE_ARDUINO_CORE=y
CONFIG_NUCODE_ARDUINO_RUNTIME=n
CONFIG_NUCODE_ARDUINO_API=y
CONFIG_NUCODE_ARDUINO_GPIO=n
CONFIG_NUCODE_ARDUINO_INTERRUPTS=n
CONFIG_NUCODE_ARDUINO_TIME=n
CONFIG_NUCODE_ARDUINO_SERIAL=n
CONFIG_NUCODE_ARDUINO_WIRE=n
CONFIG_NUCODE_ARDUINO_SPI=n
CONFIG_NUCODE_ARDUINO_ADC=n
CONFIG_NUCODE_ARDUINO_PWM=n

CONFIG_BT=y
CONFIG_BT_PERIPHERAL=y
CONFIG_BT_CENTRAL=y
CONFIG_BT_OBSERVER=y
CONFIG_BT_MAX_CONN=2
CONFIG_BT_CTLR_SDC_PERIPHERAL_COUNT=1
CONFIG_BT_DEVICE_NAME_DYNAMIC=y
CONFIG_BT_DEVICE_NAME_MAX=32
CONFIG_BT_EXT_ADV=y
CONFIG_BT_EXT_ADV_MAX_ADV_SET=3
CONFIG_BT_CTLR_ADV_DATA_LEN_MAX=255
CONFIG_BT_EXT_SCAN_BUF_SIZE=255
CONFIG_BT_ID_MAX=3
CONFIG_BT_PRIVACY=y
CONFIG_BT_SMP=y
CONFIG_BT_FILTER_ACCEPT_LIST=y
CONFIG_BT_PER_ADV=y
CONFIG_BT_PER_ADV_SYNC=y
CONFIG_BT_PER_ADV_SYNC_MAX=2
CONFIG_BT_CTLR_SYNC_PERIODIC_ADV_LIST_SIZE=2
CONFIG_BT_CTLR_PHY_CODED=y
CONFIG_BT_EXT_ADV_CODING_SELECTION=y
CONFIG_BT_EAD=y

CONFIG_NUCODE_BLE_CORE=y
CONFIG_NUCODE_BLE_CORE_EVENT_QUEUE_SIZE=24
CONFIG_NUCODE_BLE_SCAN_RESULT_QUEUE_SIZE=8
CONFIG_NUCODE_BLE_PERIODIC_REPORT_QUEUE_SIZE=8
CONFIG_HEAP_MEM_POOL_SIZE=4096
CONFIG_SYSTEM_WORKQUEUE_STACK_SIZE=2048
CONFIG_COMMON_LIBC_MALLOC_ARENA_SIZE=8192
```

## src/main.cpp
```c
/**
 * @file main.cpp
 * @brief M32 advertising·identity·list·EAD 공개 API의 target link 계약입니다.
 *
 * SPDX-License-Identifier: MIT
 */

#include <NUCODE_BLE_GAP.h>

#include <cstdint>

static_assert(CONFIG_BT_EXT_ADV_MAX_ADV_SET == 3);
static_assert(CONFIG_BT_ID_MAX == 3);
static_assert(CONFIG_BT_EXT_ADV_CODING_SELECTION == 1);
static_assert(CONFIG_BT_EAD == 1);
static_assert(nucode::ble::ExtendedAdvertising::product_maximum_sets == 3U);
static_assert(nucode::ble::Identity::product_maximum_identities == 3U);
static_assert(nucode::ble::EncryptedAdvertisingData::maximum_plaintext_length == 246U);

int main()
{
    nucode::ble::BLEExtendedAdvertisingParameters parameters;
    nucode::ble::BLEAdvertisingSetHandle advertising_set;
    nucode::ble::BLEAddress address;
    nucode::ble::EncryptedAdvertisingData ead;
    std::uint8_t identity = 0U;
    std::uint8_t key[nucode::ble::EncryptedAdvertisingData::session_key_length] = {};
    std::uint8_t iv[nucode::ble::EncryptedAdvertisingData::initialization_vector_length] = {};
    std::uint8_t plaintext[4] = {2U, 0xffU, 1U, 0U};
    std::uint8_t encrypted[32] = {};
    std::uint8_t decrypted[sizeof(plaintext)] = {};
    std::size_t encrypted_length = 0U;
    std::size_t decrypted_length = 0U;

    parameters.identity = 1U;
    parameters.sid = 1U;
    parameters.coded = true;
    parameters.coding = nucode::ble::BLEAdvertisingCoding::s8;
    parameters.filter_scan_requests = true;
    static_cast<void>(BLEExtendedAdvertising.create(parameters, advertising_set));
    static_cast<void>(BLEIdentity.count());
    static_cast<void>(BLEIdentity.address(identity, address));
    static_cast<void>(BLEIdentity.create(identity, address));
    static_cast<void>(BLEIdentity.reset(identity, address));
    static_cast<void>(BLEIdentity.remove(identity));
    static_cast<void>(BLEAdvertisingLists.filterAcceptCapacity());
    static_cast<void>(BLEAdvertisingLists.resolvingCapacity());
    static_cast<void>(BLEAdvertisingLists.periodicAdvertiserCapacity());
    static_cast<void>(BLEAdvertisingLists.addFilterAccept(address));
    static_cast<void>(BLEAdvertisingLists.removeFilterAccept(address));
    static_cast<void>(BLEAdvertisingLists.clearFilterAccept());
    static_cast<void>(BLEAdvertisingLists.addPeriodicAdvertiser(address, 1U));
    static_cast<void>(BLEAdvertisingLists.removePeriodicAdvertiser(address, 1U));
    static_cast<void>(BLEAdvertisingLists.clearPeriodicAdvertisers());
    static_cast<void>(ead.configure(key, iv));
    static_cast<void>(ead.encrypt(plaintext, sizeof(plaintext), encrypted,
                                  sizeof(encrypted), encrypted_length));
    static_cast<void>(ead.decrypt(encrypted, encrypted_length, decrypted,
                                  sizeof(decrypted), decrypted_length));
    ead.clear();
    return 0;
}
```
