## CMakeLists.txt
```
# SPDX-License-Identifier: MIT

cmake_minimum_required(VERSION 3.20.0)

find_package(Zephyr REQUIRED HINTS $ENV{ZEPHYR_BASE})
project(nucode_m28_ble_pawr_contract)

get_filename_component(NUCODE_ROOT "${CMAKE_CURRENT_LIST_DIR}/../../.." ABSOLUTE)
target_sources(app PRIVATE
  src/main.cpp
  "${NUCODE_ROOT}/libraries/NUCODE_BLE/src/NUCODE_BLE_GAP.cpp"
  "${NUCODE_ROOT}/libraries/NUCODE_BLE/src/internal/gap/GapValues.cpp"
  "${NUCODE_ROOT}/libraries/NUCODE_BLE/src/internal/gap/GapAdvertising.cpp"
  "${NUCODE_ROOT}/libraries/NUCODE_BLE/src/internal/gap/GapExtendedAdvertising.cpp"
  "${NUCODE_ROOT}/libraries/NUCODE_BLE/src/internal/gap/GapPeriodicAdvertising.cpp"
  "${NUCODE_ROOT}/libraries/NUCODE_BLE/src/internal/gap/GapPawr.cpp"
  "${NUCODE_ROOT}/libraries/NUCODE_BLE/src/internal/gap/GapScanning.cpp"
  "${NUCODE_ROOT}/libraries/NUCODE_BLE/src/internal/gap/GapConnection.cpp"
  "${NUCODE_ROOT}/libraries/NUCODE_BLE/src/internal/NUCODE_BLE_Stack.cpp"
)
target_include_directories(app PRIVATE
  "${NUCODE_ROOT}/libraries/NUCODE_BLE/src"
)
```

## prj.conf
```kconfig
# SPDX-License-Identifier: MIT

CONFIG_CPP=y
CONFIG_STD_CPP17=y
CONFIG_CPP_EXCEPTIONS=n
CONFIG_CPP_RTTI=n

CONFIG_NUCODE_ARDUINO_CORE=y
CONFIG_NUCODE_ARDUINO_RUNTIME=n
CONFIG_NUCODE_ARDUINO_API=y
CONFIG_NUCODE_ARDUINO_GPIO=n
CONFIG_NUCODE_ARDUINO_INTERRUPTS=n
CONFIG_NUCODE_ARDUINO_TIME=n
CONFIG_NUCODE_ARDUINO_SERIAL=n
CONFIG_NUCODE_ARDUINO_WIRE=n
CONFIG_NUCODE_ARDUINO_SPI=n
CONFIG_NUCODE_ARDUINO_ADC=n
CONFIG_NUCODE_ARDUINO_PWM=n

CONFIG_BT=y
CONFIG_BT_PERIPHERAL=y
CONFIG_BT_CENTRAL=y
CONFIG_BT_OBSERVER=y
CONFIG_BT_MAX_CONN=2
CONFIG_BT_CTLR_SDC_PERIPHERAL_COUNT=1
CONFIG_BT_DEVICE_NAME_DYNAMIC=y
CONFIG_BT_DEVICE_NAME_MAX=32
CONFIG_BT_EXT_ADV=y
CONFIG_BT_EXT_ADV_MAX_ADV_SET=1
CONFIG_BT_CTLR_ADV_DATA_LEN_MAX=255
CONFIG_BT_PER_ADV=y
CONFIG_BT_PER_ADV_SYNC=y
CONFIG_BT_PER_ADV_SYNC_MAX=1
CONFIG_BT_CTLR_SYNC_PERIODIC_ADV_LIST_SIZE=1
CONFIG_BT_PER_ADV_SYNC_TRANSFER_RECEIVER=y
CONFIG_BT_PER_ADV_SYNC_TRANSFER_SENDER=y
CONFIG_BT_PER_ADV_RSP=y
CONFIG_BT_PER_ADV_SYNC_RSP=y
CONFIG_BT_CTLR_SDC_PAWR_ADV=y
CONFIG_BT_CTLR_SDC_PAWR_ADV_COUNT=1
CONFIG_BT_CTLR_SDC_PERIODIC_ADV_RSP_TX_BUFFER_COUNT=4
CONFIG_BT_CTLR_SDC_PERIODIC_ADV_RSP_TX_MAX_DATA_SIZE=249
CONFIG_BT_CTLR_SDC_PERIODIC_ADV_RSP_RX_BUFFER_COUNT=4
CONFIG_BT_CTLR_SDC_PAWR_SYNC=y
CONFIG_BT_CTLR_SDC_PERIODIC_SYNC_RSP_TX_BUFFER_COUNT=4
CONFIG_BT_USER_PHY_UPDATE=y
CONFIG_BT_AUTO_PHY_CENTRAL_NONE=y
CONFIG_BT_AUTO_PHY_PERIPHERAL_NONE=y

CONFIG_NUCODE_BLE_CORE=y
CONFIG_NUCODE_BLE_CORE_EVENT_QUEUE_SIZE=24
CONFIG_NUCODE_BLE_SCAN_RESULT_QUEUE_SIZE=8
CONFIG_NUCODE_BLE_PERIODIC_REPORT_QUEUE_SIZE=8
CONFIG_NUCODE_BLE_PAWR_RESPONSE_QUEUE_SIZE=8
CONFIG_HEAP_MEM_POOL_SIZE=4096
CONFIG_SYSTEM_WORKQUEUE_STACK_SIZE=2048
CONFIG_COMMON_LIBC_MALLOC_ARENA_SIZE=8192
```

## src/main.cpp
```c
/**
 * @file main.cpp
 * @brief M28-W05 PAwR advertiser·scanner 공개 API의 target 계약입니다.
 *
 * SPDX-License-Identifier: MIT
 */

#include <NUCODE_BLE_GAP.h>

static_assert(CONFIG_BT_PER_ADV_RSP == 1);
static_assert(CONFIG_BT_PER_ADV_SYNC_RSP == 1);
static_assert(CONFIG_BT_CTLR_SDC_PAWR_ADV_COUNT == 1);
static_assert(CONFIG_BT_CTLR_SDC_PERIODIC_ADV_RSP_TX_BUFFER_COUNT == 4);
static_assert(CONFIG_BT_CTLR_SDC_PERIODIC_ADV_RSP_TX_MAX_DATA_SIZE == 249);
static_assert(CONFIG_BT_CTLR_SDC_PERIODIC_ADV_RSP_RX_BUFFER_COUNT == 4);
static_assert(nucode::ble::Pawr::maximum_subevents == 4U);
static_assert(nucode::ble::Pawr::maximum_response_slots == 4U);
static_assert(nucode::ble::Pawr::maximum_payload_length == 249U);

int main()
{
    nucode::ble::BLEAdvertisingSetHandle advertising_set;
    nucode::ble::BLEPeriodicSyncHandle sync;
    nucode::ble::BLEPawrAdvertisingParameters parameters{};
    nucode::ble::BLEPawrResponse response{};
    const std::uint8_t subevents[] = {0U, 1U, 2U, 3U};
    std::uint8_t payload[249]{};

    static_cast<void>(BLEPawr.configureAdvertiser(advertising_set, parameters));
    static_cast<void>(BLEPawr.setSubeventData(advertising_set, 0U, payload,
                                             sizeof(payload)));
    static_cast<void>(BLEPawr.configureScanner(sync, subevents, sizeof(subevents)));
    static_cast<void>(BLEPawr.sendResponse(sync, 1U, 0U, 0U, 0U, payload,
                                          sizeof(payload)));
    static_cast<void>(BLEPawr.available());
    static_cast<void>(BLEPawr.read(response));
    static_cast<void>(BLEPawr.droppedResponses());
    return 0;
}
```
