## CMakeLists.txt
```
# SPDX-License-Identifier: MIT

cmake_minimum_required(VERSION 3.20.0)

find_package(Zephyr REQUIRED HINTS $ENV{ZEPHYR_BASE})
project(nucode_m32_esb_contract)

get_filename_component(NUCODE_ROOT "${CMAKE_CURRENT_LIST_DIR}/../../.." ABSOLUTE)
target_sources(app PRIVATE
    src/main.cpp
    "${NUCODE_ROOT}/libraries/NUCODE_Radio_ESB/src/NUCODE_Radio_ESB.cpp"
)
target_include_directories(app PRIVATE
    "${NUCODE_ROOT}/libraries/NUCODE_Radio_ESB/src"
)
```

## prj.conf
```kconfig
# SPDX-License-Identifier: MIT

CONFIG_CPP=y
CONFIG_STD_CPP17=y
CONFIG_CPP_EXCEPTIONS=n
CONFIG_CPP_RTTI=n
CONFIG_NUCODE_ARDUINO_CORE=y
CONFIG_NUCODE_ARDUINO_RUNTIME=n
CONFIG_NUCODE_ARDUINO_API=y
CONFIG_NUCODE_ARDUINO_GPIO=n
CONFIG_NUCODE_ARDUINO_INTERRUPTS=n
CONFIG_NUCODE_ARDUINO_TIME=n
CONFIG_NUCODE_ARDUINO_SERIAL=n
CONFIG_NUCODE_ARDUINO_WIRE=n
CONFIG_NUCODE_ARDUINO_SPI=n
CONFIG_NUCODE_ARDUINO_ADC=n
CONFIG_NUCODE_ARDUINO_PWM=n
CONFIG_NUCODE_RADIO_ESB=y
CONFIG_ESB=y
CONFIG_ESB_MAX_PAYLOAD_LENGTH=32
CONFIG_CLOCK_CONTROL=y
CONFIG_ESB_CLOCK_INIT=y
```

## src/main.cpp
```c
/**
 * @file main.cpp
 * @brief M32-W09 ESB 공개 API target compile 계약입니다.
 *
 * SPDX-License-Identifier: MIT
 */

#include <NUCODE_Radio_ESB.h>

/** @brief 공개 구조와 bounded lifecycle signature를 target compiler로 확인합니다. */
int main()
{
    nucode::esb::Configuration configuration{};
    nucode::esb::Packet packet{};
    const std::uint8_t payload[] = {0x45U, 0x53U};
    volatile bool execute_contract = false;
    if (execute_contract)
    {
        static_cast<void>(NUCODEEsb.begin(nucode::esb::Role::primary_transmitter,
                                          configuration));
        static_cast<void>(NUCODEEsb.send(1U, payload, sizeof(payload)));
        static_cast<void>(NUCODEEsb.available());
        static_cast<void>(NUCODEEsb.read(packet));
        static_cast<void>(NUCODEEsb.cancel());
        static_cast<void>(NUCODEEsb.busy());
        static_cast<void>(NUCODEEsb.statistics());
        static_cast<void>(NUCODEEsb.lastError());
        static_cast<void>(NUCODEEsb.lastDriverError());
        static_cast<void>(NUCODEEsb.stop());
    }
    return 0;
}
```
