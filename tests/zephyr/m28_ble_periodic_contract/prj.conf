## CMakeLists.txt
```
# SPDX-License-Identifier: MIT

cmake_minimum_required(VERSION 3.20.0)

find_package(Zephyr REQUIRED HINTS $ENV{ZEPHYR_BASE})
project(nucode_m28_ble_periodic_contract)

get_filename_component(NUCODE_ROOT "${CMAKE_CURRENT_LIST_DIR}/../../.." ABSOLUTE)
target_sources(app PRIVATE
  src/main.cpp
  "${NUCODE_ROOT}/libraries/NUCODE_BLE/src/NUCODE_BLE_GAP.cpp"
  "${NUCODE_ROOT}/libraries/NUCODE_BLE/src/internal/gap/GapValues.cpp"
  "${NUCODE_ROOT}/libraries/NUCODE_BLE/src/internal/gap/GapAdvertising.cpp"
  "${NUCODE_ROOT}/libraries/NUCODE_BLE/src/internal/gap/GapExtendedAdvertising.cpp"
  "${NUCODE_ROOT}/libraries/NUCODE_BLE/src/internal/gap/GapPeriodicAdvertising.cpp"
  "${NUCODE_ROOT}/libraries/NUCODE_BLE/src/internal/gap/GapPawr.cpp"
  "${NUCODE_ROOT}/libraries/NUCODE_BLE/src/internal/gap/GapScanning.cpp"
  "${NUCODE_ROOT}/libraries/NUCODE_BLE/src/internal/gap/GapConnection.cpp"
  "${NUCODE_ROOT}/libraries/NUCODE_BLE/src/internal/NUCODE_BLE_Stack.cpp"
)
target_include_directories(app PRIVATE
  "${NUCODE_ROOT}/libraries/NUCODE_BLE/src"
)
```

## prj.conf
```kconfig
# SPDX-License-Identifier: MIT

CONFIG_CPP=y
CONFIG_STD_CPP17=y
CONFIG_CPP_EXCEPTIONS=n
CONFIG_CPP_RTTI=n

CONFIG_NUCODE_ARDUINO_CORE=y
CONFIG_NUCODE_ARDUINO_RUNTIME=n
CONFIG_NUCODE_ARDUINO_API=y
CONFIG_NUCODE_ARDUINO_GPIO=n
CONFIG_NUCODE_ARDUINO_INTERRUPTS=n
CONFIG_NUCODE_ARDUINO_TIME=n
CONFIG_NUCODE_ARDUINO_SERIAL=n
CONFIG_NUCODE_ARDUINO_WIRE=n
CONFIG_NUCODE_ARDUINO_SPI=n
CONFIG_NUCODE_ARDUINO_ADC=n
CONFIG_NUCODE_ARDUINO_PWM=n

CONFIG_BT=y
CONFIG_BT_PERIPHERAL=y
CONFIG_BT_CENTRAL=y
CONFIG_BT_OBSERVER=y
CONFIG_BT_MAX_CONN=2
CONFIG_BT_CTLR_SDC_PERIPHERAL_COUNT=1
CONFIG_BT_DEVICE_NAME_DYNAMIC=y
CONFIG_BT_DEVICE_NAME_MAX=32
CONFIG_BT_EXT_ADV=y
CONFIG_BT_EXT_ADV_MAX_ADV_SET=1
CONFIG_BT_CTLR_ADV_DATA_LEN_MAX=255
CONFIG_BT_PER_ADV=y
CONFIG_BT_PER_ADV_SYNC=y
CONFIG_BT_PER_ADV_SYNC_MAX=1
CONFIG_BT_CTLR_SYNC_PERIODIC_ADV_LIST_SIZE=1
CONFIG_BT_PER_ADV_SYNC_TRANSFER_RECEIVER=y
CONFIG_BT_PER_ADV_SYNC_TRANSFER_SENDER=y
CONFIG_BT_USER_PHY_UPDATE=y
CONFIG_BT_AUTO_PHY_CENTRAL_NONE=y
CONFIG_BT_AUTO_PHY_PERIPHERAL_NONE=y

CONFIG_NUCODE_BLE_CORE=y
CONFIG_NUCODE_BLE_CORE_EVENT_QUEUE_SIZE=24
CONFIG_NUCODE_BLE_SCAN_RESULT_QUEUE_SIZE=8
CONFIG_NUCODE_BLE_PERIODIC_REPORT_QUEUE_SIZE=8
CONFIG_HEAP_MEM_POOL_SIZE=4096
CONFIG_SYSTEM_WORKQUEUE_STACK_SIZE=2048
CONFIG_COMMON_LIBC_MALLOC_ARENA_SIZE=8192
```

## src/main.cpp
```c
/**
 * @file main.cpp
 * @brief M28-W04 periodic advertising·sync·PAST 공개 API의 target 계약입니다.
 *
 * SPDX-License-Identifier: MIT
 */

#include <NUCODE_BLE_GAP.h>

static_assert(CONFIG_BT_PER_ADV == 1);
static_assert(CONFIG_BT_PER_ADV_SYNC == 1);
static_assert(CONFIG_BT_PER_ADV_SYNC_MAX == 1);
static_assert(CONFIG_BT_PER_ADV_SYNC_TRANSFER_RECEIVER == 1);
static_assert(CONFIG_BT_PER_ADV_SYNC_TRANSFER_SENDER == 1);
static_assert(nucode::ble::PeriodicAdvertising::maximum_payload_length == 255U);
static_assert(nucode::ble::BLEPeriodicReport::maximum_payload_length == 255U);

int main()
{
    nucode::ble::BLEAdvertisingSetHandle advertising_set;
    nucode::ble::BLEPeriodicSyncHandle sync;
    nucode::ble::BLEConnectionHandle connection;
    nucode::ble::BLEPeriodicAdvertisingParameters parameters{};
    nucode::ble::BLEPeriodicReport report{};
    const nucode::ble::BLEAddress address(
        "01:02:03:04:05:06", nucode::ble::BLEAddress::Type::public_address);
    std::uint8_t payload[255]{};
    payload[0] = 254U;
    payload[1] = 0xffU;

    static_cast<void>(BLEPeriodicAdvertising.configure(advertising_set, parameters));
    static_cast<void>(BLEPeriodicAdvertising.setData(advertising_set, payload,
                                                     sizeof(payload)));
    static_cast<void>(BLEPeriodicAdvertising.start(advertising_set));
    static_cast<void>(BLEPeriodicAdvertising.running(advertising_set));
    static_cast<void>(BLEPeriodicAdvertising.stop(advertising_set));
    static_cast<void>(BLEPeriodicAdvertising.createSync(address, 1U, sync));
    static_cast<void>(BLEPeriodicAdvertising.exists(sync));
    static_cast<void>(BLEPeriodicAdvertising.synchronized(sync));
    static_cast<void>(BLEPeriodicAdvertising.available());
    static_cast<void>(BLEPeriodicAdvertising.read(report));
    static_cast<void>(BLEPeriodicAdvertising.transferSync(sync, connection));
    static_cast<void>(BLEPeriodicAdvertising.transferSet(advertising_set, connection));
    static_cast<void>(BLEPeriodicAdvertising.subscribeTransfers(connection));
    static_cast<void>(BLEPeriodicAdvertising.unsubscribeTransfers(connection));
    static_cast<void>(BLEPeriodicAdvertising.deleteSync(sync));
    return 0;
}
```
