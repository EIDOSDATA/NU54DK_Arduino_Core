## CMakeLists.txt
```
cmake_minimum_required(VERSION 3.20.0)
find_package(Zephyr REQUIRED HINTS $ENV{ZEPHYR_BASE})
project(m25_nojumper_hil LANGUAGES C CXX)
include(${CMAKE_CURRENT_SOURCE_DIR}/../v04_pair_hil/read_revision.cmake)
nucode_hil_revision("${CMAKE_CURRENT_SOURCE_DIR}/../../.." HIL_REVISION)
target_compile_definitions(app PRIVATE NUCODE_HIL_CORE_REVISION="${HIL_REVISION}")
target_sources(app PRIVATE src/main.cpp)
```

## prj.conf
```kconfig
CONFIG_CPP=y
CONFIG_STD_CPP17=y
CONFIG_CPP_EXCEPTIONS=n
CONFIG_CPP_RTTI=n
CONFIG_CONSOLE=n
CONFIG_SERIAL=n
CONFIG_PRINTK=n
CONFIG_LOG=n
CONFIG_ADC=n
CONFIG_PWM=n
CONFIG_NUCODE_ARDUINO_CORE=y
CONFIG_NUCODE_ARDUINO_RUNTIME=n
CONFIG_NUCODE_ARDUINO_API=y
CONFIG_NUCODE_ARDUINO_IO_OWNERSHIP=y
CONFIG_NUCODE_ARDUINO_IO_RESOURCE_SLOTS=128
CONFIG_NUCODE_ARDUINO_GPIO=y
CONFIG_NUCODE_ARDUINO_CONNECTOR_GPIO=y
CONFIG_NUCODE_ARDUINO_INTERRUPTS=n
CONFIG_NUCODE_ARDUINO_TIME=y
CONFIG_NUCODE_ARDUINO_SERIAL=n
CONFIG_NUCODE_ARDUINO_WIRE=n
CONFIG_NUCODE_ARDUINO_SPI=n
CONFIG_NUCODE_ARDUINO_ADC=n
CONFIG_NUCODE_ARDUINO_PWM=n
CONFIG_NUCODE_ARDUINO_ANALOG_FABRIC=y
CONFIG_NUCODE_ARDUINO_EVENT_FABRIC=y
CONFIG_MAIN_STACK_SIZE=8192
```

## app.overlay
```dts
/** @brief 보드 간 점퍼 없이 사용하는 canonical pin map입니다. */
#include <nucode/nu54dk-arduino-pins.dtsi>
```

## src/main.cpp
```c
/**
 * @file
 * @brief SWD 명령으로 무점퍼 PWM의 준비 취소·시작·정지·자원 반환을 검증합니다.
 * SPDX-License-Identifier: MIT
 */
#include <nucode/AnalogFabric.h>
#include <nucode/EventFabric.h>
#include <internal/IoResourceManager.h>
#include <internal/pin_description.h>
#include <hal/nrf_pwm.h>
#include <variant.h>
#include <zephyr/kernel.h>
#include <cstdint>

extern "C"
{
    /** @brief exact ELF에서 찾는 mailbox입니다. request/response의 sequence는 마지막에 게시합니다. */
    volatile std::uint32_t nojumper_request[8]{};
    volatile std::uint32_t nojumper_response[32]{};
    volatile std::uint32_t nojumper_ready[4]{};
    alignas(4) volatile char nojumper_revision[41] = NUCODE_HIL_CORE_REVISION;
}

namespace
{
    using namespace nucode::arduino;
    using namespace nucode::arduino::internal;
    constexpr std::uint32_t magic = 0x4E4A5031U;
    constexpr std::uint32_t guard = 0xD65A91C3U;
    struct GuardedSequence
    {
        std::uint32_t before[4];
        std::uint16_t values[8];
        std::uint32_t after[4];
    };
    alignas(4) GuardedSequence sequences[2]{};

    /** @brief 초기화 시점만 buffer를 쓰며 DMA 구간에서는 guard와 원본을 변경하지 않습니다. */
    void prepareSequences(std::uint32_t top)
    {
        for (auto &sequence : sequences)
        {
            for (unsigned index = 0U; index < 4U; ++index)
            {
                sequence.before[index] = guard;
                sequence.after[index] = guard;
            }
            for (unsigned index = 0U; index < 8U; ++index)
            {
                sequence.values[index] =
                    static_cast<std::uint16_t>(index % 4U == 3U ? top : (0x8000U | (top / 2U)));
            }
        }
    }

    bool guardsValid()
    {
        for (const auto &sequence : sequences)
        {
            for (unsigned index = 0U; index < 4U; ++index)
            {
                if (sequence.before[index] != guard || sequence.after[index] != guard)
                {
                    return false;
                }
            }
        }
        return true;
    }

    bool resourceFree(const IoResourceId &id)
    {
        IoResourceSnapshot snapshot{};
        return ioResourceSnapshot(id, snapshot) == IoResourceResult::success &&
               snapshot.state == IoResourceState::free;
    }

    /** @brief P1.14 한 출력만 사용하며 보드 간 신호·DAP UART·공유 ADC 핀을 구동하지 않습니다. */
    void exercisePwm(const std::uint32_t *request, std::uint32_t *result)
    {
        const auto instance = static_cast<std::uint8_t>(request[3]);
        const auto flags = request[4];
        const auto load = request[5];
        const auto top = request[6];
        const auto repetitions = request[7];
        if (request[3] < 20U || request[3] > 22U || flags > 63U || load > 3U ||
            (top != 1000U && top != 4000U) || repetitions == 0U || repetitions > 100U ||
            ((flags & 32U) != 0U && (flags & 1U) == 0U))
        {
            result[2] = 1U;
            return;
        }
        NRF_PWM_Type *const registers = instance == 20U   ? NRF_PWM20
                                        : instance == 21U ? NRF_PWM21
                                                          : NRF_PWM22;
        auto *const pwm = analogFabric().pwm(instance);
        auto *const egu = eventFabric().egu(20U);
        auto *const dppi = eventFabric().dppi(20U);
        const auto gpio = pinDescription(PIN_P1_14)->gpio;
        const std::uint32_t pin_before = NRF_P1->PIN_CNF[14];
        const bool out_before = (NRF_P1->OUT & (1UL << 14U)) != 0U;
        prepareSequences(top);
        const PwmSequenceBuffer first{sequences[0].values, 8U, 0U, 0U};
        const PwmSequenceBuffer second{sequences[1].values, 8U, 0U, 0U};
        for (std::uint32_t run = 0U; run < repetitions; ++run)
        {
            PwmSequenceConfiguration configuration{};
            configuration.output_pins[0] = PIN_P1_14;
            configuration.load = static_cast<PwmSequenceLoad>(load);
            configuration.top_value = static_cast<std::uint16_t>(top);
            configuration.triggered_step = (flags & 8U) != 0U;
            result[8] = static_cast<std::uint32_t>(pwm->configure(configuration));
            if (result[8] != 0U)
            {
                result[2] = 2U;
                break;
            }
            registers->EVENTS_PWMPERIODEND = 0U;
            result[9] =
                static_cast<std::uint32_t>(pwm->play(first, (flags & 4U) != 0U ? &second : nullptr,
                                                     1U, (flags & 16U) != 0U, (flags & 1U) != 0U));
            if (result[9] != 0U)
            {
                result[2] = 3U;
                break;
            }
            bool dppi_acquired = false;
            bool egu_acquired = false;
            bool event_ok = true;
            if ((flags & 32U) != 0U)
            {
                egu_acquired = egu->acquire(0U) == EventFabricResult::success;
                dppi_acquired = dppi->acquireChannel(0U) == EventFabricResult::success;
                event_ok = egu_acquired && dppi_acquired;
                const EventEndpoint subscriber{pwm->startTaskAddress(), 20U,
                                               EventEndpointRole::subscriber};
                event_ok =
                    event_ok &&
                    dppi->connect(egu->event(0U), subscriber, 0U) == EventFabricResult::success &&
                    dppi->enable(0U) == EventFabricResult::success;
                if (event_ok)
                {
                    result[22] = static_cast<std::uint32_t>(pwm->stop(1000U));
                    event_ok = result[22] ==
                               static_cast<std::uint32_t>(AnalogFabricResult::ownership_conflict);
                }
                if (event_ok && (flags & 2U) != 0U)
                {
                    event_ok = egu->trigger(0U) == EventFabricResult::success;
                }
                k_busy_wait(2000U);
                if (dppi_acquired)
                {
                    event_ok &= dppi->releaseChannel(0U) == EventFabricResult::success;
                }
                if (egu_acquired)
                {
                    event_ok &= egu->release(0U) == EventFabricResult::success;
                }
            }
            else if ((flags & 3U) == 3U)
            {
                *reinterpret_cast<volatile std::uint32_t *>(pwm->startTaskAddress()) = 1U;
            }
            k_busy_wait(2000U);
            if (configuration.triggered_step && ((flags & 1U) == 0U || (flags & 2U) != 0U))
            {
                event_ok &= pwm->step() == AnalogFabricResult::success;
            }
            result[12] = registers->EVENTS_DMA.SEQ[0].READY;
            result[13] = registers->EVENTS_DMA.SEQ[1].READY;
            result[14] = registers->EVENTS_SEQSTARTED[0];
            result[15] = registers->EVENTS_SEQSTARTED[1];
            result[16] = registers->EVENTS_PWMPERIODEND;
            const auto start = k_cycle_get_32();
            result[10] = static_cast<std::uint32_t>(pwm->stop(100000U));
            result[23] = k_cyc_to_us_floor32(k_cycle_get_32() - start);
            result[11] = static_cast<std::uint32_t>(pwm->state());
            result[17] = registers->ENABLE;
            result[19] = guardsValid() ? 1U : 0U;
            result[20] = resourceFree(peripheralIoResource(IoResourceKind::pwm_block, instance)) &&
                         resourceFree(gpioIoResource(gpio)) &&
                         resourceFree(dmaMemoryIoResource(first.values, 16U)) &&
                         resourceFree(dmaMemoryIoResource(second.values, 16U));
            const bool expected_start = (flags & 1U) == 0U || (flags & 2U) != 0U;
            const bool observed_start =
                (result[12] | result[13]) != 0U && (result[14] | result[15]) != 0U;
            if (!event_ok || result[10] != 0U || result[17] != 0U || result[19] != 1U ||
                result[20] != 1U || expected_start != observed_start ||
                (!expected_start && result[16] != 0U))
            {
                result[2] = 4U;
                break;
            }
            ++result[21];
        }
        if (resourceFree(gpioIoResource(gpio)) && registers->ENABLE == 0U)
        {
            if (out_before)
            {
                NRF_P1->OUTSET = 1UL << 14U;
            }
            else
            {
                NRF_P1->OUTCLR = 1UL << 14U;
            }
            NRF_P1->PIN_CNF[14] = pin_before;
        }
        result[18] = NRF_P1->PIN_CNF[14];
        result[24] = pin_before;
        if (result[18] != pin_before)
        {
            result[2] = 5U;
        }
    }
} // namespace

#include "nojumper_ownership.h"
#include "nojumper_adc.h"
#include "nojumper_timer.h"
#include "nojumper_event.h"
#include "nojumper_time.h"

int main()
{
    nojumper_ready[1] = nojumper_revision[0] != '\0' ? 2U : 0U;
    nojumper_ready[0] = magic;
    std::uint32_t previous = 0U;
    while (true)
    {
        const auto sequence = nojumper_request[0];
        if (sequence != 0U && sequence != previous && nojumper_ready[3] == 0U)
        {
            std::uint32_t request[8]{};
            std::uint32_t result[32]{};
            nrf_barrier_rw();
            for (unsigned index = 0U; index < 8U; ++index)
            {
                request[index] = nojumper_request[index];
                result[index] = request[index];
            }
            result[2] = 0U;
            if (request[0] != sequence || request[1] == 0U || (request[2] < 1U || request[2] > 6U))
            {
                result[2] = 1U;
            }
            else
            {
                switch (request[2])
                {
                case 1U:
                    exercisePwm(request, result);
                    break;
                case 2U:
                    exerciseSaadc(request, result);
                    break;
                case 3U:
                    exerciseTimer(request, result);
                    break;
                case 4U:
                    exerciseEvent(request, result);
                    break;
                case 5U:
                    exerciseBridge(request, result);
                    break;
                case 6U:
                    exerciseTime(request, result);
                    break;
                default:
                    result[2] = 1U;
                    break;
                }
            }
            for (unsigned index = 1U; index < 32U; ++index)
            {
                nojumper_response[index] = result[index];
            }
            nrf_barrier_rw();
            nojumper_response[0] = sequence;
            previous = sequence;
            ++nojumper_ready[2];
            nojumper_ready[3] = result[2];
        }
        k_sleep(K_MSEC(1));
    }
}
```

## src/nojumper_adc.h
```c
/** @file @brief 내부 VDD/AVDD의 순서·calibration 완료·guard·반복 재시작을 검증합니다. */
#pragma once
#include <hal/nrf_saadc.h>

struct GuardedAdc
{
    std::uint32_t before[4];
    std::int16_t samples[32];
    std::uint32_t after[4];
};
extern "C"
{
    alignas(4) GuardedAdc nojumper_adc_buffer{};
}
namespace
{
    auto &adc_buffer = nojumper_adc_buffer;

    /** @brief 내부 입력만 선택하며 외부 AIN pad는 사용하지 않습니다. */
    void exerciseSaadc(const std::uint32_t *request, std::uint32_t *result)
    {
        const auto channels = request[3];
        const auto flags = request[4];
        const auto sample_count = request[5];
        const auto repetitions = request[6];
        if ((channels != 1U && channels != 2U) || flags > 3U ||
            (sample_count != 1U && sample_count != 32U) || sample_count % channels != 0U ||
            repetitions == 0U || repetitions > 100U || request[7] != 1U)
        {
            result[2] = 1U;
            return;
        }
        auto &adc = analogFabric().saadc();
        SaadcChannelConfiguration configuration[2] = {
            {SaadcInput::vdd, SaadcInput::disabled, SaadcGain::one_quarter},
            {SaadcInput::avdd, SaadcInput::disabled, SaadcGain::one_quarter}};
        if ((flags & 1U) != 0U)
        {
            configuration[0].positive = SaadcInput::avdd;
            configuration[1].positive = SaadcInput::vdd;
        }
        const SaadcChannelConfiguration unsupported{SaadcInput::vss, SaadcInput::disabled,
                                                    SaadcGain::one_quarter};
        result[26] = static_cast<std::uint32_t>(adc.configure({&unsupported, 1U, 12U, 1U, 0U}));
        if (result[26] != static_cast<std::uint32_t>(AnalogFabricResult::invalid_argument))
        {
            result[2] = 6U;
            return;
        }
        result[12] = result[14] = 4095U;
        for (std::uint32_t run = 0U; run < repetitions; ++run)
        {
            for (unsigned index = 0U; index < 4U; ++index)
            {
                adc_buffer.before[index] = guard;
                adc_buffer.after[index] = guard;
            }
            for (auto &sample : adc_buffer.samples)
            {
                sample = 0x5555;
            }
            result[8] =
                static_cast<std::uint32_t>(adc.configure({configuration, channels, 12U, 1U, 0U}));
            if (result[8] != 0U)
            {
                result[2] = 2U;
                break;
            }
            result[9] = static_cast<std::uint32_t>(
                adc.start(adc_buffer.samples, sample_count, nullptr, 0U));
            if (result[9] != 0U)
            {
                result[2] = 3U;
                break;
            }
            bool ready = false;
            bool finished = false;
            bool complete = false;
            bool calibrated = false;
            bool events_ok = true;
            auto drain = [&]
            {
                SaadcEvent event{};
                while (adc.takeEvent(event))
                {
                    ready |= event.type == SaadcEventType::ready;
                    finished |= event.type == SaadcEventType::finished;
                    calibrated |= event.type == SaadcEventType::calibration_complete;
                    if (event.type == SaadcEventType::buffer_complete)
                    {
                        events_ok &= !complete && event.buffer == adc_buffer.samples &&
                                     event.samples == sample_count;
                        complete = true;
                    }
                    events_ok &= event.type != SaadcEventType::error && event.driver_error == 0;
                }
            };
            auto deadline = k_uptime_get() + 100;
            while (!ready && k_uptime_get() < deadline)
            {
                drain();
                k_busy_wait(50U);
            }
            events_ok &= ready;
            for (std::uint32_t index = 0U; events_ok && index < sample_count / channels; ++index)
            {
                events_ok &= adc.sample() == AnalogFabricResult::success;
                k_busy_wait(100U);
                drain();
            }
            deadline = k_uptime_get() + 100;
            while (!finished && k_uptime_get() < deadline)
            {
                drain();
                k_busy_wait(50U);
            }
            events_ok &= complete && finished;
            if (events_ok && (flags & 2U) != 0U)
            {
                result[22] = static_cast<std::uint32_t>(adc.calibrate());
                deadline = k_uptime_get() + 100;
                while (!calibrated && k_uptime_get() < deadline)
                {
                    drain();
                    k_busy_wait(50U);
                }
                events_ok &= result[22] == 0U && calibrated;
                if (calibrated)
                {
                    ++result[23];
                }
            }
            result[10] = static_cast<std::uint32_t>(adc.stop(100000U));
            result[11] = static_cast<std::uint32_t>(adc.state());
            result[17] = NRF_SAADC->ENABLE;
            result[19] = 1U;
            for (unsigned index = 0U; index < 4U; ++index)
            {
                result[19] &= adc_buffer.before[index] == guard && adc_buffer.after[index] == guard;
            }
            for (std::uint32_t index = sample_count; index < 32U; ++index)
            {
                result[19] &= adc_buffer.samples[index] == 0x5555;
            }
            result[20] =
                resourceFree(peripheralIoResource(IoResourceKind::adc_block, 0U, NRF_SAADC)) &&
                resourceFree(dmaMemoryIoResource(adc_buffer.samples, sample_count * 2U));
            for (std::uint32_t index = 0U; index < sample_count; ++index)
            {
                const auto sample = adc_buffer.samples[index];
                const auto channel = index % channels;
                if (sample < 0 || sample > 4095)
                {
                    events_ok = false;
                    break;
                }
                const auto value = static_cast<std::uint32_t>(sample);
                const auto minimum = 12U + channel * 2U;
                const auto maximum = minimum + 1U;
                if (value < result[minimum])
                {
                    result[minimum] = value;
                }
                if (value > result[maximum])
                {
                    result[maximum] = value;
                }
                ++result[16];
            }
            if (!events_ok || result[10] != 0U || result[17] != 0U || result[19] != 1U ||
                result[20] != 1U)
            {
                result[2] = 4U;
                break;
            }
            ++result[21];
        }
    }
} // namespace
```

## src/nojumper_event.h
```c
/** @file @brief EGU·DPPI와 PPIB 왕복 경로를 외부 GPIO 없이 검증합니다. */
#pragma once
#include <hal/nrf_dppi.h>
#include <hal/nrf_egu.h>
#include <hal/nrf_ppib.h>

namespace
{
    NRF_DPPIC_Type *dppiRegisters(std::uint32_t instance)
    {
        switch (instance)
        {
        case 0U:
            return NRF_DPPIC00;
        case 10U:
            return NRF_DPPIC10;
        case 20U:
            return NRF_DPPIC20;
        case 30U:
            return NRF_DPPIC30;
        default:
            return nullptr;
        }
    }

    /** @brief CPU는 발생 EGU만 trigger하며 수신 EGU event를 독립 관측합니다. */
    bool observeEvent(EguFabric &egu, std::uint8_t source, std::uint8_t sink, bool expected)
    {
        auto *const event = reinterpret_cast<volatile std::uint32_t *>(egu.event(sink).address);
        *reinterpret_cast<volatile std::uint32_t *>(egu.event(source).address) = 0U;
        *event = 0U;
        nrf_barrier_rw();
        if (egu.trigger(source) != EventFabricResult::success)
        {
            return false;
        }
        k_busy_wait(100U);
        if (expected)
        {
            const auto deadline = k_uptime_get() + 2;
            while (*event == 0U && k_uptime_get() < deadline)
            {
                k_busy_wait(10U);
            }
        }
        return (*event != 0U) == expected;
    }

    /** @brief 한 channel의 enable/disable/disconnect와 모든 group의 해제를 반복합니다. */
    void exerciseEvent(const std::uint32_t *request, std::uint32_t *result)
    {
        const auto domain = request[3];
        const auto channel = request[4];
        const auto source = request[5];
        const auto events = request[6];
        const auto repetitions = request[7];
        auto *const dppi = eventFabric().dppi(static_cast<std::uint8_t>(domain));
        auto *const egu = eventFabric().egu(static_cast<std::uint8_t>(domain));
        auto *const registers = dppiRegisters(domain);
        if ((domain != 10U && domain != 20U) || dppi == nullptr || egu == nullptr ||
            channel >= dppi->channelCount() || source >= egu->channelCount() || events != 1000U ||
            repetitions == 0U || repetitions > 10U)
        {
            result[2] = 1U;
            return;
        }
        auto *const egu_registers = domain == 10U ? NRF_EGU10 : NRF_EGU20;
        const auto ch = static_cast<std::uint8_t>(channel);
        const auto src = static_cast<std::uint8_t>(source);
        const auto sink = static_cast<std::uint8_t>((source + 1U) % egu->channelCount());
        const auto publisher = egu->event(src);
        const auto subscriber = egu->task(sink);
        result[23] = dppi->groupCount();
        for (std::uint32_t run = 0U; run < repetitions; ++run)
        {
            if (!refusesReservation(
                    peripheralIoResource(IoResourceKind::dppi_channel, ch, registers),
                    [&]
                    {
                        return dppi->acquireChannel(ch);
                    }) ||
                !refusesReservation(
                    peripheralIoResource(IoResourceKind::event_channel, src, egu_registers),
                    [&]
                    {
                        return egu->acquire(src);
                    }))
            {
                result[2] = 6U;
                return;
            }
            ++result[24];
            ++result[25];
            bool valid = egu->acquire(src) == EventFabricResult::success;
            valid &= egu->acquire(sink) == EventFabricResult::success;
            valid &= dppi->acquireChannel(ch) == EventFabricResult::success;
            if (!valid)
            {
                result[2] = 2U;
                return;
            }
            valid &= dppi->connect(publisher, subscriber, ch) == EventFabricResult::success;
            valid &= dppi->enable(ch) == EventFabricResult::success;
            for (std::uint32_t index = 0U; valid && index < events; ++index)
            {
                valid = observeEvent(*egu, src, sink, true);
                if (valid)
                {
                    ++result[12];
                }
            }
            valid &= dppi->disable(ch) == EventFabricResult::success;
            valid &= observeEvent(*egu, src, sink, false);
            if (valid)
            {
                ++result[13];
            }
            for (std::uint8_t group = 0U; valid && group < dppi->groupCount(); ++group)
            {
                valid &= refusesReservation(
                    peripheralIoResource(IoResourceKind::dppi_group, group, registers),
                    [&]
                    {
                        return dppi->acquireGroup(group, 1UL << ch);
                    });
                if (valid)
                {
                    ++result[26];
                }
                valid &= dppi->acquireGroup(group, 1UL << ch) == EventFabricResult::success;
                valid &= registers->CHG[group] == (1UL << ch);
                nrf_dppi_group_enable(registers, static_cast<nrf_dppi_channel_group_t>(group));
                valid &= (registers->CHEN & (1UL << ch)) != 0U;
                valid &= observeEvent(*egu, src, sink, true);
                valid &= dppi->releaseGroup(group) == EventFabricResult::success;
                valid &= registers->CHG[group] == 0U && (registers->CHEN & (1UL << ch)) == 0U;
                valid &= observeEvent(*egu, src, sink, false);
                valid &= resourceFree(
                    peripheralIoResource(IoResourceKind::dppi_group, group, registers));
                if (valid)
                {
                    ++result[22];
                }
            }
            valid &= dppi->disconnect(publisher, subscriber, ch) == EventFabricResult::success;
            valid &= dppi->enable(ch) == EventFabricResult::success;
            valid &= observeEvent(*egu, src, sink, false);
            if (valid)
            {
                ++result[14];
            }
            result[10] = static_cast<std::uint32_t>(dppi->releaseChannel(ch));
            valid &= egu->release(src) == EventFabricResult::success;
            valid &= egu->release(sink) == EventFabricResult::success;
            result[17] = registers->CHEN & (1UL << ch);
            result[18] = *reinterpret_cast<volatile std::uint32_t *>(publisher.address + 0x80U);
            result[19] = *reinterpret_cast<volatile std::uint32_t *>(subscriber.address + 0x80U);
            result[20] =
                resourceFree(peripheralIoResource(IoResourceKind::dppi_channel, ch, registers)) &&
                resourceFree(
                    peripheralIoResource(IoResourceKind::event_channel, src, egu_registers)) &&
                resourceFree(
                    peripheralIoResource(IoResourceKind::event_channel, sink, egu_registers));
            if (!valid || result[10] != 0U || result[17] != 0U || result[18] != 0U ||
                result[19] != 0U || result[20] != 1U)
            {
                result[2] = 4U;
                return;
            }
            ++result[21];
        }
    }

    /** @brief 서로 다른 두 bridge channel을 사용해 되먹임 없는 왕복 경로를 구성합니다. */
    void exerciseBridge(const std::uint32_t *request, std::uint32_t *result)
    {
        const auto pair = request[3];
        const auto channel = request[4];
        const auto remote_channel = request[5];
        const auto events = request[6];
        const auto repetitions = request[7];
        constexpr std::uint8_t starts[] = {10U, 20U, 21U, 22U};
        constexpr std::uint8_t ends[] = {0U, 1U, 11U, 30U};
        NRF_PPIB_Type *const start_regs[] = {NRF_PPIB10, NRF_PPIB20, NRF_PPIB21, NRF_PPIB22};
        NRF_PPIB_Type *const end_regs[] = {NRF_PPIB00, NRF_PPIB01, NRF_PPIB11, NRF_PPIB30};
        if (pair > 3U || events != 1000U || repetitions == 0U || repetitions > 10U)
        {
            result[2] = 1U;
            return;
        }
        auto &start = *eventFabric().ppib(starts[pair]);
        auto &end = *eventFabric().ppib(ends[pair]);
        auto &local = *eventFabric().dppi(start.domain());
        auto &remote = *eventFabric().dppi(end.domain());
        auto &egu = *eventFabric().egu(start.domain());
        auto *const local_reg = dppiRegisters(start.domain());
        auto *const remote_reg = dppiRegisters(end.domain());
        const auto outgoing = static_cast<std::uint8_t>(channel);
        const auto incoming = static_cast<std::uint8_t>(channel ^ 1U);
        const auto middle = static_cast<std::uint8_t>(remote_channel);
        if (channel >= start.channelCount() || channel >= end.channelCount() ||
            incoming >= start.channelCount() || incoming >= end.channelCount() ||
            remote_channel >= remote.channelCount())
        {
            result[2] = 1U;
            return;
        }
        result[23] = remote.groupCount();
        for (std::uint32_t run = 0U; run < repetitions; ++run)
        {
            if (!refusesReservation(
                    peripheralIoResource(IoResourceKind::ppib_channel, outgoing, start_regs[pair]),
                    [&]
                    {
                        return start.acquire(outgoing);
                    }))
            {
                result[2] = 6U;
                return;
            }
            ++result[24];
            bool valid = start.acquire(outgoing) == EventFabricResult::success;
            valid &= start.acquire(incoming) == EventFabricResult::success;
            valid &= end.acquire(outgoing) == EventFabricResult::success;
            valid &= end.acquire(incoming) == EventFabricResult::success;
            valid &= local.acquireChannel(0U) == EventFabricResult::success;
            valid &= local.acquireChannel(1U) == EventFabricResult::success;
            valid &= remote.acquireChannel(middle) == EventFabricResult::success;
            valid &= egu.acquire(0U) == EventFabricResult::success;
            valid &= egu.acquire(1U) == EventFabricResult::success;
            if (!valid)
            {
                result[2] = 2U;
                return;
            }
            start_regs[pair]->OVERFLOW.SEND = 0U;
            end_regs[pair]->OVERFLOW.SEND = 0U;
            valid &= local.connect(egu.event(0U), start.sendTask(outgoing), 0U) ==
                     EventFabricResult::success;
            valid &= remote.connect(end.receiveEvent(outgoing), end.sendTask(incoming), middle) ==
                     EventFabricResult::success;
            valid &= local.connect(start.receiveEvent(incoming), egu.task(1U), 1U) ==
                     EventFabricResult::success;
            valid &= remote.enable(middle) == EventFabricResult::success;
            valid &= local.enable(1U) == EventFabricResult::success;
            valid &= local.enable(0U) == EventFabricResult::success;
            for (std::uint32_t index = 0U; valid && index < events; ++index)
            {
                valid = observeEvent(egu, 0U, 1U, true);
                if (valid)
                {
                    ++result[12];
                }
            }
            valid &= remote.disable(middle) == EventFabricResult::success;
            valid &= observeEvent(egu, 0U, 1U, false);
            if (valid)
            {
                ++result[13];
            }
            for (std::uint8_t group = 0U; valid && group < remote.groupCount(); ++group)
            {
                valid &= refusesReservation(
                    peripheralIoResource(IoResourceKind::dppi_group, group, remote_reg),
                    [&]
                    {
                        return remote.acquireGroup(group, 1UL << middle);
                    });
                if (valid)
                {
                    ++result[26];
                }
                valid &= remote.acquireGroup(group, 1UL << middle) == EventFabricResult::success;
                valid &= remote_reg->CHG[group] == (1UL << middle);
                nrf_dppi_group_enable(remote_reg, static_cast<nrf_dppi_channel_group_t>(group));
                valid &= observeEvent(egu, 0U, 1U, true);
                valid &= remote.releaseGroup(group) == EventFabricResult::success;
                valid &= remote_reg->CHG[group] == 0U && (remote_reg->CHEN & (1UL << middle)) == 0U;
                valid &= observeEvent(egu, 0U, 1U, false);
                valid &= resourceFree(
                    peripheralIoResource(IoResourceKind::dppi_group, group, remote_reg));
                if (valid)
                {
                    ++result[22];
                }
            }
            valid &= local.releaseChannel(0U) == EventFabricResult::success;
            valid &= local.releaseChannel(1U) == EventFabricResult::success;
            valid &= remote.releaseChannel(middle) == EventFabricResult::success;
            valid &= start.release(outgoing) == EventFabricResult::success;
            valid &= start.release(incoming) == EventFabricResult::success;
            valid &= end.release(outgoing) == EventFabricResult::success;
            valid &= end.release(incoming) == EventFabricResult::success;
            valid &= egu.release(0U) == EventFabricResult::success;
            valid &= egu.release(1U) == EventFabricResult::success;
            result[17] = (local_reg->CHEN & 3U) | (remote_reg->CHEN & (1UL << middle));
            result[18] = start_regs[pair]->OVERFLOW.SEND;
            result[19] = end_regs[pair]->OVERFLOW.SEND;
            result[20] =
                resourceFree(peripheralIoResource(IoResourceKind::dppi_channel, 0U, local_reg)) &&
                resourceFree(peripheralIoResource(IoResourceKind::dppi_channel, 1U, local_reg)) &&
                resourceFree(
                    peripheralIoResource(IoResourceKind::dppi_channel, middle, remote_reg));
            auto *const egu_registers = start.domain() == 10U ? NRF_EGU10 : NRF_EGU20;
            result[20] &= resourceFree(peripheralIoResource(IoResourceKind::event_channel, 0U,
                                                            egu_registers)) &&
                          resourceFree(peripheralIoResource(IoResourceKind::event_channel, 1U,
                                                            egu_registers));
            valid &=
                *reinterpret_cast<volatile std::uint32_t *>(egu.event(0U).address + 0x80U) == 0U &&
                *reinterpret_cast<volatile std::uint32_t *>(egu.task(1U).address + 0x80U) == 0U;
            const std::uint8_t bridge_channels[] = {outgoing, incoming};
            for (auto bridge_channel : bridge_channels)
            {
                result[20] &=
                    resourceFree(peripheralIoResource(IoResourceKind::ppib_channel, bridge_channel,
                                                      start_regs[pair])) &&
                    resourceFree(peripheralIoResource(IoResourceKind::ppib_channel, bridge_channel,
                                                      end_regs[pair]));
                valid &= start_regs[pair]->SUBSCRIBE_SEND[bridge_channel] == 0U &&
                         start_regs[pair]->PUBLISH_RECEIVE[bridge_channel] == 0U &&
                         end_regs[pair]->SUBSCRIBE_SEND[bridge_channel] == 0U &&
                         end_regs[pair]->PUBLISH_RECEIVE[bridge_channel] == 0U;
            }
            if (!valid || result[17] != 0U || result[18] != 0U || result[19] != 0U ||
                result[20] != 1U)
            {
                result[2] = 4U;
                return;
            }
            ++result[21];
        }
    }
} // namespace
```

## src/nojumper_ownership.h
```c
/** @file @brief 시험이 예약한 자원에서 public API의 원자적 충돌 거부를 확인합니다. */
#pragma once

namespace
{
    /** @brief 실제 system 자원을 빼앗지 않고 빈 자원에 시험용 system 예약을 만듭니다. */
    template <typename Acquire>
    bool refusesReservation(const IoResourceId &resource, Acquire acquire)
    {
        IoResourceLease lease{};
        if (reserveIoResources({IoOwnerKind::system, 0xFFU}, &resource, 1U,
                               IoAcquirePolicy::exclusive, lease) != IoResourceResult::success)
        {
            return false;
        }
        const auto result = acquire();
        IoResourceSnapshot snapshot{};
        const bool unchanged =
            ioResourceSnapshot(resource, snapshot) == IoResourceResult::success &&
            snapshot.state == IoResourceState::reserved &&
            snapshot.owner.kind == IoOwnerKind::system && snapshot.owner.instance == 0xFFU;
        const auto rollback = rollbackIoResources(lease);
        return result == EventFabricResult::ownership_conflict && unchanged &&
               rollback == IoResourceResult::success && resourceFree(resource);
    }
} // namespace
```

## src/nojumper_time.h
```c
/** @file @brief GRTC 기반 기존 micros/millis/delay endpoint를 별도 TIMER와 대조합니다. */
#pragma once

#include <zephyr/sys/time_units.h>

namespace
{
    void exerciseTime(const std::uint32_t *request, std::uint32_t *result)
    {
        const auto duration = request[3];
        const auto sleep_ms = request[4];
        const auto repetitions = request[5];
        if ((duration != 1000U && duration != 10000U) || sleep_ms > 1U || repetitions != 100U ||
            request[6] != 0U || request[7] != 1U)
        {
            result[2] = 1U;
            return;
        }
        auto &timer = *eventFabric().timer(20U);
        /** @brief nrfx busy-wait와 GRTC의 clock 차이는 시험표의 양방향 5%로 판정합니다. */
        const auto minimum_elapsed = sleep_ms != 0U ? duration : duration - duration / 20U;
        const auto maximum_elapsed = sleep_ms != 0U ? duration + 3000U : duration + duration / 20U;
        const auto tick_us = k_ticks_to_us_ceil32(1U);
        result[28] = tick_us;
        result[12] = 0xFFFFFFFFU;
        result[14] = 0xFFFFFFFFU;
        for (std::uint32_t run = 0U; run < repetitions; ++run)
        {
            result[8] = static_cast<std::uint32_t>(timer.acquire(1000000U));
            if (result[8] != 0U)
            {
                result[2] = 2U;
                return;
            }
            result[9] = static_cast<std::uint32_t>(timer.start());
            const auto before_us = static_cast<std::uint32_t>(micros());
            const auto before_ms = static_cast<std::uint32_t>(millis());
            if (sleep_ms != 0U)
            {
                delay(duration / 1000U);
            }
            else
            {
                delayMicroseconds(duration);
            }
            const auto after_us = static_cast<std::uint32_t>(micros());
            const auto after_ms = static_cast<std::uint32_t>(millis());
            const auto captured = timer.capture(0U);
            const auto elapsed = after_us - before_us;
            const auto elapsed_ms = after_ms - before_ms;
            const auto error = elapsed > captured ? elapsed - captured : captured - elapsed;
            result[10] = static_cast<std::uint32_t>(timer.release());
            if (elapsed < result[12])
            {
                result[12] = elapsed;
            }
            if (elapsed > result[13])
            {
                result[13] = elapsed;
            }
            if (elapsed_ms < result[14])
            {
                result[14] = elapsed_ms;
            }
            if (elapsed_ms > result[15])
            {
                result[15] = elapsed_ms;
            }
            if (error > result[16])
            {
                result[16] = error;
            }
            result[20] =
                resourceFree(peripheralIoResource(IoResourceKind::timer_block, 20U, NRF_TIMER20));
            const auto milliseconds_us = elapsed_ms * 1000U;
            const auto error_ms_us =
                milliseconds_us > elapsed ? milliseconds_us - elapsed : elapsed - milliseconds_us;
            if (error_ms_us > result[27])
            {
                result[27] = error_ms_us;
            }
            result[24] = elapsed_ms;
            result[25] = elapsed;
            result[26] = captured;
            /** @brief 서로 다른 읽기 구간, millis의 1ms 단위와 kernel tick 1개를 반영합니다. */
            if (result[9] != 0U || result[10] != 0U || result[20] != 1U ||
                elapsed < minimum_elapsed || elapsed > maximum_elapsed || error > duration / 20U ||
                error_ms_us > 1000U + tick_us + error)
            {
                result[2] = 4U;
                return;
            }
            ++result[21];
        }
    }
} // namespace
```

## src/nojumper_timer.h
```c
/** @file @brief TIMER 44개 CC의 compare·clear/stop shortcut과 자원 반환을 검증합니다. */
#pragma once
#include <hal/nrf_timer.h>

namespace
{
    NRF_TIMER_Type *timerRegisters(std::uint32_t instance)
    {
        switch (instance)
        {
        case 0U:
            return NRF_TIMER00;
        case 10U:
            return NRF_TIMER10;
        case 20U:
            return NRF_TIMER20;
        case 21U:
            return NRF_TIMER21;
        case 22U:
            return NRF_TIMER22;
        case 23U:
            return NRF_TIMER23;
        case 24U:
            return NRF_TIMER24;
        default:
            return nullptr;
        }
    }

    /** @brief 다른 CC로 capture하여 시험 중인 compare 값을 보존합니다. */
    void exerciseTimer(const std::uint32_t *request, std::uint32_t *result)
    {
        const auto instance = request[3];
        const auto channel = request[4];
        const auto flags = request[5];
        const auto top = request[6];
        const auto repetitions = request[7];
        auto *const registers = timerRegisters(instance);
        auto *const timer = eventFabric().timer(static_cast<std::uint8_t>(instance));
        if (registers == nullptr || timer == nullptr || channel >= timer->channelCount() ||
            flags > 3U || (top != 1000U && top != 10000U) || repetitions == 0U || repetitions > 10U)
        {
            result[2] = 1U;
            return;
        }
        const auto capture_channel =
            static_cast<std::uint8_t>((channel + 1U) % timer->channelCount());
        const auto compare_channel = static_cast<std::uint8_t>(channel);
        const auto compare_event = nrf_timer_compare_event_get(compare_channel);
        result[12] = 0xFFFFFFFFU;
        result[18] = 1U;
        for (std::uint32_t run = 0U; run < repetitions; ++run)
        {
            if (!refusesReservation(peripheralIoResource(IoResourceKind::timer_block,
                                                         static_cast<std::uint8_t>(instance),
                                                         registers),
                                    [&]
                                    {
                                        return timer->acquire(1000000U);
                                    }))
            {
                result[2] = 6U;
                return;
            }
            ++result[27];
            result[8] = static_cast<std::uint32_t>(timer->acquire(1000000U));
            if (result[8] != 0U)
            {
                result[2] = 2U;
                break;
            }
            nrf_timer_event_clear(registers, compare_event);
            result[9] = static_cast<std::uint32_t>(
                timer->setCompare(compare_channel, top, (flags & 1U) != 0U, (flags & 2U) != 0U));
            const auto before = k_cycle_get_32();
            result[22] = static_cast<std::uint32_t>(timer->start());
            k_busy_wait(top + top / 2U);
            const auto captured = timer->capture(capture_channel);
            const auto elapsed = k_cyc_to_us_floor32(k_cycle_get_32() - before);
            const auto expected = (flags & 2U) != 0U
                                      ? ((flags & 1U) != 0U ? 0U : top)
                                      : ((flags & 1U) != 0U ? elapsed % top : elapsed);
            const auto error = captured > expected ? captured - expected : expected - captured;
            bool valid = (flags & 2U) != 0U ? captured == expected : error <= top / 20U;
            result[15] = nrf_timer_event_check(registers, compare_event) ? 1U : 0U;
            result[23] = static_cast<std::uint32_t>(timer->stop());
            const auto stopped = timer->capture(capture_channel);
            k_busy_wait(50U);
            result[18] &= stopped == timer->capture(capture_channel);
            result[24] = static_cast<std::uint32_t>(timer->clear());
            result[19] = timer->capture(capture_channel) == 0U ? 1U : 0U;
            result[10] = static_cast<std::uint32_t>(timer->release());
            result[11] = timer->active() ? 1U : 0U;
            result[17] = registers->SHORTS;
            result[20] = resourceFree(peripheralIoResource(
                IoResourceKind::timer_block, static_cast<std::uint8_t>(instance), registers));
            if (captured < result[12])
            {
                result[12] = captured;
            }
            if (captured > result[13])
            {
                result[13] = captured;
            }
            if (error > result[14])
            {
                result[14] = error;
            }
            result[25] = elapsed;
            result[26] = captured;
            valid &= result[9] == 0U && result[10] == 0U && result[11] == 0U && result[15] == 1U &&
                     result[17] == 0U && result[18] == 1U && result[19] == 1U && result[20] == 1U &&
                     result[22] == 0U && result[23] == 0U && result[24] == 0U;
            if (!valid)
            {
                result[2] = 4U;
                break;
            }
            ++result[21];
        }
    }
} // namespace
```
