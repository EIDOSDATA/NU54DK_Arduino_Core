## tests/zephyr/m32_ble_advertising_hil/testcase.yaml
```yaml
tests:
  nucode.m32.ble_advertising_hil.advertiser_a:
    build_only: true
    extra_args:
      - M32_ADV_ROLE=advertiser_a
    platform_allow:
      - nrf54l15dk/nrf54l15/cpuapp/nu54dk
    integration_platforms:
      - nrf54l15dk/nrf54l15/cpuapp/nu54dk
    tags: [bluetooth, m32, advertising, hil]
  nucode.m32.ble_advertising_hil.advertiser_b:
    build_only: true
    extra_args:
      - M32_ADV_ROLE=advertiser_b
    platform_allow:
      - nrf54l15dk/nrf54l15/cpuapp/nu54dk
    integration_platforms:
      - nrf54l15dk/nrf54l15/cpuapp/nu54dk
    tags: [bluetooth, m32, advertising, hil]
  nucode.m32.ble_advertising_hil.scanner:
    build_only: true
    extra_args:
      - M32_ADV_ROLE=scanner
    platform_allow:
      - nrf54l15dk/nrf54l15/cpuapp/nu54dk
    integration_platforms:
      - nrf54l15dk/nrf54l15/cpuapp/nu54dk
    tags: [bluetooth, m32, advertising, hil]
```

## tests/zephyr/m32_ble_capability/testcase.yaml
```yaml
tests:
  nucode.m32.ble_capability.baseline_sdc:
    build_only: true
    integration_platforms:
      - nrf54l15dk/nrf54l15/cpuapp/nu54dk
    platform_allow:
      - nrf54l15dk/nrf54l15/cpuapp/nu54dk
    extra_args:
      - EXTRA_CONF_FILE=baseline.conf
    tags:
      - bluetooth
      - m32
      - capability
  nucode.m32.ble_capability.extended_sdc:
    build_only: true
    integration_platforms:
      - nrf54l15dk/nrf54l15/cpuapp/nu54dk
    platform_allow:
      - nrf54l15dk/nrf54l15/cpuapp/nu54dk
    extra_args:
      - EXTRA_CONF_FILE=extended.conf
    tags:
      - bluetooth
      - m32
      - capability
```

## tests/zephyr/m32_ble_ead_hil/testcase.yaml
```yaml
tests:
  nucode.m32.ble_ead_hil.advertiser:
    build_only: true
    extra_args:
      - M32_EAD_ROLE=advertiser
    platform_allow:
      - nrf54l15dk/nrf54l15/cpuapp/nu54dk
    integration_platforms:
      - nrf54l15dk/nrf54l15/cpuapp/nu54dk
    tags:
      - bluetooth
      - m32
      - advertising
      - ead
      - hil
  nucode.m32.ble_ead_hil.scanner:
    build_only: true
    extra_args:
      - M32_EAD_ROLE=scanner
    platform_allow:
      - nrf54l15dk/nrf54l15/cpuapp/nu54dk
    integration_platforms:
      - nrf54l15dk/nrf54l15/cpuapp/nu54dk
    tags:
      - bluetooth
      - m32
      - advertising
      - ead
      - hil
```

## tests/zephyr/m32_ble_nordic_hil/testcase.yaml
```yaml
tests:
  nucode.m32.ble_nordic_hil.central:
    build_only: true
    extra_args: [M32_NORDIC_ROLE=central]
    platform_allow: [nrf54l15dk/nrf54l15/cpuapp/nu54dk]
    integration_platforms: [nrf54l15dk/nrf54l15/cpuapp/nu54dk]
    tags: [bluetooth, m32, nordic, hil]
  nucode.m32.ble_nordic_hil.peripheral:
    build_only: true
    extra_args: [M32_NORDIC_ROLE=peripheral]
    platform_allow: [nrf54l15dk/nrf54l15/cpuapp/nu54dk]
    integration_platforms: [nrf54l15dk/nrf54l15/cpuapp/nu54dk]
    tags: [bluetooth, m32, nordic, hil]
```

## tests/zephyr/m32_ble_power_contract/testcase.yaml
```yaml
tests:
  nucode.m32.ble_power_contract:
    tags:
      - nucode
      - arduino
      - m32
      - bluetooth
      - power
      - path_loss
    build_only: true
    sysbuild: false
    platform_allow:
      - nrf54l15dk/nrf54l15/cpuapp/nu54dk
    integration_platforms:
      - nrf54l15dk/nrf54l15/cpuapp/nu54dk
```

## tests/zephyr/m32_ble_power_hil/testcase.yaml
```yaml
tests:
  nucode.m32.ble_power_hil.central:
    build_only: true
    extra_args:
      - M32_POWER_ROLE=central
    platform_allow:
      - nrf54l15dk/nrf54l15/cpuapp/nu54dk
    integration_platforms:
      - nrf54l15dk/nrf54l15/cpuapp/nu54dk
    tags:
      - bluetooth
      - m32
      - power
      - path_loss
      - hil
  nucode.m32.ble_power_hil.peripheral:
    build_only: true
    extra_args:
      - M32_POWER_ROLE=peripheral
    platform_allow:
      - nrf54l15dk/nrf54l15/cpuapp/nu54dk
    integration_platforms:
      - nrf54l15dk/nrf54l15/cpuapp/nu54dk
    tags:
      - bluetooth
      - m32
      - power
      - path_loss
      - hil
```

## tests/zephyr/m32_ble_privacy_hil/testcase.yaml
```yaml
tests:
  nucode.m32.ble_privacy_hil.identity_a:
    build_only: true
    extra_args: [M32_PRIV_ROLE=identity_a]
    platform_allow: [nrf54l15dk/nrf54l15/cpuapp/nu54dk]
    integration_platforms: [nrf54l15dk/nrf54l15/cpuapp/nu54dk]
    tags: [bluetooth, m32, identity, privacy, hil]
  nucode.m32.ble_privacy_hil.identity_b:
    build_only: true
    extra_args: [M32_PRIV_ROLE=identity_b]
    platform_allow: [nrf54l15dk/nrf54l15/cpuapp/nu54dk]
    integration_platforms: [nrf54l15dk/nrf54l15/cpuapp/nu54dk]
    tags: [bluetooth, m32, identity, privacy, hil]
  nucode.m32.ble_privacy_hil.peer:
    build_only: true
    extra_args: [M32_PRIV_ROLE=peer]
    platform_allow: [nrf54l15dk/nrf54l15/cpuapp/nu54dk]
    integration_platforms: [nrf54l15dk/nrf54l15/cpuapp/nu54dk]
    tags: [bluetooth, m32, identity, privacy, hil]
```
