## tests/zephyr/m29_ble_coc_hil/testcase.yaml
```yaml
tests:
  nucode.m29.ble_coc_peripheral:
    tags:
      - nucode
      - arduino
      - m29
      - bluetooth
      - l2cap
      - hil
    build_only: true
    extra_args:
      - M29_COC_ROLE=peripheral
    platform_allow:
      - nrf54l15dk/nrf54l15/cpuapp/nu54dk
    integration_platforms:
      - nrf54l15dk/nrf54l15/cpuapp/nu54dk
  nucode.m29.ble_coc_central:
    tags:
      - nucode
      - arduino
      - m29
      - bluetooth
      - l2cap
      - hil
    build_only: true
    extra_args:
      - M29_COC_ROLE=central
    platform_allow:
      - nrf54l15dk/nrf54l15/cpuapp/nu54dk
    integration_platforms:
      - nrf54l15dk/nrf54l15/cpuapp/nu54dk
```

## tests/zephyr/m29_ble_long_write_hil/testcase.yaml
```yaml
tests:
  nucode.m29.ble_long_write_peripheral:
    tags:
      - nucode
      - arduino
      - m29
      - bluetooth
      - gatt
      - hil
    build_only: true
    extra_args:
      - M29_LONG_WRITE_ROLE=peripheral
    platform_allow:
      - nrf54l15dk/nrf54l15/cpuapp/nu54dk
    integration_platforms:
      - nrf54l15dk/nrf54l15/cpuapp/nu54dk
  nucode.m29.ble_long_write_central:
    tags:
      - nucode
      - arduino
      - m29
      - bluetooth
      - gatt
      - hil
    build_only: true
    extra_args:
      - M29_LONG_WRITE_ROLE=central
    platform_allow:
      - nrf54l15dk/nrf54l15/cpuapp/nu54dk
    integration_platforms:
      - nrf54l15dk/nrf54l15/cpuapp/nu54dk
```

## tests/zephyr/m29_ble_multi_hil/testcase.yaml
```yaml
tests:
  nucode.m29.ble_multi_peripheral:
    tags: [nucode, arduino, m29, bluetooth, gatt, l2cap, hil]
    build_only: true
    extra_args: [M29_MULTI_ROLE=peripheral]
    platform_allow: [nrf54l15dk/nrf54l15/cpuapp/nu54dk]
    integration_platforms: [nrf54l15dk/nrf54l15/cpuapp/nu54dk]
  nucode.m29.ble_multi_mixed:
    tags: [nucode, arduino, m29, bluetooth, gatt, l2cap, hil]
    build_only: true
    extra_args: [M29_MULTI_ROLE=mixed]
    platform_allow: [nrf54l15dk/nrf54l15/cpuapp/nu54dk]
    integration_platforms: [nrf54l15dk/nrf54l15/cpuapp/nu54dk]
  nucode.m29.ble_multi_central:
    tags: [nucode, arduino, m29, bluetooth, gatt, l2cap, hil]
    build_only: true
    extra_args: [M29_MULTI_ROLE=central]
    platform_allow: [nrf54l15dk/nrf54l15/cpuapp/nu54dk]
    integration_platforms: [nrf54l15dk/nrf54l15/cpuapp/nu54dk]
```

## tests/zephyr/m29_ble_signed_eatt_hil/testcase.yaml
```yaml
tests:
  nucode.m29.ble_signed_eatt_peripheral:
    tags:
      - nucode
      - arduino
      - m29
      - bluetooth
      - signing
      - eatt
      - hil
    build_only: true
    extra_args:
      - M29_ADVANCED_ROLE=peripheral
    platform_allow:
      - nrf54l15dk/nrf54l15/cpuapp/nu54dk
    integration_platforms:
      - nrf54l15dk/nrf54l15/cpuapp/nu54dk
  nucode.m29.ble_signed_eatt_central:
    tags:
      - nucode
      - arduino
      - m29
      - bluetooth
      - signing
      - eatt
      - hil
    build_only: true
    extra_args:
      - M29_ADVANCED_ROLE=central
    platform_allow:
      - nrf54l15dk/nrf54l15/cpuapp/nu54dk
    integration_platforms:
      - nrf54l15dk/nrf54l15/cpuapp/nu54dk
```

## tests/zephyr/m30_ble_bond_hil/testcase.yaml
```yaml
tests:
  nucode.m30.bond.p:
    tags: [nucode, arduino, m30, bluetooth, security, bond, privacy, hil]
    build_only: true
    extra_args: [M30_BOND_ROLE=peripheral]
    platform_allow: [nrf54l15dk/nrf54l15/cpuapp/nu54dk]
    integration_platforms: [nrf54l15dk/nrf54l15/cpuapp/nu54dk]
  nucode.m30.bond.c:
    tags: [nucode, arduino, m30, bluetooth, security, bond, privacy, hil]
    build_only: true
    extra_args: [M30_BOND_ROLE=central]
    platform_allow: [nrf54l15dk/nrf54l15/cpuapp/nu54dk]
    integration_platforms: [nrf54l15dk/nrf54l15/cpuapp/nu54dk]
```

## tests/zephyr/m30_ble_capability/testcase.yaml
```yaml
tests:
  nucode.m30.ble_capability:
    tags:
      - nucode
      - arduino
      - m30
      - bluetooth
      - security
      - dfu
      - capability
      - hil
    build_only: true
    platform_allow:
      - nrf54l15dk/nrf54l15/cpuapp/nu54dk
    integration_platforms:
      - nrf54l15dk/nrf54l15/cpuapp/nu54dk
```

## tests/zephyr/m30_ble_dfu_hil/testcase.yaml
```yaml
tests:
  nucode.m30.dfu.peripheral:
    tags: [nucode, arduino, m30, bluetooth, dfu, hil]
    build_only: true
    sysbuild: true
    extra_args:
      - M30_DFU_ROLE=peripheral
      - M30_DFU_AUTO_CONFIRM=1
      - EXTRA_CONF_FILE=peripheral.conf
    platform_allow: [nrf54l15dk/nrf54l15/cpuapp/nu54dk]
    integration_platforms: [nrf54l15dk/nrf54l15/cpuapp/nu54dk]
  nucode.m30.dfu.central:
    tags: [nucode, arduino, m30, bluetooth, dfu, hil]
    build_only: true
    extra_args:
      - M30_DFU_ROLE=central
      - EXTRA_CONF_FILE=central.conf
    platform_allow: [nrf54l15dk/nrf54l15/cpuapp/nu54dk]
    integration_platforms: [nrf54l15dk/nrf54l15/cpuapp/nu54dk]
  nucode.m30.power.confirmed:
    tags: [nucode, arduino, m30, bluetooth, dfu, power, hil]
    build_only: true
    sysbuild: true
    extra_args:
      - M30_DFU_ROLE=peripheral
      - M30_DFU_AUTO_CONFIRM=1
      - M30_DFU_POWER_HIL=1
      - EXTRA_CONF_FILE=peripheral.conf
    platform_allow: [nrf54l15dk/nrf54l15/cpuapp/nu54dk]
    integration_platforms: [nrf54l15dk/nrf54l15/cpuapp/nu54dk]
  nucode.m30.power.unconfirmed:
    tags: [nucode, arduino, m30, bluetooth, dfu, power, hil]
    build_only: true
    sysbuild: true
    extra_args:
      - M30_DFU_ROLE=peripheral
      - M30_DFU_AUTO_CONFIRM=0
      - M30_DFU_POWER_HIL=1
      - EXTRA_CONF_FILE=peripheral.conf
    platform_allow: [nrf54l15dk/nrf54l15/cpuapp/nu54dk]
    integration_platforms: [nrf54l15dk/nrf54l15/cpuapp/nu54dk]
```

## tests/zephyr/m30_ble_multi_hil/testcase.yaml
```yaml
tests:
  nucode.m30.multi.peripheral:
    tags: [nucode, arduino, m30, bluetooth, security, hil]
    build_only: true
    extra_args: [M30_MULTI_ROLE=peripheral]
    platform_allow: [nrf54l15dk/nrf54l15/cpuapp/nu54dk]
    integration_platforms: [nrf54l15dk/nrf54l15/cpuapp/nu54dk]
  nucode.m30.multi.mixed:
    tags: [nucode, arduino, m30, bluetooth, security, hil]
    build_only: true
    extra_args: [M30_MULTI_ROLE=mixed]
    platform_allow: [nrf54l15dk/nrf54l15/cpuapp/nu54dk]
    integration_platforms: [nrf54l15dk/nrf54l15/cpuapp/nu54dk]
  nucode.m30.multi.central:
    tags: [nucode, arduino, m30, bluetooth, security, hil]
    build_only: true
    extra_args: [M30_MULTI_ROLE=central]
    platform_allow: [nrf54l15dk/nrf54l15/cpuapp/nu54dk]
    integration_platforms: [nrf54l15dk/nrf54l15/cpuapp/nu54dk]
```

## tests/zephyr/m30_ble_oob_hil/testcase.yaml
```yaml
tests:
  nucode.m30.oob.p:
    tags: [nucode, arduino, m30, bluetooth, security, oob, hil]
    build_only: true
    extra_args: [M30_OOB_ROLE=peripheral]
    platform_allow: [nrf54l15dk/nrf54l15/cpuapp/nu54dk]
    integration_platforms: [nrf54l15dk/nrf54l15/cpuapp/nu54dk]
  nucode.m30.oob.c:
    tags: [nucode, arduino, m30, bluetooth, security, oob, hil]
    build_only: true
    extra_args: [M30_OOB_ROLE=central]
    platform_allow: [nrf54l15dk/nrf54l15/cpuapp/nu54dk]
    integration_platforms: [nrf54l15dk/nrf54l15/cpuapp/nu54dk]
```

## tests/zephyr/m30_ble_pair_hil/testcase.yaml
```yaml
tests:
  nucode.m30.pair.ni.p:
    tags: [nucode, arduino, m30, bluetooth, security, hil]
    build_only: true
    extra_args: [M30_PAIR_ROLE=peripheral, M30_PAIR_CASE=0, M30_PAIR_IO=0]
    platform_allow: [nrf54l15dk/nrf54l15/cpuapp/nu54dk]
    integration_platforms: [nrf54l15dk/nrf54l15/cpuapp/nu54dk]
  nucode.m30.pair.ni.c:
    tags: [nucode, arduino, m30, bluetooth, security, hil]
    build_only: true
    extra_args: [M30_PAIR_ROLE=central, M30_PAIR_CASE=0, M30_PAIR_IO=0]
    platform_allow: [nrf54l15dk/nrf54l15/cpuapp/nu54dk]
    integration_platforms: [nrf54l15dk/nrf54l15/cpuapp/nu54dk]
  nucode.m30.pair.dk.p:
    tags: [nucode, arduino, m30, bluetooth, security, hil]
    build_only: true
    extra_args: [M30_PAIR_ROLE=peripheral, M30_PAIR_CASE=1, M30_PAIR_IO=1]
    platform_allow: [nrf54l15dk/nrf54l15/cpuapp/nu54dk]
    integration_platforms: [nrf54l15dk/nrf54l15/cpuapp/nu54dk]
  nucode.m30.pair.dk.c:
    tags: [nucode, arduino, m30, bluetooth, security, hil]
    build_only: true
    extra_args: [M30_PAIR_ROLE=central, M30_PAIR_CASE=1, M30_PAIR_IO=2]
    platform_allow: [nrf54l15dk/nrf54l15/cpuapp/nu54dk]
    integration_platforms: [nrf54l15dk/nrf54l15/cpuapp/nu54dk]
  nucode.m30.pair.kd.p:
    tags: [nucode, arduino, m30, bluetooth, security, hil]
    build_only: true
    extra_args: [M30_PAIR_ROLE=peripheral, M30_PAIR_CASE=2, M30_PAIR_IO=2]
    platform_allow: [nrf54l15dk/nrf54l15/cpuapp/nu54dk]
    integration_platforms: [nrf54l15dk/nrf54l15/cpuapp/nu54dk]
  nucode.m30.pair.kd.c:
    tags: [nucode, arduino, m30, bluetooth, security, hil]
    build_only: true
    extra_args: [M30_PAIR_ROLE=central, M30_PAIR_CASE=2, M30_PAIR_IO=1]
    platform_allow: [nrf54l15dk/nrf54l15/cpuapp/nu54dk]
    integration_platforms: [nrf54l15dk/nrf54l15/cpuapp/nu54dk]
  nucode.m30.pair.yn.p:
    tags: [nucode, arduino, m30, bluetooth, security, hil]
    build_only: true
    extra_args: [M30_PAIR_ROLE=peripheral, M30_PAIR_CASE=3, M30_PAIR_IO=3]
    platform_allow: [nrf54l15dk/nrf54l15/cpuapp/nu54dk]
    integration_platforms: [nrf54l15dk/nrf54l15/cpuapp/nu54dk]
  nucode.m30.pair.yn.c:
    tags: [nucode, arduino, m30, bluetooth, security, hil]
    build_only: true
    extra_args: [M30_PAIR_ROLE=central, M30_PAIR_CASE=3, M30_PAIR_IO=3]
    platform_allow: [nrf54l15dk/nrf54l15/cpuapp/nu54dk]
    integration_platforms: [nrf54l15dk/nrf54l15/cpuapp/nu54dk]
  nucode.m30.pair.kdf.p:
    tags: [nucode, arduino, m30, bluetooth, security, hil]
    build_only: true
    extra_args: [M30_PAIR_ROLE=peripheral, M30_PAIR_CASE=4, M30_PAIR_IO=4]
    platform_allow: [nrf54l15dk/nrf54l15/cpuapp/nu54dk]
    integration_platforms: [nrf54l15dk/nrf54l15/cpuapp/nu54dk]
  nucode.m30.pair.kdf.c:
    tags: [nucode, arduino, m30, bluetooth, security, hil]
    build_only: true
    extra_args: [M30_PAIR_ROLE=central, M30_PAIR_CASE=4, M30_PAIR_IO=4]
    platform_allow: [nrf54l15dk/nrf54l15/cpuapp/nu54dk]
    integration_platforms: [nrf54l15dk/nrf54l15/cpuapp/nu54dk]
```

## tests/zephyr/m30_ble_profile_hil/testcase.yaml
```yaml
tests:
  nucode.m30.profile.p:
    tags: [nucode, arduino, m30, bluetooth, profile, hil]
    build_only: true
    extra_args: [M30_PROFILE_ROLE=peripheral]
    platform_allow: [nrf54l15dk/nrf54l15/cpuapp/nu54dk]
    integration_platforms: [nrf54l15dk/nrf54l15/cpuapp/nu54dk]
  nucode.m30.profile.c:
    tags: [nucode, arduino, m30, bluetooth, profile, hil]
    build_only: true
    extra_args: [M30_PROFILE_ROLE=central]
    platform_allow: [nrf54l15dk/nrf54l15/cpuapp/nu54dk]
    integration_platforms: [nrf54l15dk/nrf54l15/cpuapp/nu54dk]
```

## tests/zephyr/m30_mcuboot_hil/testcase.yaml
```yaml
tests:
  nucode.m30.mcuboot_hil:
    tags:
      - nucode
      - m30
      - mcuboot
      - hil
    platform_allow:
      - nrf54l15dk/nrf54l15/cpuapp/nu54dk
    sysbuild: true
    integration_platforms:
      - nrf54l15dk/nrf54l15/cpuapp/nu54dk
```

## tests/zephyr/m31_ble_capability/testcase.yaml
```yaml
tests:
  nucode.m31.ble_capability:
    tags:
      - nucode
      - arduino
      - m31
      - bluetooth
      - capability
      - hil
    build_only: true
    platform_allow:
      - nrf54l15dk/nrf54l15/cpuapp/nu54dk
    integration_platforms:
      - nrf54l15dk/nrf54l15/cpuapp/nu54dk
  nucode.m31.ble_capability.iso:
    tags:
      - nucode
      - arduino
      - m31
      - bluetooth
      - iso
    build_only: true
    platform_allow:
      - nrf54l15dk/nrf54l15/cpuapp/nu54dk
    integration_platforms:
      - nrf54l15dk/nrf54l15/cpuapp/nu54dk
    extra_args:
      - EXTRA_CONF_FILE=iso.conf
  nucode.m31.ble_capability.cs:
    tags:
      - nucode
      - arduino
      - m31
      - bluetooth
      - channel_sounding
    build_only: true
    platform_allow:
      - nrf54l15dk/nrf54l15/cpuapp/nu54dk
    integration_platforms:
      - nrf54l15dk/nrf54l15/cpuapp/nu54dk
    extra_args:
      - EXTRA_CONF_FILE=cs.conf
  nucode.m31.ble_capability.df_tx:
    tags:
      - nucode
      - arduino
      - m31
      - bluetooth
      - direction_finding
    build_only: true
    platform_allow:
      - nrf54l15dk/nrf54l15/cpuapp/nu54dk
    integration_platforms:
      - nrf54l15dk/nrf54l15/cpuapp/nu54dk
    extra_args:
      - EXTRA_CONF_FILE=df_tx.conf
  nucode.m31.ble_capability.df_iq_ll:
    tags:
      - nucode
      - arduino
      - m31
      - bluetooth
      - direction_finding
      - candidate
    build_only: true
    platform_allow:
      - nrf54l15dk/nrf54l15/cpuapp/nu54dk
    integration_platforms:
      - nrf54l15dk/nrf54l15/cpuapp/nu54dk
    extra_args:
      - EXTRA_CONF_FILE=df_iq_ll.conf
      - SNIPPET=bt-ll-sw-split
```

## tests/zephyr/m31_df_iq_candidate/testcase.yaml
```yaml
tests:
  nucode.m31.df_iq_candidate:
    tags:
      - nucode
      - arduino
      - m31
      - bluetooth
      - direction_finding
    build_only: true
    platform_allow:
      - nrf54l15dk/nrf54l15/cpuapp/nu54dk
    integration_platforms:
      - nrf54l15dk/nrf54l15/cpuapp/nu54dk
    extra_args:
      - SNIPPET=bt-ll-sw-split
```

## tests/zephyr/m31_iso_bis_hil/testcase.yaml
```yaml
common:
  platform_allow:
    - nrf54l15dk/nrf54l15/cpuapp/nu54dk
  build_only: true
  tags:
    - bluetooth
    - m31
    - bis
tests:
  nucode.m31.iso_bis.source:
    extra_args:
      - M31_BIS_ROLE=source
      - EXTRA_CONF_FILE=source.conf
  nucode.m31.iso_bis.receiver:
    extra_args:
      - M31_BIS_ROLE=receiver
      - EXTRA_CONF_FILE=receiver.conf
  nucode.m31.iso_time.sender:
    extra_args:
      - M31_BIS_ROLE=source
      - M31_BIS_TIME_SYNC=1
      - EXTRA_CONF_FILE=source.conf
  nucode.m31.iso_time.receiver:
    extra_args:
      - M31_BIS_ROLE=receiver
      - M31_BIS_TIME_SYNC=1
      - EXTRA_CONF_FILE=receiver.conf
  nucode.m31.iso_bis_encrypted.source:
    extra_args:
      - M31_BIS_ROLE=source
      - M31_BIS_ENCRYPTED=1
      - EXTRA_CONF_FILE=source.conf
  nucode.m31.iso_bis_encrypted.receiver:
    extra_args:
      - M31_BIS_ROLE=receiver
      - M31_BIS_ENCRYPTED=1
      - EXTRA_CONF_FILE=receiver.conf
```

## tests/zephyr/m31_iso_cis_hil/testcase.yaml
```yaml
tests:
  nucode.m31.iso_cis.central:
    tags:
      - nucode
      - arduino
      - m31
      - bluetooth
      - iso
      - hil
    build_only: true
    platform_allow:
      - nrf54l15dk/nrf54l15/cpuapp/nu54dk
    integration_platforms:
      - nrf54l15dk/nrf54l15/cpuapp/nu54dk
    extra_args:
      - M31_ISO_ROLE=central
  nucode.m31.iso_cis.peripheral:
    tags:
      - nucode
      - arduino
      - m31
      - bluetooth
      - iso
      - hil
    build_only: true
    platform_allow:
      - nrf54l15dk/nrf54l15/cpuapp/nu54dk
    integration_platforms:
      - nrf54l15dk/nrf54l15/cpuapp/nu54dk
    extra_args:
      - M31_ISO_ROLE=peripheral
```

## tests/zephyr/m31_iso_combined_hil/testcase.yaml
```yaml
tests:
  nucode.m31.iso_combined.central:
    tags:
      - nucode
      - arduino
      - m31
      - bluetooth
      - iso
      - combined
    build_only: true
    platform_allow:
      - nrf54l15dk/nrf54l15/cpuapp/nu54dk
```

## tests/zephyr/m32_ble_advertising_contract/testcase.yaml
```yaml
tests:
  nucode.m32.ble.advertising.contract:
    platform_allow:
      - nrf54l15dk/nrf54l15/cpuapp/nu54dk
    integration_platforms:
      - nrf54l15dk/nrf54l15/cpuapp/nu54dk
    tags:
      - nucode
      - m32
      - bluetooth
```
