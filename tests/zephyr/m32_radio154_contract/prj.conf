## CMakeLists.txt
```
# SPDX-License-Identifier: MIT

cmake_minimum_required(VERSION 3.20.0)

find_package(Zephyr REQUIRED HINTS $ENV{ZEPHYR_BASE})
project(nucode_m32_radio154_contract)

get_filename_component(NUCODE_ROOT "${CMAKE_CURRENT_LIST_DIR}/../../.." ABSOLUTE)
target_sources(app PRIVATE
    src/main.cpp
    "${NUCODE_ROOT}/libraries/NUCODE_Radio_IEEE802154/src/NUCODE_Radio_IEEE802154.cpp"
)
target_include_directories(app PRIVATE
    "${NUCODE_ROOT}/libraries/NUCODE_Radio_IEEE802154/src"
)
```

## prj.conf
```kconfig
# SPDX-License-Identifier: MIT

CONFIG_CPP=y
CONFIG_STD_CPP17=y
CONFIG_CPP_EXCEPTIONS=n
CONFIG_CPP_RTTI=n
CONFIG_NUCODE_ARDUINO_CORE=y
CONFIG_NUCODE_ARDUINO_RUNTIME=n
CONFIG_NUCODE_ARDUINO_API=y
CONFIG_NUCODE_ARDUINO_GPIO=n
CONFIG_NUCODE_ARDUINO_INTERRUPTS=n
CONFIG_NUCODE_ARDUINO_TIME=n
CONFIG_NUCODE_ARDUINO_SERIAL=n
CONFIG_NUCODE_ARDUINO_WIRE=n
CONFIG_NUCODE_ARDUINO_SPI=n
CONFIG_NUCODE_ARDUINO_ADC=n
CONFIG_NUCODE_ARDUINO_PWM=n
CONFIG_NUCODE_RADIO_IEEE802154=y
CONFIG_NRF_802154_RADIO_DRIVER=y
CONFIG_NRF_802154_DRV_REINIT_ENABLED=y
CONFIG_NRF_802154_ENCRYPTION=n
CONFIG_NRF_802154_TX_DIAGNOSTIC_MODE=y
CONFIG_SYSTEM_WORKQUEUE_STACK_SIZE=2048
```

## src/main.cpp
```c
/**
 * @file main.cpp
 * @brief M32-W09 IEEE 802.15.4 공개 API target compile 계약입니다.
 *
 * SPDX-License-Identifier: MIT
 */

#include <NUCODE_Radio_IEEE802154.h>

/** @brief 공개 구조와 bounded lifecycle signature를 target compiler로 확인합니다. */
int main()
{
    nucode::radio154::Configuration configuration{};
    nucode::radio154::Packet packet{};
    const std::uint8_t payload[] = {0x4EU, 0x55U};
    volatile bool execute_contract = false;
    if (execute_contract)
    {
        static_cast<void>(NUCODERadio154.begin(nucode::radio154::Role::transmitter,
                                               configuration));
        static_cast<void>(NUCODERadio154.send(1U, payload, sizeof(payload)));
        static_cast<void>(NUCODERadio154.available());
        static_cast<void>(NUCODERadio154.read(packet));
        static_cast<void>(NUCODERadio154.cancel());
        static_cast<void>(NUCODERadio154.busy());
        static_cast<void>(NUCODERadio154.statistics());
        static_cast<void>(NUCODERadio154.lastError());
        static_cast<void>(NUCODERadio154.lastDriverError());
        static_cast<void>(NUCODERadio154.stop());
    }
    return 0;
}
```
