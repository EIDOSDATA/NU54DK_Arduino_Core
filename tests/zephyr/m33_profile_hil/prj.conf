## CMakeLists.txt
```
# SPDX-License-Identifier: MIT
cmake_minimum_required(VERSION 3.20.0)
# sysbuild 상위 cache의 역할을 Kconfig 병합 전에 읽습니다.
find_package(Zephyr REQUIRED COMPONENTS extensions basic_settings HINTS $ENV{ZEPHYR_BASE})
zephyr_get(M33_PROFILE_ROLE)
zephyr_get(M33_PROFILE_FAMILY)
zephyr_get(USE_CCACHE)
if(NOT M33_PROFILE_FAMILY)
    set(M33_PROFILE_FAMILY standard)
endif()
if(NOT M33_PROFILE_FAMILY MATCHES "^(standard|native)$")
    message(FATAL_ERROR "M33_PROFILE_FAMILY must be standard or native")
endif()
get_filename_component(NUCODE_ROOT "${CMAKE_CURRENT_LIST_DIR}/../../.." ABSOLUTE)
list(APPEND EXTRA_CONF_FILE "${NUCODE_ROOT}/libraries/NUCODE_BLE_Security/zephyr/ble-security.conf")
list(APPEND EXTRA_DTC_OVERLAY_FILE "${CMAKE_CURRENT_LIST_DIR}/app.overlay")
if(M33_PROFILE_FAMILY STREQUAL "native")
    list(APPEND EXTRA_CONF_FILE "${CMAKE_CURRENT_LIST_DIR}/native.conf")
    if(M33_PROFILE_ROLE MATCHES "^(client|watcher)$")
        list(APPEND EXTRA_CONF_FILE "${CMAKE_CURRENT_LIST_DIR}/native-client.conf")
    endif()
endif()
find_package(Zephyr REQUIRED HINTS $ENV{ZEPHYR_BASE})
project(nucode_m33_profile_hil)
if(NOT M33_PROFILE_ROLE MATCHES "^(server|client|watcher)$")
    message(FATAL_ERROR "M33_PROFILE_ROLE must be server, client or watcher")
endif()
execute_process(COMMAND git -C "${NUCODE_ROOT}" rev-parse HEAD
    OUTPUT_VARIABLE revision OUTPUT_STRIP_TRAILING_WHITESPACE COMMAND_ERROR_IS_FATAL ANY)
file(GLOB gap_sources CONFIGURE_DEPENDS "${NUCODE_ROOT}/libraries/NUCODE_BLE/src/internal/gap/*.cpp")
file(GLOB gatt_sources CONFIGURE_DEPENDS "${NUCODE_ROOT}/libraries/NUCODE_BLE/src/internal/gatt/*.cpp")
file(GLOB security_sources CONFIGURE_DEPENDS "${NUCODE_ROOT}/libraries/NUCODE_BLE_Security/src/internal/security/*.cpp")
file(GLOB profile_sources CONFIGURE_DEPENDS "${NUCODE_ROOT}/libraries/NUCODE_BLE_Profiles/src/*.cpp")
target_sources(app PRIVATE src/main.cpp ${gap_sources} ${gatt_sources} ${security_sources} ${profile_sources}
    "${NUCODE_ROOT}/libraries/NUCODE_BLE/src/NUCODE_BLE_GAP.cpp"
    "${NUCODE_ROOT}/libraries/NUCODE_BLE/src/NUCODE_BLE_GATT.cpp"
    "${NUCODE_ROOT}/libraries/NUCODE_BLE/src/internal/NUCODE_BLE_Stack.cpp"
    "${NUCODE_ROOT}/libraries/NUCODE_BLE_Security/src/NUCODE_BLE_Security.cpp"
    "${NUCODE_ROOT}/libraries/NUCODE_BLE_Security/src/internal/NUCODE_BLE_HidsBackend.c"
    "${NUCODE_ROOT}/libraries/NUCODE_BLE_Security/src/internal/NUCODE_BLE_ProfilesBackend.c")
target_include_directories(app PRIVATE
    "${NUCODE_ROOT}/libraries/NUCODE_BLE/src"
    "${NUCODE_ROOT}/libraries/NUCODE_BLE_Security/src"
    "${NUCODE_ROOT}/libraries/NUCODE_BLE_Profiles/src")
target_compile_definitions(app PRIVATE M33_PROFILE_CORE_REVISION="${revision}" M33_PROFILE_ROLE="${M33_PROFILE_ROLE}")
if(M33_PROFILE_ROLE STREQUAL "server")
    target_compile_definitions(app PRIVATE M33_PROFILE_SERVER=1)
elseif(M33_PROFILE_ROLE STREQUAL "watcher")
    if(M33_PROFILE_FAMILY STREQUAL "native")
        target_compile_definitions(app PRIVATE M33_PROFILE_SECOND_PEER=1)
    else()
        target_compile_definitions(app PRIVATE M33_PROFILE_WATCHER=1)
    endif()
endif()
if(M33_PROFILE_FAMILY STREQUAL "native")
    target_compile_definitions(app PRIVATE M33_PROFILE_NATIVE=1)
    target_sources(app PRIVATE src/BackendSecurityTrace.cpp)
    target_link_options(app PUBLIC -Wl,--wrap=bt_conn_security_changed)
endif()
```

## prj.conf
```kconfig
# SPDX-License-Identifier: MIT
CONFIG_CPP=y
CONFIG_STD_CPP17=y
CONFIG_CPP_EXCEPTIONS=n
CONFIG_CPP_RTTI=n
CONFIG_NUCODE_ARDUINO_CORE=y
CONFIG_NUCODE_ARDUINO_RUNTIME=y
CONFIG_NUCODE_ARDUINO_API=y
CONFIG_NUCODE_ARDUINO_GPIO=n
CONFIG_NUCODE_ARDUINO_INTERRUPTS=n
CONFIG_NUCODE_ARDUINO_TIME=y
CONFIG_NUCODE_ARDUINO_SERIAL=y
CONFIG_NUCODE_ARDUINO_WIRE=n
CONFIG_NUCODE_ARDUINO_SPI=n
CONFIG_NUCODE_ARDUINO_ADC=n
CONFIG_NUCODE_ARDUINO_PWM=n
CONFIG_BT=y
CONFIG_BT_PERIPHERAL=y
CONFIG_BT_CENTRAL=y
CONFIG_BT_OBSERVER=y
CONFIG_BT_GATT_CLIENT=y
CONFIG_BT_GATT_DYNAMIC_DB=y
CONFIG_BT_GATT_AUTO_DISCOVER_CCC=y
CONFIG_BT_MAX_CONN=2
CONFIG_BT_CTLR_SDC_PERIPHERAL_COUNT=1
CONFIG_BT_DEVICE_NAME_DYNAMIC=y
CONFIG_BT_DEVICE_NAME_MAX=32
CONFIG_BT_SMP=y
CONFIG_BT_SMP_APP_PAIRING_ACCEPT=y
CONFIG_BT_BONDABLE=y
CONFIG_BT_SETTINGS=y
CONFIG_NUCODE_BLE_CORE=y
CONFIG_NUCODE_BLE_GATT=y
CONFIG_NUCODE_BLE_CORE_EVENT_QUEUE_SIZE=32
CONFIG_NUCODE_BLE_SCAN_RESULT_QUEUE_SIZE=16
CONFIG_NUCODE_BLE_GATT_SERVER=y
CONFIG_NUCODE_BLE_GATT_CLIENT=y
CONFIG_NUCODE_BLE_GATT_MAX_SERVICES=8
CONFIG_NUCODE_BLE_GATT_MAX_CHARACTERISTICS_PER_SERVICE=8
CONFIG_NUCODE_BLE_GATT_EVENT_QUEUE_SIZE=32
CONFIG_HEAP_MEM_POOL_SIZE=4096
CONFIG_COMMON_LIBC_MALLOC_ARENA_SIZE=8192
CONFIG_MAIN_STACK_SIZE=8192
CONFIG_SYSTEM_WORKQUEUE_STACK_SIZE=3072
CONFIG_BOOT_BANNER=n
CONFIG_NCS_BOOT_BANNER=n
CONFIG_LOG=n
CONFIG_WATCHDOG=y
```

## native-client.conf
```kconfig
# SPDX-License-Identifier: MIT
CONFIG_BT_PERIPHERAL=n
CONFIG_BT_CTLR_SDC_PERIPHERAL_COUNT=0
```

## native.conf
```kconfig
# SPDX-License-Identifier: MIT
CONFIG_BT_MAX_CONN=1
CONFIG_BT_FIXED_PASSKEY=y
CONFIG_BT_OTS=y
CONFIG_BT_GATT_AUTHORIZATION_CUSTOM=y
CONFIG_BT_OTS_CLIENT=y
CONFIG_BT_OTS_L2CAP_CHAN_TX_MTU=64
CONFIG_BT_OTS_L2CAP_CHAN_RX_MTU=64
CONFIG_BT_OTS_MAX_OBJ_CNT=4
CONFIG_BT_OTS_OBJ_MAX_NAME_LEN=32
CONFIG_BT_OTS_OACP_CREATE_SUPPORT=y
CONFIG_BT_OTS_OACP_DELETE_SUPPORT=y
CONFIG_BT_OTS_OACP_WRITE_SUPPORT=y
CONFIG_BT_OTS_OACP_PATCH_SUPPORT=y
CONFIG_BT_OTS_OBJ_NAME_WRITE_SUPPORT=y
CONFIG_BT_OTS_OLCP_GO_TO_SUPPORT=y
CONFIG_BT_CGMS=y
CONFIG_BT_CGMS_MAX_MEASUREMENT_RECORD=16
```

## app.overlay
```dts
/** @brief 시험 command lease와 cleanup timeout을 WDT30으로 제한합니다. */
&wdt30
{
    status = "okay";
};
```

## src/BackendSecurityTrace.cpp
```c
/** @file @brief 원형 보안 callback을 그대로 전달하며 첫 실패의 축약 전 인수를 기록합니다.
 * SPDX-License-Identifier: MIT
 */
#include "BackendSecurityTrace.h"

#include <zephyr/bluetooth/conn.h>
#include <zephyr/kernel.h>

namespace
{
    k_spinlock trace_lock;
    BackendSecurityTrace trace{};
} // namespace

BackendSecurityTrace backendSecurityTraceSnapshot() noexcept
{
    const k_spinlock_key_t key = k_spin_lock(&trace_lock);
    const BackendSecurityTrace snapshot = trace;
    k_spin_unlock(&trace_lock, key);
    return snapshot;
}

extern "C" void __real_bt_conn_security_changed(bt_conn *connection, uint8_t hci_reason,
                                                bt_security_err error);

/** @brief 같은 인수로 원형을 한 번 호출하며 보안 수준·retry·timeout을 변경하지 않습니다. */
extern "C" __attribute__((noinline)) void
__wrap_bt_conn_security_changed(bt_conn *connection, uint8_t hci_reason, bt_security_err error)
{
    const uintptr_t caller = reinterpret_cast<uintptr_t>(__builtin_return_address(0));
    const k_spinlock_key_t key = k_spin_lock(&trace_lock);
    ++trace.calls;
    if (hci_reason != 0U || error != BT_SECURITY_ERR_SUCCESS)
    {
        if (trace.failures == 0U)
        {
            trace.first_hci_reason = hci_reason;
            trace.first_security_error = static_cast<uint8_t>(error);
            trace.first_caller = caller;
        }
        ++trace.failures;
    }
    k_spin_unlock(&trace_lock, key);
    __real_bt_conn_security_changed(connection, hci_reason, error);
}
```

## src/BackendSecurityTrace.h
```c
/** @file @brief 보안 실패의 원형 backend 인수와 호출 위치를 보존합니다.
 * SPDX-License-Identifier: MIT
 */
#pragma once

#include <stdint.h>

/** @brief 판정에 사용하지 않는 부팅 이후 보안 callback 진단입니다. */
struct BackendSecurityTrace
{
    uint32_t calls;
    uint32_t failures;
    uint8_t first_hci_reason;
    uint8_t first_security_error;
    uintptr_t first_caller;
};

/** @brief UART 출력 없이 잠금 아래 일관된 진단 사본을 반환합니다. */
BackendSecurityTrace backendSecurityTraceSnapshot() noexcept;
```

## src/ExpectedCgms.h
```c
/** @file @brief 고정 NCS CGMS 제어 응답을 Host와 target에서 동일하게 판정합니다.
 * SPDX-License-Identifier: MIT
 */
#pragma once
#include <cstddef>
#include <cstdint>

/** @brief NCS 3.4.0은 read interval 응답에 opcode + LE16 값을 사용합니다. */
inline bool expectedCgmsInterval(const std::uint8_t *data, std::size_t length) noexcept
{
    return data != nullptr && length == 3U && data[0] == 3U && data[1] == 1U && data[2] == 0U;
}
```

## src/ExpectedReject.h
```c
/** @file @brief 한 요청의 GAP·상세 ATT 오류를 순서와 무관하게 한 번씩 결합합니다.
 * SPDX-License-Identifier: MIT
 */
#pragma once
#include <stdint.h>

/** @brief token의 link generation과 단계를 고정하고 두 callback 사이를 100ms로 제한합니다. */
template <typename Handle> class ExpectedReject
{
  public:
    bool begin(Handle handle, unsigned index, unsigned phase, int driver, unsigned att)
    {
        if (active_)
        {
            return false;
        }
        handle_ = handle;
        index_ = index;
        phase_ = phase;
        driver_ = driver;
        att_ = att;
        gap_ = false;
        detail_ = false;
        active_ = true;
        return true;
    }
    bool active() const
    {
        return active_;
    }
    bool matched() const
    {
        return active_ && gap_ && detail_;
    }
    bool expired(uint32_t now) const
    {
        return active_ && (gap_ || detail_) && now - first_at_ > 100U;
    }
    bool gap(Handle handle, unsigned index, unsigned phase, int driver, unsigned att, uint32_t now)
    {
        return accept(true, handle, index, phase, driver, att, now);
    }
    bool detail(Handle handle, unsigned index, unsigned phase, int status, unsigned att,
                uint32_t now)
    {
        if (status != (att_ != 0U ? -static_cast<int>(att_) : driver_))
        {
            return false;
        }
        return accept(false, handle, index, phase, driver_, att, now);
    }
    bool finish()
    {
        if (!matched())
        {
            return false;
        }
        active_ = false;
        return true;
    }
    /** @brief 정상 write ACK는 오류 callback을 하나도 소비하지 않은 token만 닫습니다. */
    bool acknowledge()
    {
        if (!active_ || gap_ || detail_)
        {
            return false;
        }
        active_ = false;
        return true;
    }

  private:
    bool accept(bool gap, Handle handle, unsigned index, unsigned phase, int driver, unsigned att,
                uint32_t now)
    {
        if (!active_ || handle != handle_ || index != index_ || phase != phase_ ||
            driver != driver_ || att != att_ || expired(now) || (gap ? gap_ : detail_))
        {
            return false;
        }
        if (!gap_ && !detail_)
        {
            first_at_ = now;
        }
        if (gap)
        {
            gap_ = true;
        }
        else
        {
            detail_ = true;
        }
        return true;
    }
    Handle handle_{};
    unsigned index_ = 0U, phase_ = 0U, att_ = 0U;
    int driver_ = 0;
    uint32_t first_at_ = 0U;
    bool active_ = false, gap_ = false, detail_ = false;
};
```
