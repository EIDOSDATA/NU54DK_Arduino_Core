## CMakeLists.txt
```
# SPDX-License-Identifier: MIT

cmake_minimum_required(VERSION 3.20.0)

find_package(Zephyr REQUIRED HINTS $ENV{ZEPHYR_BASE})

project(nucode_df_receiver_probe)

target_sources(app PRIVATE src/main.c)
```

## prj.conf
```kconfig
# SPDX-License-Identifier: MIT

CONFIG_BT=y
CONFIG_BT_EXT_ADV=y
CONFIG_BT_PER_ADV_SYNC=y
CONFIG_BT_OBSERVER=y
CONFIG_BT_DF=y
CONFIG_BT_DF_CONNECTIONLESS_CTE_RX=y
CONFIG_BT_CTLR_DF=y
CONFIG_BT_CTLR_DF_SCAN_CTE_RX=y
CONFIG_BT_CTLR_DF_ANT_SWITCH_RX=n
CONFIG_BT_CTLR_DF_ANT_SWITCH_TX=n
CONFIG_BT_CTLR_TIFS_HW=n

CONFIG_BOOT_BANNER=n
CONFIG_NCS_BOOT_BANNER=n
CONFIG_LOG=n
CONFIG_MAIN_STACK_SIZE=4096
CONFIG_THREAD_NAME=y
CONFIG_THREAD_ANALYZER=y
CONFIG_THREAD_ANALYZER_RUN_UNLOCKED=y
CONFIG_SYS_HEAP_RUNTIME_STATS=y
```

## src/main.c
```c
/**
 * @file main.c
 * @brief 고정 SDK의 기본 안테나 CTE 수신 가능성을 분리 진단합니다.
 *
 * SPDX-License-Identifier: MIT
 */

#include <errno.h>
#include <stdint.h>
#include <string.h>

#include <zephyr/bluetooth/bluetooth.h>
#include <zephyr/bluetooth/direction.h>
#include <zephyr/bluetooth/gap.h>
#include <zephyr/debug/thread_analyzer.h>
#include <zephyr/device.h>
#include <zephyr/drivers/uart.h>
#include <zephyr/kernel.h>
#include <zephyr/sys/printk.h>
#include <sys_malloc.h>

#define PEER_NAME "NU54-CTE"
#define PEER_NAME_LENGTH (sizeof(PEER_NAME) - 1U)

static K_SEM_DEFINE(advertisement_found, 0, 1);
static K_SEM_DEFINE(sync_finished, 0, 1);

static bt_addr_le_t peer_address;
static uint8_t peer_sid;
static uint16_t peer_interval;
static bool peer_selected;
static bool sync_established;
static struct bt_le_per_adv_sync *periodic_sync;
static uint32_t iq_reports;
static uint32_t iq_samples;

/** @brief 정지 뒤 thread별 stack 예약량과 최고 사용량을 출력합니다. */
static void report_thread(struct thread_analyzer_info *info)
{
    printk("P2_STACK name=%s reserved=%u used=%u\n", info->name,
           (unsigned int)info->stack_size, (unsigned int)info->stack_used);
}

/** @brief 성공·timeout 양쪽의 관찰 범위를 분리해 기록합니다. */
static void report_memory(void)
{
    printk("DF_CL|STATS|reports=%u|samples=%u\n", iq_reports, iq_samples);
    printk("P2_PHASE name=stopped\n");
    thread_analyzer_run(report_thread, 0U);
    struct sys_memory_stats stats = {0};
    if (malloc_runtime_stats_get(&stats) == 0)
    {
        printk("P2_MALLOC free=%u allocated=%u peak=%u\n",
               (unsigned int)stats.free_bytes,
               (unsigned int)stats.allocated_bytes,
               (unsigned int)stats.max_allocated_bytes);
    }
}

/** @brief 광고 이름이 지정한 송신자와 일치하는지 확인합니다. */
static bool inspect_data(struct bt_data *data, void *user_data)
{
    bool *matched = user_data;
    if ((data->type == BT_DATA_NAME_COMPLETE) &&
        (data->data_len == PEER_NAME_LENGTH) &&
        (memcmp(data->data, PEER_NAME, PEER_NAME_LENGTH) == 0))
    {
        *matched = true;
    }
    return true;
}

/** @brief 대상 periodic 광고 하나의 주소와 SID만 고정합니다. */
static void on_scan(const struct bt_le_scan_recv_info *info, struct net_buf_simple *buffer)
{
    bool matched = false;
    if (peer_selected || (info->interval == 0U))
    {
        return;
    }
    bt_data_parse(buffer, inspect_data, &matched);
    if (!matched)
    {
        return;
    }

    bt_addr_le_copy(&peer_address, info->addr);
    peer_sid = info->sid;
    peer_interval = info->interval;
    peer_selected = true;
    printk("M31_RX|1|ADVERTISER|interval=%u|sid=%u|rssi=%d\n",
           peer_interval, peer_sid, info->rssi);
    k_sem_give(&advertisement_found);
}

/** @brief controller가 periodic sync를 수립한 시점을 기록합니다. */
static void on_synced(struct bt_le_per_adv_sync *sync,
                      struct bt_le_per_adv_sync_synced_info *info)
{
    ARG_UNUSED(sync);
    sync_established = true;
    printk("M31_RX|1|SYNCED|interval=%u|phy=%u\n", info->interval, info->phy);
    k_sem_give(&sync_finished);
}

/** @brief controller가 periodic sync를 종료한 시점을 기록합니다. */
static void on_terminated(struct bt_le_per_adv_sync *sync,
                          const struct bt_le_per_adv_sync_term_info *info)
{
    ARG_UNUSED(sync);
    ARG_UNUSED(info);
    printk("M31_RX|1|SYNC_LOST\n");
    k_sem_give(&sync_finished);
}

/** @brief 실제 controller IQ report의 형식과 개수를 기록합니다. */
static void on_iq(struct bt_le_per_adv_sync *sync,
                  const struct bt_df_per_adv_sync_iq_samples_report *report)
{
    ARG_UNUSED(sync);
    ++iq_reports;
    iq_samples += report->sample_count;
    printk("M31_RX|1|IQ|count=%u|type=%u|status=%u|rssi=%d\n",
           report->sample_count, report->cte_type, report->packet_status, report->rssi);
}

static struct bt_le_scan_cb scan_callbacks = {
    .recv = on_scan,
};

static struct bt_le_per_adv_sync_cb sync_callbacks = {
    .synced = on_synced,
    .term = on_terminated,
    .cte_report_cb = on_iq,
};

/** @brief 송신 광고, periodic sync, 공개 AoA RX API를 차례로 확인합니다. */
int main(void)
{
    const struct device *console = DEVICE_DT_GET(DT_CHOSEN(zephyr_console));
    int result = bt_enable(NULL);
    if (result != 0)
    {
        printk("M31_RX|1|ERROR|stage=bluetooth|code=%d\n", result);
        return 0;
    }

    bt_le_scan_cb_register(&scan_callbacks);
    bt_le_per_adv_sync_cb_register(&sync_callbacks);
    const struct bt_le_scan_param scan_parameters = {
        .type = BT_LE_SCAN_TYPE_ACTIVE,
        .options = BT_LE_SCAN_OPT_FILTER_DUPLICATE,
        .interval = BT_GAP_SCAN_FAST_INTERVAL,
        .window = BT_GAP_SCAN_FAST_WINDOW,
    };
    result = bt_le_scan_start(&scan_parameters, NULL);
    if (result != 0)
    {
        printk("M31_RX|1|ERROR|stage=scan|code=%d\n", result);
        return 0;
    }
    printk("M31_RX|1|SCANNING\n");
    printk("P2_READY role=df-connectionless-receiver\n");

    if (k_sem_take(&advertisement_found, K_SECONDS(30)) != 0)
    {
        printk("M31_RX|1|ERROR|stage=advertiser_timeout|code=%d\n", -ETIMEDOUT);
        return 0;
    }

    struct bt_le_per_adv_sync_param sync_parameters = {};
    bt_addr_le_copy(&sync_parameters.addr, &peer_address);
    sync_parameters.options = BT_LE_PER_ADV_SYNC_OPT_SYNC_ONLY_CONST_TONE_EXT;
    sync_parameters.sid = peer_sid;
    sync_parameters.skip = 0U;
    sync_parameters.timeout = (uint16_t)CLAMP(
        BT_GAP_US_TO_PER_ADV_SYNC_TIMEOUT(
            BT_GAP_PER_ADV_INTERVAL_TO_US(peer_interval)) * 7U,
        BT_GAP_PER_ADV_MIN_TIMEOUT, BT_GAP_PER_ADV_MAX_TIMEOUT);
    result = bt_le_per_adv_sync_create(&sync_parameters, &periodic_sync);
    printk("M31_RX|1|SYNC_CREATE|code=%d|timeout_10ms=%u\n",
           result, sync_parameters.timeout);
    if (result != 0)
    {
        return 0;
    }
    if ((k_sem_take(&sync_finished, K_MSEC((uint32_t)sync_parameters.timeout * 10U + 2000U)) != 0) ||
        !sync_established)
    {
        printk("M31_RX|1|SYNC_TIMEOUT\n");
    }
    else
    {
        const uint8_t antennas[] = {1U, 2U};
        const struct bt_df_per_adv_sync_cte_rx_param cte_parameters = {
            .max_cte_count = 5U,
            .cte_types = BT_DF_CTE_TYPE_AOA,
            .slot_durations = BT_HCI_LE_ANTENNA_SWITCHING_SLOT_2US,
            .num_ant_ids = ARRAY_SIZE(antennas),
            .ant_ids = antennas,
        };
        result = bt_df_per_adv_sync_cte_rx_enable(periodic_sync, &cte_parameters);
        printk("M31_RX|1|CTE_ENABLE|code=%d\n", result);
    }
    while (true)
    {
        uint8_t command = 0U;
        if ((uart_poll_in(console, &command) == 0) && (command == 's'))
        {
            int disable_result = 0;
            int delete_result = 0;
            if (sync_established)
            {
                disable_result = bt_df_per_adv_sync_cte_rx_disable(periodic_sync);
                delete_result = bt_le_per_adv_sync_delete(periodic_sync);
            }
            const int scan_result = bt_le_scan_stop();
            printk("DF_CL|CLEANUP|disable=%d|delete=%d|scan=%d\n",
                   disable_result, delete_result, scan_result);
            report_memory();
            printk("P2_STOP role=df-connectionless-receiver\n");
            break;
        }
        k_sleep(K_MSEC(10));
    }
    return 0;
}
```
