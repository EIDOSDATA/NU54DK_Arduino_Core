## tests/zephyr/v04_t13_hil/testcase.yaml
```yaml
tests:
  nucode.v04.t13_s_dut:
    platform_allow: nrf54l15dk/nrf54l15/cpuapp/nu54dk
    build_only: true
    tags: [nucode, v04, hil, t13]
    extra_configs:
      - CONFIG_NUCODE_V04_HIL_ROLE=1
      - CONFIG_NUCODE_T13_HARNESS=2
  nucode.v04.t13_s_peer:
    platform_allow: nrf54l15dk/nrf54l15/cpuapp/nu54dk
    build_only: true
    tags: [nucode, v04, hil, t13]
    extra_configs:
      - CONFIG_NUCODE_V04_HIL_ROLE=2
      - CONFIG_NUCODE_T13_HARNESS=2
  nucode.v04.t13_u_dut:
    platform_allow: nrf54l15dk/nrf54l15/cpuapp/nu54dk
    build_only: true
    tags: [nucode, v04, hil, t13]
    extra_configs:
      - CONFIG_NUCODE_V04_HIL_ROLE=1
      - CONFIG_NUCODE_T13_HARNESS=3
  nucode.v04.t13_u_peer:
    platform_allow: nrf54l15dk/nrf54l15/cpuapp/nu54dk
    build_only: true
    tags: [nucode, v04, hil, t13]
    extra_configs:
      - CONFIG_NUCODE_V04_HIL_ROLE=2
      - CONFIG_NUCODE_T13_HARNESS=3
  nucode.v04.t13_power_s_dut:
    platform_allow: nrf54l15dk/nrf54l15/cpuapp/nu54dk
    build_only: true
    tags: [nucode, v04, hil, t13, power]
    extra_args: EXTRA_DTC_OVERLAY_FILE=power.overlay
    extra_configs:
      - CONFIG_NUCODE_V04_HIL_ROLE=1
      - CONFIG_NUCODE_T13_HARNESS=2
      - CONFIG_NUCODE_T13_POWER=y
  nucode.v04.t13_power_s_peer:
    platform_allow: nrf54l15dk/nrf54l15/cpuapp/nu54dk
    build_only: true
    tags: [nucode, v04, hil, t13, power]
    extra_args: EXTRA_DTC_OVERLAY_FILE=power.overlay
    extra_configs:
      - CONFIG_NUCODE_V04_HIL_ROLE=2
      - CONFIG_NUCODE_T13_HARNESS=2
      - CONFIG_NUCODE_T13_POWER=y
```

## zephyr/Kconfig
```kconfig
menu "NUCODE Arduino Core"

config NUCODE_ARDUINO_CORE
	bool "NUCODE Arduino Core 런타임 활성화"
	depends on CPP
	depends on STD_CPP_VERSION >= 201703
	help
	  Loader 없이 하나의 Zephyr 애플리케이션 이미지에 Arduino 호환
	  setup()/loop() 런타임을 링크합니다. 이 옵션은 기본적으로 비활성화되며,
	  애플리케이션이 C++17 이상의 표준을 명시해야 합니다.

	  setup()/loop() 런타임 자체는 동적 메모리를 할당하지 않습니다.
	  ArduinoCore-API String을 활성화하면 별도로 제한된 common libc malloc
	  arena를 사용합니다. 그 밖의 힙 크기는 최종 애플리케이션의 Kconfig가
	  소유합니다. 예외와 RTTI의 기본 검증값은 비활성이지만 Core가
	  구조적으로 금지하지 않습니다.

config NUCODE_M30_POWER_HIL_MCUBOOT
	bool "M30 전원 손실 HIL용 MCUboot swap 관찰 창"
	depends on MCUBOOT_ACTION_HOOKS
	help
	  M30-POWER-01 전원 시험용 MCUboot image에서 test swap 직전의
	  유한 전원 차단 창을 보고합니다. 일반 Arduino Core image에서는
	  사용하지 않으며 전원 시험용 sysbuild 설정만 활성화합니다.

if NUCODE_ARDUINO_CORE

rsource "config/core.Kconfig"

rsource "config/serial.Kconfig"

rsource "config/analog_fabric.Kconfig"

rsource "config/event.Kconfig"

rsource "config/stream.Kconfig"

rsource "config/system.Kconfig"

rsource "config/buses.Kconfig"

rsource "config/analog.Kconfig"

rsource "config/ble.Kconfig"

rsource "config/scheduler.Kconfig"

endif

config COMMON_LIBC_MALLOC_ARENA_SIZE
	default 8192 if NUCODE_ARDUINO_API

endmenu
```
