## CMakeLists.txt
```
# SPDX-License-Identifier: MIT

cmake_minimum_required(VERSION 3.20.0)

find_package(Zephyr REQUIRED HINTS $ENV{ZEPHYR_BASE})
project(nucode_m32_ble_nordic_contract)

get_filename_component(NUCODE_ROOT "${CMAKE_CURRENT_LIST_DIR}/../../.." ABSOLUTE)
target_sources(app PRIVATE
    src/main.cpp
    "${NUCODE_ROOT}/libraries/NUCODE_BLE/src/NUCODE_BLE_GAP.cpp"
    "${NUCODE_ROOT}/libraries/NUCODE_BLE/src/internal/gap/GapValues.cpp"
    "${NUCODE_ROOT}/libraries/NUCODE_BLE/src/internal/gap/GapAdvertising.cpp"
    "${NUCODE_ROOT}/libraries/NUCODE_BLE/src/internal/gap/GapExtendedAdvertising.cpp"
    "${NUCODE_ROOT}/libraries/NUCODE_BLE/src/internal/gap/GapPeriodicAdvertising.cpp"
    "${NUCODE_ROOT}/libraries/NUCODE_BLE/src/internal/gap/GapPawr.cpp"
    "${NUCODE_ROOT}/libraries/NUCODE_BLE/src/internal/gap/GapScanning.cpp"
    "${NUCODE_ROOT}/libraries/NUCODE_BLE/src/internal/gap/GapConnection.cpp"
    "${NUCODE_ROOT}/libraries/NUCODE_BLE/src/internal/gap/GapNordic.cpp"
    "${NUCODE_ROOT}/libraries/NUCODE_BLE/src/internal/NUCODE_BLE_Stack.cpp"
)
target_include_directories(app PRIVATE
    "${NUCODE_ROOT}/libraries/NUCODE_BLE/src"
)
```

## prj.conf
```kconfig
# SPDX-License-Identifier: MIT

CONFIG_CPP=y
CONFIG_STD_CPP17=y
CONFIG_CPP_EXCEPTIONS=n
CONFIG_CPP_RTTI=n

CONFIG_NUCODE_ARDUINO_CORE=y
CONFIG_NUCODE_ARDUINO_RUNTIME=n
CONFIG_NUCODE_ARDUINO_API=y
CONFIG_NUCODE_ARDUINO_GPIO=n
CONFIG_NUCODE_ARDUINO_INTERRUPTS=n
CONFIG_NUCODE_ARDUINO_TIME=n
CONFIG_NUCODE_ARDUINO_SERIAL=n
CONFIG_NUCODE_ARDUINO_WIRE=n
CONFIG_NUCODE_ARDUINO_SPI=n
CONFIG_NUCODE_ARDUINO_ADC=n
CONFIG_NUCODE_ARDUINO_PWM=n

CONFIG_BT=y
CONFIG_BT_PERIPHERAL=y
CONFIG_BT_CENTRAL=y
CONFIG_BT_MAX_CONN=2
CONFIG_BT_CTLR_SDC_PERIPHERAL_COUNT=1
CONFIG_BT_DEVICE_NAME_DYNAMIC=y
CONFIG_BT_DEVICE_NAME_MAX=32
CONFIG_BT_USER_PHY_UPDATE=y
CONFIG_BT_AUTO_PHY_CENTRAL_NONE=y
CONFIG_BT_AUTO_PHY_PERIPHERAL_NONE=y
CONFIG_BT_EXT_ADV=y
CONFIG_BT_EXT_ADV_MAX_ADV_SET=1

CONFIG_BT_CTLR_SDC_LLPM=y
CONFIG_BT_CTLR_SDC_QOS_CONN_EVENT_REPORT=y
CONFIG_BT_CTLR_SDC_QOS_CHANNEL_SURVEY=y
CONFIG_BT_CTLR_SDC_CONN_ANCHOR_POINT_REPORT=y
CONFIG_BT_CTLR_SDC_EVENT_TRIGGER=y
CONFIG_BT_HCI_VS_EVT_USER=y
CONFIG_BT_RADIO_NOTIFICATION_CONN_CB=y
CONFIG_BT_CTLR_EXTENDED_FEAT_SET=y
CONFIG_BT_CTLR_LE_FLUSHABLE_ACL_DATA=y

CONFIG_NUCODE_BLE_CORE=y
CONFIG_NUCODE_BLE_CORE_EVENT_QUEUE_SIZE=24
CONFIG_NUCODE_BLE_NORDIC_EXTENSIONS=y
CONFIG_NUCODE_BLE_NORDIC_REPORT_QUEUE_SIZE=16
CONFIG_HEAP_MEM_POOL_SIZE=4096
CONFIG_SYSTEM_WORKQUEUE_STACK_SIZE=2048
```

## src/main.cpp
```c
/** @file @brief M32-W05 Nordic extension 공개 API의 target link 계약을 검사합니다. */
#include <NUCODE_BLE_GAP.h>

using namespace nucode::ble;

/** @brief callback signature를 target compiler에 고정합니다. */
void onConnectionEvent(const BLENordicConnectionEventReport &, void *)
{
}

/** @brief callback signature를 target compiler에 고정합니다. */
void onChannelSurvey(const BLENordicChannelSurveyReport &, void *)
{
}

/** @brief callback signature를 target compiler에 고정합니다. */
void onAnchorPoint(const BLENordicAnchorPointReport &, void *)
{
}

/** @brief Nordic profile의 모든 공개 entry point를 link합니다. */
int main()
{
    BLENordic.onConnectionEvent(onConnectionEvent);
    BLENordic.onChannelSurvey(onChannelSurvey);
    BLENordic.onAnchorPoint(onAnchorPoint);

    BLENordicAnchorPointReport anchor;
    std::uint64_t projected = 0U;
    static_cast<void>(BLENordic.projectAnchorPoint(anchor, 1U, 7500U, projected));
    static_cast<void>(BLENordic.availableConnectionEventReports());
    static_cast<void>(BLENordic.availableChannelSurveyReports());
    static_cast<void>(BLENordic.availableAnchorPointReports());
    static_cast<void>(BLENordic.droppedReports());
    static_cast<void>(BLENordic.flushableAclSupport());
    return 0;
}
```
