## CMakeLists.txt
```
# SPDX-License-Identifier: MIT

cmake_minimum_required(VERSION 3.20.0)

find_package(Zephyr REQUIRED HINTS $ENV{ZEPHYR_BASE})
project(nucode_m32_ble_timing_contract)

get_filename_component(NUCODE_ROOT "${CMAKE_CURRENT_LIST_DIR}/../../.." ABSOLUTE)
target_sources(app PRIVATE
    src/main.cpp
    "${NUCODE_ROOT}/libraries/NUCODE_BLE/src/NUCODE_BLE_GAP.cpp"
    "${NUCODE_ROOT}/libraries/NUCODE_BLE/src/internal/gap/GapValues.cpp"
    "${NUCODE_ROOT}/libraries/NUCODE_BLE/src/internal/gap/GapAdvertising.cpp"
    "${NUCODE_ROOT}/libraries/NUCODE_BLE/src/internal/gap/GapExtendedAdvertising.cpp"
    "${NUCODE_ROOT}/libraries/NUCODE_BLE/src/internal/gap/GapPeriodicAdvertising.cpp"
    "${NUCODE_ROOT}/libraries/NUCODE_BLE/src/internal/gap/GapPawr.cpp"
    "${NUCODE_ROOT}/libraries/NUCODE_BLE/src/internal/gap/GapScanning.cpp"
    "${NUCODE_ROOT}/libraries/NUCODE_BLE/src/internal/gap/GapConnection.cpp"
    "${NUCODE_ROOT}/libraries/NUCODE_BLE/src/internal/NUCODE_BLE_Stack.cpp"
)
target_include_directories(app PRIVATE
    "${NUCODE_ROOT}/libraries/NUCODE_BLE/src"
)
```

## prj.conf
```kconfig
# SPDX-License-Identifier: MIT

CONFIG_CPP=y
CONFIG_STD_CPP17=y
CONFIG_CPP_EXCEPTIONS=n
CONFIG_CPP_RTTI=n

CONFIG_NUCODE_ARDUINO_CORE=y
CONFIG_NUCODE_ARDUINO_RUNTIME=n
CONFIG_NUCODE_ARDUINO_API=y
CONFIG_NUCODE_ARDUINO_GPIO=n
CONFIG_NUCODE_ARDUINO_INTERRUPTS=n
CONFIG_NUCODE_ARDUINO_TIME=n
CONFIG_NUCODE_ARDUINO_SERIAL=n
CONFIG_NUCODE_ARDUINO_WIRE=n
CONFIG_NUCODE_ARDUINO_SPI=n
CONFIG_NUCODE_ARDUINO_ADC=n
CONFIG_NUCODE_ARDUINO_PWM=n

CONFIG_BT=y
CONFIG_BT_PERIPHERAL=y
CONFIG_BT_CENTRAL=y
CONFIG_BT_MAX_CONN=2
CONFIG_BT_CTLR_SDC_PERIPHERAL_COUNT=1
CONFIG_BT_DEVICE_NAME_DYNAMIC=y
CONFIG_BT_DEVICE_NAME_MAX=32
CONFIG_BT_GATT_CLIENT=y
CONFIG_BT_SUBRATING=y
CONFIG_BT_SCA_UPDATE=y
CONFIG_BT_LE_EXTENDED_FEAT_SET=y
CONFIG_BT_FRAME_SPACE_UPDATE=y
CONFIG_BT_SHORTER_CONNECTION_INTERVALS=y

CONFIG_NUCODE_BLE_CORE=y
CONFIG_NUCODE_BLE_CORE_EVENT_QUEUE_SIZE=24
CONFIG_NUCODE_BLE_SCAN_RESULT_QUEUE_SIZE=8
CONFIG_HEAP_MEM_POOL_SIZE=4096
CONFIG_SYSTEM_WORKQUEUE_STACK_SIZE=2048
CONFIG_COMMON_LIBC_MALLOC_ARENA_SIZE=8192
```

## src/main.cpp
```c
/**
 * @file main.cpp
 * @brief M32 최신 연결 timing·feature 공개 API의 target link 계약입니다.
 *
 * SPDX-License-Identifier: MIT
 */

#include <NUCODE_BLE_GAP.h>

#include <cstdint>

static_assert(CONFIG_BT_MAX_CONN == 2);
static_assert(CONFIG_BT_SUBRATING == 1);
static_assert(CONFIG_BT_SCA_UPDATE == 1);
static_assert(CONFIG_BT_LE_EXTENDED_FEAT_SET == 1);
static_assert(CONFIG_BT_FRAME_SPACE_UPDATE == 1);
static_assert(CONFIG_BT_SHORTER_CONNECTION_INTERVALS == 1);

int main()
{
    nucode::ble::BLEConnectionHandle connection;
    nucode::ble::BLESubrateParameters subrate_parameters;
    nucode::ble::BLESubrateInfo subrate_information;
    nucode::ble::BLEConnectionRateParameters rate_parameters;
    nucode::ble::BLEConnectionRateInfo rate_information;
    nucode::ble::BLEFrameSpaceParameters frame_parameters;
    nucode::ble::BLEFrameSpaceInfo frame_information;
    nucode::ble::BLEExtendedFeatureSet local_features;
    nucode::ble::BLEExtendedFeatureSet remote_features;
    std::uint16_t minimum_interval_us = 0U;
    const std::uint8_t channel_map[5] = {0xffU, 0xffU, 0xffU, 0xffU, 0x1fU};

    static_cast<void>(BLEConnection.setDefaultSubrate(subrate_parameters));
    static_cast<void>(BLEConnection.requestSubrate(connection, subrate_parameters));
    static_cast<void>(BLEConnection.subrate(connection, subrate_information));
    static_cast<void>(BLEConnection.setDefaultConnectionRate(rate_parameters));
    static_cast<void>(BLEConnection.requestConnectionRate(connection, rate_parameters));
    static_cast<void>(BLEConnection.connectionRate(connection, rate_information));
    static_cast<void>(BLEConnection.minimumConnectionInterval(minimum_interval_us));
    static_cast<void>(BLEConnection.requestFrameSpace(connection, frame_parameters));
    static_cast<void>(BLEConnection.frameSpace(connection, frame_information));
    static_cast<void>(BLEConnection.localExtendedFeatures(local_features));
    static_cast<void>(BLEConnection.requestRemoteExtendedFeatures(connection));
    static_cast<void>(BLEConnection.remoteExtendedFeatures(connection, remote_features));
    static_cast<void>(BLEConnection.sleepClockAccuracySupport());
    static_cast<void>(BLEConnection.setChannelClassification(channel_map));
    return 0;
}
```
