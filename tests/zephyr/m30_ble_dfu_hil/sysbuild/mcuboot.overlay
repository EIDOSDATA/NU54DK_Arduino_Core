/**
 * @file mcuboot.overlay
 * @brief M30 secure BLE DFU가 사용하는 내부 flash boot partition을 선택합니다.
 *
 * SPDX-License-Identifier: MIT
 */

/ {
	chosen {
		zephyr,code-partition = &boot_partition;
	};
};

/** @brief 앱 전환 중에도 DAPLink VCOM 속도를 DFU relay와 일치시킵니다. */
&uart20 {
	current-speed = <460800>;
};
