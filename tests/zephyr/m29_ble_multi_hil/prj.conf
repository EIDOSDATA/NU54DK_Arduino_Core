## CMakeLists.txt
```
# SPDX-License-Identifier: MIT

cmake_minimum_required(VERSION 3.20.0)

find_package(Zephyr REQUIRED HINTS $ENV{ZEPHYR_BASE})
project(nucode_m29_ble_multi_hil)

zephyr_get(M29_MULTI_ROLE)
get_filename_component(NUCODE_ROOT "${CMAKE_CURRENT_LIST_DIR}/../../.." ABSOLUTE)

# @brief W07-D protocol과 build record에 결합할 exact Core revision을 읽습니다.
execute_process(
  COMMAND git -c "safe.directory=${NUCODE_ROOT}" -C "${NUCODE_ROOT}" rev-parse HEAD
  RESULT_VARIABLE revision_result
  OUTPUT_VARIABLE M29_MULTI_CORE_REVISION
  ERROR_VARIABLE revision_error
  OUTPUT_STRIP_TRAILING_WHITESPACE
)
string(LENGTH "${M29_MULTI_CORE_REVISION}" revision_length)
if(NOT revision_result EQUAL 0 OR NOT revision_length EQUAL 40 OR
   NOT M29_MULTI_CORE_REVISION MATCHES "^[0-9a-f]+$")
  message(FATAL_ERROR "M29 W07-D Core revision query failed: ${revision_error}")
endif()

target_sources(app PRIVATE
  src/main.cpp
  "${NUCODE_ROOT}/libraries/NUCODE_BLE/src/NUCODE_BLE_GAP.cpp"
  "${NUCODE_ROOT}/libraries/NUCODE_BLE/src/internal/gap/GapValues.cpp"
  "${NUCODE_ROOT}/libraries/NUCODE_BLE/src/internal/gap/GapAdvertising.cpp"
  "${NUCODE_ROOT}/libraries/NUCODE_BLE/src/internal/gap/GapExtendedAdvertising.cpp"
  "${NUCODE_ROOT}/libraries/NUCODE_BLE/src/internal/gap/GapPeriodicAdvertising.cpp"
  "${NUCODE_ROOT}/libraries/NUCODE_BLE/src/internal/gap/GapPawr.cpp"
  "${NUCODE_ROOT}/libraries/NUCODE_BLE/src/internal/gap/GapScanning.cpp"
  "${NUCODE_ROOT}/libraries/NUCODE_BLE/src/internal/gap/GapConnection.cpp"
  "${NUCODE_ROOT}/libraries/NUCODE_BLE/src/NUCODE_BLE_GATT.cpp"
  "${NUCODE_ROOT}/libraries/NUCODE_BLE/src/internal/gatt/GattDatabase.cpp"
  "${NUCODE_ROOT}/libraries/NUCODE_BLE/src/internal/gatt/GattCache.cpp"
  "${NUCODE_ROOT}/libraries/NUCODE_BLE/src/internal/gatt/GattServer.cpp"
  "${NUCODE_ROOT}/libraries/NUCODE_BLE/src/internal/gatt/GattClient.cpp"
  "${NUCODE_ROOT}/libraries/NUCODE_BLE/src/NUCODE_BLE_L2CAP.cpp"
  "${NUCODE_ROOT}/libraries/NUCODE_BLE/src/internal/NUCODE_BLE_Stack.cpp"
)
target_include_directories(app PRIVATE
  "${NUCODE_ROOT}/libraries/NUCODE_BLE/src"
)
target_compile_definitions(app PRIVATE
  M29_MULTI_CORE_REVISION="${M29_MULTI_CORE_REVISION}"
)

if("${M29_MULTI_ROLE}" STREQUAL "peripheral")
  target_compile_definitions(app PRIVATE NUCODE_M29_MULTI_PERIPHERAL=1)
elseif("${M29_MULTI_ROLE}" STREQUAL "mixed")
  target_compile_definitions(app PRIVATE NUCODE_M29_MULTI_MIXED=1)
elseif("${M29_MULTI_ROLE}" STREQUAL "central")
  target_compile_definitions(app PRIVATE NUCODE_M29_MULTI_CENTRAL=1)
else()
  message(FATAL_ERROR "M29_MULTI_ROLE must be peripheral, mixed, or central")
endif()
```

## prj.conf
```kconfig
# SPDX-License-Identifier: MIT

CONFIG_CPP=y
CONFIG_STD_CPP17=y
CONFIG_CPP_EXCEPTIONS=n
CONFIG_CPP_RTTI=n

CONFIG_NUCODE_ARDUINO_CORE=y
CONFIG_NUCODE_ARDUINO_RUNTIME=y
CONFIG_NUCODE_ARDUINO_API=y
CONFIG_NUCODE_ARDUINO_GPIO=n
CONFIG_NUCODE_ARDUINO_INTERRUPTS=n
CONFIG_NUCODE_ARDUINO_TIME=y
CONFIG_NUCODE_ARDUINO_SERIAL=y
CONFIG_NUCODE_ARDUINO_WIRE=n
CONFIG_NUCODE_ARDUINO_SPI=n
CONFIG_NUCODE_ARDUINO_ADC=n
CONFIG_NUCODE_ARDUINO_PWM=n

CONFIG_BT=y
CONFIG_BT_PERIPHERAL=y
CONFIG_BT_CENTRAL=y
CONFIG_BT_OBSERVER=y
CONFIG_BT_MAX_CONN=2
CONFIG_BT_CTLR_SDC_PERIPHERAL_COUNT=1
CONFIG_BT_DEVICE_NAME_DYNAMIC=y
CONFIG_BT_DEVICE_NAME_MAX=32
CONFIG_BT_GATT_CLIENT=y
CONFIG_BT_GATT_DYNAMIC_DB=y
CONFIG_BT_SMP=y
CONFIG_BT_BUF_ACL_RX_SIZE=251
CONFIG_BT_BUF_ACL_TX_SIZE=251
CONFIG_BT_L2CAP_DYNAMIC_CHANNEL=y
CONFIG_BT_L2CAP_TX_MTU=512
CONFIG_BT_L2CAP_TX_BUF_COUNT=4
CONFIG_BT_ATT_TX_COUNT=4
CONFIG_BT_ATT_PREPARE_COUNT=2

CONFIG_NUCODE_BLE_CORE=y
CONFIG_NUCODE_BLE_NUS=n
CONFIG_NUCODE_BLE_CORE_EVENT_QUEUE_SIZE=32
CONFIG_NUCODE_BLE_SCAN_RESULT_QUEUE_SIZE=8
CONFIG_NUCODE_BLE_GATT=y
CONFIG_NUCODE_BLE_GATT_MAX_SERVICES=2
CONFIG_NUCODE_BLE_GATT_MAX_CHARACTERISTICS_PER_SERVICE=4
CONFIG_NUCODE_BLE_GATT_EVENT_QUEUE_SIZE=32
CONFIG_NUCODE_BLE_L2CAP=y
CONFIG_NUCODE_BLE_L2CAP_EVENT_QUEUE_SIZE=24

CONFIG_BOOT_BANNER=n
CONFIG_NCS_BOOT_BANNER=n
CONFIG_LOG=n
CONFIG_HEAP_MEM_POOL_SIZE=8192
CONFIG_COMMON_LIBC_MALLOC_ARENA_SIZE=8192
CONFIG_MAIN_STACK_SIZE=8192
CONFIG_SYSTEM_WORKQUEUE_STACK_SIZE=4096
```

## src/main.cpp
```c
/**
 * @file main.cpp
 * @brief 세 NU54DK에서 두 link의 GATT·LE CoC 동시 traffic을 검증합니다.
 *
 * SPDX-License-Identifier: MIT
 */

#include <Arduino.h>
#include <NUCODE_BLE.h>

#include <zephyr/bluetooth/bluetooth.h>
#include <zephyr/bluetooth/hci_types.h>
#include <zephyr/kernel.h>

#include "M29MultiPayload.h"

#include <cstddef>
#include <cstdint>
#include <string.h>

#ifndef M29_MULTI_CORE_REVISION
#error "M29_MULTI_CORE_REVISION is required"
#endif

static_assert(CONFIG_BT_MAX_CONN == 2);
static_assert(CONFIG_BT_CTLR_SDC_PERIPHERAL_COUNT == 1);
static_assert(CONFIG_BT_L2CAP_DYNAMIC_CHANNEL == 1);
static_assert(nucode::ble::L2capCoc::maximum_channels == 2U);
static_assert(nucode::ble::L2capCoc::transmit_buffers == 4U);

namespace
{

    using MultiPayload = nucode::test::m29::MultiPayload;

    constexpr char protocol[] = "M29W07D|1";
    constexpr char ready_query[] = "M29W07D|1|READY?";
    constexpr char start_prefix[] = "M29W07D|1|START|test=M29-MULTI-01|nonce=";
    constexpr char stop_prefix[] = "M29W07D|1|STOP|nonce=";
    constexpr char core_suffix[] = "|core=" M29_MULTI_CORE_REVISION;
    constexpr char service_text[] = "90bf2a40-14f5-4d3d-92c7-299334932a20";
    constexpr char characteristic_text[] = "90bf2a41-14f5-4d3d-92c7-299334932a20";
    constexpr std::uint16_t company_id = 0x29a7U;
    constexpr std::uint16_t coc_psm = 0x0081U;
    constexpr std::uint32_t required_operations = 1000U;
    constexpr std::int64_t session_timeout_ms = 900000;
    constexpr std::int64_t cleanup_timeout_ms = 30000;
    constexpr std::int64_t cleanup_quiet_ms = 1000;
    constexpr std::uint8_t peripheral_marker = 0xa1U;
    constexpr std::uint8_t mixed_marker = 0xb2U;

    const nucode::ble::BLEUuid service_uuid(service_text);
    const nucode::ble::BLEUuid characteristic_uuid(characteristic_text);
    nucode::ble::BLEService test_service(service_uuid);
    nucode::ble::BLECharacteristic test_characteristic(
        characteristic_uuid, nucode::ble::BLEProperty::write,
        nucode::ble::BLEPermission::write, MultiPayload::payload_length);

    char command[160] = {};
    std::size_t command_length = 0U;
    char nonce[MultiPayload::nonce_text_length + 1U] = {};
    std::uint8_t nonce_binary[MultiPayload::nonce_binary_length] = {};
    std::uint8_t gatt_payload[MultiPayload::payload_length] = {};
    std::uint8_t coc_payload[MultiPayload::payload_length] = {};
    bool session_started = false;
    bool session_finished = false;
    bool cleanup_requested = false;
    bool cleanup_started = false;
    bool callback_context_valid = true;
    bool peer_found = false;
    bool scan_started = false;
    bool client_discovered = false;
    bool client_channel_connected = false;
    bool server_channel_connected = false;
    bool advertising_started = false;
    [[maybe_unused]] bool mixed_advertising_started = false;
    bool link_reported = false;
    bool traffic_started = false;
    bool gatt_inflight = false;
    bool coc_waiting_for_echo = false;
    bool server_echo_pending = false;
    std::int64_t session_deadline = 0;
    std::int64_t cleanup_deadline = 0;
    std::int64_t cleanup_quiet_since = 0;
    std::uint32_t progress_reported = 0U;
    std::uint32_t client_gatt_completed = 0U;
    std::uint32_t client_coc_sent = 0U;
    std::uint32_t client_coc_received = 0U;
    std::uint32_t server_gatt_received = 0U;
    std::uint32_t server_coc_received = 0U;
    std::uint32_t server_coc_sent = 0U;
    std::uint32_t cross_link_events = 0U;
    std::uint32_t payload_errors = 0U;
    nucode::ble::BLEAddress peer_address;
    nucode::ble::BLEConnectionHandle client_connection;
    nucode::ble::BLEConnectionHandle server_connection;
    nucode::ble::BLEL2capChannelHandle client_channel;
    nucode::ble::BLEL2capChannelHandle server_channel;
    nucode::ble::BLEL2capStatistics session_statistics_base;
    struct k_thread *setup_thread = nullptr;

#include "M29MultiProtocol.inc"
#include "M29MultiRadio.inc"
#include "M29MultiTraffic.inc"
#include "M29MultiEvents.inc"
#include "M29MultiCommand.inc"

} // namespace

void setup()
{
    setup_thread = k_current_get();
    Serial.begin(115200);
    const std::int64_t deadline = k_uptime_get() + 5000;
    while (!Serial && k_uptime_get() < deadline)
    {
        delay(10);
    }
    if (hasServer())
    {
        test_characteristic.onEvent(onCharacteristicEvent);
        if (!test_service.addCharacteristic(test_characteristic) ||
            !BLEDevice.addService(test_service))
        {
            fail("schema");
            return;
        }
    }
    BLEDevice.onEventInfo(onBleEvent);
    BLEL2cap.onEvent(onL2capEvent);
    if (hasClient())
    {
        BLEScan.onResult(onScanResult);
        BLEClient.onDetailedEvent(onClientEvent);
    }
    if (!BLEDevice.begin(roleName()))
    {
        fail("device_begin", BLEDevice.lastDriverError());
        return;
    }
    printReady();
}

void loop()
{
    pollHostCommand();
    BLEDevice.poll();
    driveCleanup();
    if (!session_started || session_finished)
    {
        delay(1);
        return;
    }
    if (peer_found && scan_started)
    {
        peer_found = false;
        scan_started = false;
        if (!BLEScan.stop() || !BLEConnection.connect(peer_address, client_connection))
        {
            fail("connect_start", BLEDevice.lastDriverError());
        }
    }
    issueClientTraffic();
    printProgress();
    finishIfComplete();
    if (!session_finished && k_uptime_get() >= session_deadline)
    {
        fail("timeout");
    }
    delay(1);
}
```

## src/M29MultiPayload.h
```c
/**
 * @file M29MultiPayload.h
 * @brief M29 3보드 통합 시험의 link 식별 payload를 생성하고 검증합니다.
 *
 * SPDX-License-Identifier: MIT
 */

#pragma once

#include <cstddef>
#include <cstdint>
#include <string.h>

namespace nucode::test::m29
{

    /** @brief GATT와 CoC가 공통으로 사용하는 고정 payload codec입니다. */
    class MultiPayload final
    {
      public:
        static constexpr std::size_t nonce_text_length = 32U;
        static constexpr std::size_t nonce_binary_length = 16U;
        static constexpr std::size_t payload_length = 20U;
        static constexpr std::uint8_t gatt_kind = 0x47U;
        static constexpr std::uint8_t coc_kind = 0x4cU;

        /** @brief 128-bit lowercase hex nonce를 고정 binary buffer로 변환합니다. */
        [[nodiscard]] static bool decodeNonce(const char *text,
                                              std::uint8_t output[nonce_binary_length]) noexcept
        {
            if (text == nullptr || output == nullptr || ::strlen(text) != nonce_text_length)
            {
                return false;
            }
            for (std::size_t index = 0U; index < nonce_binary_length; ++index)
            {
                const int high = nibble(text[index * 2U]);
                const int low = nibble(text[index * 2U + 1U]);
                if (high < 0 || low < 0)
                {
                    return false;
                }
                output[index] = static_cast<std::uint8_t>((high << 4U) | low);
            }
            return true;
        }

        /** @brief link marker·종류·sequence·nonce로 검증 가능한 payload를 만듭니다. */
        static void build(std::uint8_t output[payload_length], std::uint8_t marker,
                          std::uint8_t kind, std::uint32_t sequence,
                          const std::uint8_t nonce[nonce_binary_length]) noexcept
        {
            output[0] = marker;
            output[1] = kind;
            putLe32(output + 2U, sequence);
            for (std::size_t index = 6U; index < payload_length; ++index)
            {
                output[index] = static_cast<std::uint8_t>(
                    nonce[(index + sequence) % nonce_binary_length] ^
                    static_cast<std::uint8_t>(marker + kind + index * 13U + sequence * 7U));
            }
        }

        /** @brief 수신 payload가 기대 link·종류·sequence·nonce와 byte 단위로 일치하는지 확인합니다. */
        [[nodiscard]] static bool valid(const std::uint8_t *data, std::size_t length,
                                        std::uint8_t marker, std::uint8_t kind,
                                        std::uint32_t sequence,
                                        const std::uint8_t nonce[nonce_binary_length]) noexcept
        {
            if (data == nullptr || length != payload_length || data[0] != marker ||
                data[1] != kind || getLe32(data + 2U) != sequence)
            {
                return false;
            }
            std::uint8_t expected[payload_length] = {};
            build(expected, marker, kind, sequence, nonce);
            return ::memcmp(data, expected, payload_length) == 0;
        }

      private:
        /** @brief lowercase hex 한 글자를 0..15로 변환합니다. */
        [[nodiscard]] static int nibble(char value) noexcept
        {
            if (value >= '0' && value <= '9')
            {
                return value - '0';
            }
            if (value >= 'a' && value <= 'f')
            {
                return value - 'a' + 10;
            }
            return -1;
        }

        /** @brief 32-bit sequence를 little-endian으로 기록합니다. */
        static void putLe32(std::uint8_t *output, std::uint32_t value) noexcept
        {
            output[0] = static_cast<std::uint8_t>(value & 0xffU);
            output[1] = static_cast<std::uint8_t>((value >> 8U) & 0xffU);
            output[2] = static_cast<std::uint8_t>((value >> 16U) & 0xffU);
            output[3] = static_cast<std::uint8_t>((value >> 24U) & 0xffU);
        }

        /** @brief little-endian 32-bit sequence를 읽습니다. */
        [[nodiscard]] static std::uint32_t getLe32(const std::uint8_t *input) noexcept
        {
            return static_cast<std::uint32_t>(input[0]) |
                   (static_cast<std::uint32_t>(input[1]) << 8U) |
                   (static_cast<std::uint32_t>(input[2]) << 16U) |
                   (static_cast<std::uint32_t>(input[3]) << 24U);
        }
    };

} // namespace nucode::test::m29
```
