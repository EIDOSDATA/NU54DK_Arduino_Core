## CMakeLists.txt
```
# SPDX-License-Identifier: MIT

cmake_minimum_required(VERSION 3.20.0)

get_filename_component(NUCODE_ROOT "${CMAKE_CURRENT_LIST_DIR}/../../.." ABSOLUTE)
list(APPEND EXTRA_CONF_FILE
  "${NUCODE_ROOT}/libraries/NUCODE_BLE_Security/zephyr/ble-security.conf"
)

find_package(Zephyr REQUIRED HINTS $ENV{ZEPHYR_BASE})
project(nucode_m21_ble_contract)

target_sources(app PRIVATE
  src/main.cpp
  "${NUCODE_ROOT}/libraries/NUCODE_BLE_Security/src/NUCODE_BLE_Security.cpp"
  "${NUCODE_ROOT}/libraries/NUCODE_BLE_Security/src/internal/security/SecurityPairing.cpp"
  "${NUCODE_ROOT}/libraries/NUCODE_BLE_Security/src/internal/security/SecurityOob.cpp"
  "${NUCODE_ROOT}/libraries/NUCODE_BLE_Security/src/internal/security/SecurityBond.cpp"
  "${NUCODE_ROOT}/libraries/NUCODE_BLE_Security/src/internal/security/SecurityHid.cpp"
  "${NUCODE_ROOT}/libraries/NUCODE_BLE_Security/src/internal/security/SecurityBattery.cpp"
  "${NUCODE_ROOT}/libraries/NUCODE_BLE_Security/src/internal/security/SecurityDeviceInformation.cpp"
  "${NUCODE_ROOT}/libraries/NUCODE_BLE_Security/src/internal/NUCODE_BLE_HidsBackend.c"
  "${NUCODE_ROOT}/libraries/NUCODE_BLE/src/internal/NUCODE_BLE_Stack.cpp"
)
target_include_directories(app PRIVATE
  "${NUCODE_ROOT}/libraries/NUCODE_BLE_Security/src"
  "${NUCODE_ROOT}/libraries/NUCODE_BLE/src"
)
```

## prj.conf
```kconfig
CONFIG_CPP=y
CONFIG_STD_CPP17=y
CONFIG_CPP_EXCEPTIONS=n
CONFIG_CPP_RTTI=n

CONFIG_NUCODE_ARDUINO_CORE=y
CONFIG_NUCODE_ARDUINO_RUNTIME=n
CONFIG_NUCODE_ARDUINO_API=y
CONFIG_NUCODE_ARDUINO_GPIO=n
CONFIG_NUCODE_ARDUINO_INTERRUPTS=n
CONFIG_NUCODE_ARDUINO_TIME=n
CONFIG_NUCODE_ARDUINO_SERIAL=n
CONFIG_NUCODE_ARDUINO_WIRE=n
CONFIG_NUCODE_ARDUINO_SPI=n
CONFIG_NUCODE_ARDUINO_ADC=n
CONFIG_NUCODE_ARDUINO_PWM=n

CONFIG_BT=y
CONFIG_BT_PERIPHERAL=y
CONFIG_BT_MAX_CONN=1
CONFIG_BT_DEVICE_NAME_DYNAMIC=y
CONFIG_BT_DEVICE_NAME_MAX=32
CONFIG_HEAP_MEM_POOL_SIZE=4096
CONFIG_COMMON_LIBC_MALLOC_ARENA_SIZE=8192
```

## src/main.cpp
```c
/**
 * @file main.cpp
 * @brief M21 BLE security·BAS·DIS·HID 공개 표면과 NCS backend link를 검증합니다.
 *
 * SPDX-License-Identifier: MIT
 */

#include <NUCODE_BLE_Security.h>
#include <internal/NUCODE_BLE_Internal.h>

#include <cstdint>

/** @brief callback 형식과 event snapshot을 build graph에 고정합니다. */
void onSecurityEvent(const nucode::ble::SecurityEventRecord &event, void *context)
{
    volatile std::uint8_t *observed = static_cast<volatile std::uint8_t *>(context);
    if (observed != nullptr)
    {
        *observed = static_cast<std::uint8_t>(event.event);
    }
}

int main()
{
    volatile std::uint8_t observed = 0U;
    BLESecurity.onEvent(onSecurityEvent, const_cast<std::uint8_t *>(&observed));

    nucode::ble::SecurityConfig config = {};
    config.minimum_level = nucode::ble::SecurityLevel::encrypted;
    static_cast<void>(BLESecurity.begin(config));
    static_cast<void>(BLESecurity.requestSecurity());
    static_cast<void>(BLESecurity.bondCount());
    static_cast<void>(BLESecurity.bondState());
    static_cast<void>(BLESecurity.currentLevel());
    static_cast<void>(BLESecurity.lastError());
    static_cast<void>(BLESecurity.lastDriverError());

    const nucode::ble::DeviceInformation information = {"NUCODE", "NU54DK-M21", "TEST",
                                                        "0.3.0",  "NU54DK",     "0.3.0"};
    static_cast<void>(BLEDeviceInformation.configure(information));
    static_cast<void>(BLEBattery.setLevel(73U));
    static_cast<void>(BLEKeyboard.begin());
    static_cast<void>(BLEKeyboard.press(0x04U));
    static_cast<void>(BLEKeyboard.press(0x66U));
    static_cast<void>(BLEKeyboard.releaseAll());
    return 0;
}
```
