## CMakeLists.txt
```
# SPDX-License-Identifier: MIT

cmake_minimum_required(VERSION 3.20.0)

get_filename_component(NUCODE_ROOT "${CMAKE_CURRENT_LIST_DIR}/../../.." ABSOLUTE)

find_package(Zephyr REQUIRED HINTS $ENV{ZEPHYR_BASE})
project(nucode_m32_mesh_dfu_hil)

zephyr_get(M32_MDFU_ROLE)
zephyr_get(M32_MDFU_CANDIDATE_SHA256)
zephyr_get(M32_MDFU_CANDIDATE_SIZE)

set(m32_mdfu_roles distributor target_a target_b candidate)
if(NOT M32_MDFU_ROLE IN_LIST m32_mdfu_roles)
  message(FATAL_ERROR
    "M32_MDFU_ROLE must be distributor, target_a, target_b, or candidate")
endif()

execute_process(
  COMMAND git -c "safe.directory=${NUCODE_ROOT}" -C "${NUCODE_ROOT}" rev-parse HEAD
  RESULT_VARIABLE revision_result
  OUTPUT_VARIABLE M32_MDFU_CORE_REVISION
  ERROR_VARIABLE revision_error
  OUTPUT_STRIP_TRAILING_WHITESPACE
)
string(LENGTH "${M32_MDFU_CORE_REVISION}" revision_length)
if(NOT revision_result EQUAL 0 OR NOT revision_length EQUAL 40 OR
   NOT M32_MDFU_CORE_REVISION MATCHES "^[0-9a-f]+$")
  message(FATAL_ERROR "M32 MDFU Core revision query failed: ${revision_error}")
endif()

if(NOT "${M32_MDFU_ROLE}" STREQUAL "candidate")
  string(LENGTH "${M32_MDFU_CANDIDATE_SHA256}" candidate_digest_length)
  if(NOT candidate_digest_length EQUAL 64 OR
     NOT M32_MDFU_CANDIDATE_SHA256 MATCHES "^[0-9a-f]+$")
    message(FATAL_ERROR "M32_MDFU_CANDIDATE_SHA256 must be 64 lowercase hex digits")
  endif()
  if(NOT M32_MDFU_CANDIDATE_SIZE MATCHES "^[1-9][0-9]*$")
    message(FATAL_ERROR "M32_MDFU_CANDIDATE_SIZE must be a positive integer")
  endif()
endif()

if("${M32_MDFU_ROLE}" STREQUAL "candidate")
  target_sources(app PRIVATE src/candidate.cpp)
else()
  target_sources(app PRIVATE
    src/main.cpp
    "${NUCODE_ROOT}/libraries/NUCODE_BLE_Mesh/src/NUCODE_BLE_Mesh.cpp"
    "${NUCODE_ROOT}/libraries/NUCODE_BLE_Mesh/src/NUCODE_BLE_Mesh_Composition.c"
    "${NUCODE_ROOT}/libraries/NUCODE_BLE_Mesh_Update/src/NUCODE_BLE_Mesh_Update.cpp"
  )
  target_include_directories(app PRIVATE
    "${NUCODE_ROOT}/libraries/NUCODE_BLE_Mesh/src"
    "${NUCODE_ROOT}/libraries/NUCODE_BLE_Mesh_Update/src"
  )
endif()
target_compile_definitions(app PRIVATE
  M32_MDFU_CORE_REVISION="${M32_MDFU_CORE_REVISION}"
  M32_MDFU_ROLE_NAME="${M32_MDFU_ROLE}"
)

if("${M32_MDFU_ROLE}" STREQUAL "distributor")
  target_compile_definitions(app PRIVATE NUCODE_M32_MDFU_DISTRIBUTOR=1)
elseif("${M32_MDFU_ROLE}" STREQUAL "target_a")
  target_compile_definitions(app PRIVATE NUCODE_M32_MDFU_TARGET_A=1)
elseif("${M32_MDFU_ROLE}" STREQUAL "target_b")
  target_compile_definitions(app PRIVATE NUCODE_M32_MDFU_TARGET_B=1)
else()
  target_compile_definitions(app PRIVATE NUCODE_M32_MDFU_CANDIDATE=1)
endif()

if(NOT "${M32_MDFU_ROLE}" STREQUAL "candidate")
  target_compile_definitions(app PRIVATE
    M32_MDFU_CANDIDATE_SHA256="${M32_MDFU_CANDIDATE_SHA256}"
    M32_MDFU_CANDIDATE_SIZE=${M32_MDFU_CANDIDATE_SIZE}
  )
endif()
```

## prj.conf
```kconfig
# SPDX-License-Identifier: MIT

CONFIG_CPP=y
CONFIG_STD_CPP17=y
CONFIG_CPP_EXCEPTIONS=n
CONFIG_CPP_RTTI=n

CONFIG_NUCODE_ARDUINO_CORE=y
CONFIG_NUCODE_ARDUINO_RUNTIME=y
CONFIG_NUCODE_ARDUINO_API=y
CONFIG_NUCODE_ARDUINO_GPIO=n
CONFIG_NUCODE_ARDUINO_INTERRUPTS=n
CONFIG_NUCODE_ARDUINO_TIME=y
CONFIG_NUCODE_ARDUINO_SERIAL=y
CONFIG_NUCODE_ARDUINO_WIRE=n
CONFIG_NUCODE_ARDUINO_SPI=n
CONFIG_NUCODE_ARDUINO_ADC=n
CONFIG_NUCODE_ARDUINO_PWM=n

CONFIG_SETTINGS=y
CONFIG_SETTINGS_RUNTIME=y
CONFIG_SETTINGS_ZMS=y
CONFIG_SETTINGS_ZMS_LOAD_SUBTREE_PATH=y
CONFIG_FLASH=y
CONFIG_FLASH_MAP=y
CONFIG_ZMS=y

CONFIG_BOOTLOADER_MCUBOOT=y
CONFIG_STREAM_FLASH=y
CONFIG_IMG_MANAGER=y
CONFIG_MCUBOOT_IMG_MANAGER=y
CONFIG_IMG_ENABLE_IMAGE_CHECK=y
CONFIG_MCUBOOT_IMGTOOL_SIGN_VERSION="0.0.0+0"
CONFIG_MCUBOOT_EXTRA_IMGTOOL_ARGS="--security-counter 1"
CONFIG_REBOOT=y

CONFIG_SYSTEM_WORKQUEUE_STACK_SIZE=4800
CONFIG_HEAP_MEM_POOL_SIZE=8192
CONFIG_COMMON_LIBC_MALLOC_ARENA_SIZE=8192
CONFIG_MAIN_STACK_SIZE=8192
CONFIG_BOOT_BANNER=n
CONFIG_NCS_BOOT_BANNER=n
CONFIG_LOG=n
```

## candidate.conf
```kconfig
# SPDX-License-Identifier: MIT

CONFIG_MCUBOOT_IMGTOOL_SIGN_VERSION="2.0.0+0"
CONFIG_MCUBOOT_EXTRA_IMGTOOL_ARGS="--security-counter 2"

# Candidate는 UART boot·confirm·rollback oracle만 포함합니다.
```

## mesh.conf
```kconfig
# SPDX-License-Identifier: MIT

CONFIG_BT=y
CONFIG_BT_CENTRAL=y
CONFIG_BT_PERIPHERAL=y
CONFIG_BT_OBSERVER=y
CONFIG_BT_BROADCASTER=y
CONFIG_BT_MAX_CONN=2
CONFIG_BT_CTLR_SDC_PERIPHERAL_COUNT=1
CONFIG_BT_BUF_ACL_TX_COUNT=8
CONFIG_BT_BUF_ACL_RX_COUNT_EXTRA=7
CONFIG_BT_RX_STACK_SIZE=5120
CONFIG_BT_SETTINGS=y

CONFIG_BT_MESH=y
CONFIG_BT_MESH_PB_ADV=y
CONFIG_BT_MESH_PB_GATT=y
CONFIG_BT_MESH_PB_GATT_CLIENT=y
CONFIG_BT_MESH_PROXY_CLIENT=y
CONFIG_BT_MESH_PROVISIONER=y
CONFIG_BT_MESH_CDB=y
CONFIG_BT_MESH_CDB_KEY_SYNC=y
CONFIG_BT_MESH_CDB_NODE_COUNT=3
CONFIG_BT_MESH_CDB_APP_KEY_COUNT=2
CONFIG_BT_MESH_CFG_CLI=y
CONFIG_BT_MESH_HEALTH_CLI=y
CONFIG_BT_MESH_RELAY=y
CONFIG_BT_MESH_FRIEND=y
CONFIG_BT_MESH_LOW_POWER=y
CONFIG_BT_MESH_LPN_AUTO=n
CONFIG_BT_MESH_GATT_PROXY=y
CONFIG_BT_MESH_TX_SEG_MAX=16
CONFIG_BT_MESH_RX_SEG_MAX=16
CONFIG_BT_MESH_ADV_BUF_COUNT=16
CONFIG_BT_MESH_RX_SEG_MSG_COUNT=2
CONFIG_BT_MESH_TX_SEG_MSG_COUNT=2
CONFIG_BT_MESH_SETTINGS_WORKQ_STACK_SIZE=1700
CONFIG_BT_MESH_ADV_STACK_SIZE=4000

CONFIG_NUCODE_BLE_MESH=y
CONFIG_NUCODE_BLE_MESH_EVENT_QUEUE_SIZE=32
CONFIG_NUCODE_BLE_MESH_UPDATE=y
CONFIG_BT_MESH_MODEL_EXTENSIONS=y
CONFIG_BT_MESH_MODEL_EXTENSION_LIST_SIZE=4
CONFIG_BT_MESH_BLOB_SRV=y
CONFIG_BT_MESH_BLOB_CLI=y
CONFIG_BT_MESH_BLOB_IO_FLASH=y
CONFIG_BT_MESH_BLOB_SIZE_MAX=720896
CONFIG_BT_MESH_BLOB_BLOCK_SIZE_MIN=4096
CONFIG_BT_MESH_BLOB_BLOCK_SIZE_MAX=4096
CONFIG_BT_MESH_BLOB_CHUNK_COUNT_MAX=32
CONFIG_BT_MESH_ALIGN_CHUNK_SIZE_TO_MAX_SEGMENT=n
CONFIG_BT_MESH_RX_BLOB_CHUNK_SIZE=128
CONFIG_BT_MESH_TX_BLOB_CHUNK_SIZE=128
CONFIG_BT_MESH_BLOB_CLI_BLOCK_RETRIES=3
CONFIG_BT_MESH_DFU_SRV=y
CONFIG_BT_MESH_DFU_CLI=y
CONFIG_BT_MESH_DFU_METADATA=y
CONFIG_BT_MESH_DFU_FWID_MAXLEN=16
CONFIG_BT_MESH_DFU_METADATA_MAXLEN=32
CONFIG_BT_MESH_DFU_SLOTS=y
CONFIG_BT_MESH_DFU_SLOT_CNT=1
CONFIG_BT_MESH_DFD_SRV=y
CONFIG_BT_MESH_DFD_SRV_SLOT_MAX_SIZE=720896
CONFIG_BT_MESH_DFD_SRV_SLOT_SPACE=720896
CONFIG_BT_MESH_DFD_SRV_TARGETS_MAX=4
```

## src/candidate.cpp
```c
/**
 * @file candidate.cpp
 * @brief Mesh 전송 시간을 제한하는 최소 MCUboot candidate oracle입니다.
 *
 * SPDX-License-Identifier: MIT
 */

#include <Arduino.h>

#include <zephyr/dfu/mcuboot.h>
#include <zephyr/settings/settings.h>
#include <zephyr/storage/flash_map.h>

#include <cstddef>
#include <cstdint>
#include <errno.h>
#include <string.h>

#ifndef M32_MDFU_CORE_REVISION
#error "M32_MDFU_CORE_REVISION is required"
#endif

namespace
{
    constexpr char protocol[] = "M32MDFU|1";
    constexpr char apply_prefix[] = "M32MDFU|1|APPLY|nonce=";
    constexpr char boot_query_prefix[] = "M32MDFU|1|QUERY_BOOT|nonce=";
    constexpr char stop_prefix[] = "M32MDFU|1|STOP|nonce=";
    constexpr std::size_t nonce_length = 32U;
    constexpr std::size_t command_capacity = 192U;

    char command[command_capacity] = {};
    char nonce[nonce_length + 1U] = {};
    char role = '\0';
    std::size_t command_length = 0U;
    bool nonce_valid = false;
    bool candidate_applied = false;
    bool failed = false;

    /** @brief MCUboot active image의 semantic version과 confirm 상태입니다. */
    struct ActiveImage
    {
        std::uint8_t major = 0U;
        std::uint8_t minor = 0U;
        std::uint16_t revision = 0U;
        std::uint32_t build = 0U;
        bool confirmed = false;
    };

    /** @brief 설정에서 session nonce와 대상 역할을 복원합니다. */
    int loadSessionEntry(const char *key, std::size_t length,
                         settings_read_cb read_callback, void *callback_argument, void *)
    {
        if ((key != nullptr) && (::strcmp(key, "nonce") == 0) &&
            (length == sizeof(nonce)))
        {
            const ssize_t read = read_callback(callback_argument, nonce, sizeof(nonce));
            nonce_valid = read == static_cast<ssize_t>(sizeof(nonce)) &&
                          nonce[nonce_length] == '\0';
        }
        else if ((key != nullptr) && (::strcmp(key, "role") == 0) &&
                 (length == sizeof(role)))
        {
            static_cast<void>(read_callback(callback_argument, &role, sizeof(role)));
        }
        return 0;
    }

    /** @brief 저장된 역할을 protocol 문자열로 변환합니다. */
    const char *roleName()
    {
        if (role == 'a')
        {
            return "target_a";
        }
        if (role == 'b')
        {
            return "target_b";
        }
        return "candidate_unknown";
    }

    /** @brief protocol record에 session과 exact source를 결합합니다. */
    void printSuffix()
    {
        Serial.print("|nonce=");
        Serial.print(nonce_valid ? nonce : "none");
        Serial.print("|core=");
        Serial.print(M32_MDFU_CORE_REVISION);
    }

    /** @brief 첫 실패만 bounded protocol로 출력합니다. */
    void fail(const char *stage, int code = 0)
    {
        if (failed)
        {
            return;
        }
        Serial.print(protocol);
        Serial.print("|FAIL|role=");
        Serial.print(roleName());
        Serial.print("|stage=");
        Serial.print(stage);
        Serial.print("|code=");
        Serial.print(code);
        printSuffix();
        Serial.println();
        failed = true;
    }

    /** @brief active slot의 MCUboot header를 읽습니다. */
    bool activeImage(ActiveImage &image)
    {
        struct mcuboot_img_header header{};
        const int error =
            boot_read_bank_header(PARTITION_ID(slot0_partition), &header, sizeof(header));
        if ((error != 0) || (header.mcuboot_version != 1U))
        {
            return false;
        }
        image.major = header.h.v1.sem_ver.major;
        image.minor = header.h.v1.sem_ver.minor;
        image.revision = header.h.v1.sem_ver.revision;
        image.build = header.h.v1.sem_ver.build_num;
        image.confirmed = boot_is_img_confirmed();
        return true;
    }

    /** @brief 현재 candidate boot 상태를 출력합니다. */
    void reportBoot()
    {
        ActiveImage image{};
        if (!nonce_valid || ((role != 'a') && (role != 'b')) || !activeImage(image))
        {
            fail("session_restore");
            return;
        }
        Serial.print(protocol);
        Serial.print("|BOOT|role=");
        Serial.print(roleName());
        Serial.print("|version=");
        Serial.print(image.major);
        Serial.print('.');
        Serial.print(image.minor);
        Serial.print('.');
        Serial.print(image.revision);
        Serial.print('+');
        Serial.print(static_cast<unsigned long>(image.build));
        Serial.print("|confirmed=");
        Serial.print(image.confirmed ? 1 : 0);
        Serial.print("|active_slot=");
        Serial.print(static_cast<unsigned int>(boot_fetch_active_slot()));
        printSuffix();
        Serial.println();
    }

    /** @brief 저장된 nonce와 일치하는 명령인지 확인합니다. */
    bool hasSessionPrefix(const char *prefix)
    {
        const std::size_t prefix_length = ::strlen(prefix);
        return nonce_valid && (::strncmp(command, prefix, prefix_length) == 0) &&
               (::strncmp(command + prefix_length, nonce, nonce_length) == 0);
    }

    /** @brief candidate confirm 또는 rollback 대기 상태를 적용합니다. */
    bool applyCandidate()
    {
        if (!hasSessionPrefix(apply_prefix))
        {
            return false;
        }
        const char *cursor = command + ::strlen(apply_prefix) + nonce_length;
        constexpr char iteration_prefix[] = "|iteration=";
        if ((::strncmp(cursor, iteration_prefix, sizeof(iteration_prefix) - 1U) != 0) ||
            (cursor[sizeof(iteration_prefix) - 1U] < '1') ||
            (cursor[sizeof(iteration_prefix) - 1U] > '5'))
        {
            return false;
        }
        const std::uint8_t iteration = static_cast<std::uint8_t>(
            cursor[sizeof(iteration_prefix) - 1U] - '0');
        cursor += sizeof(iteration_prefix);
        constexpr char confirm_prefix[] = "|confirm=";
        if ((::strncmp(cursor, confirm_prefix, sizeof(confirm_prefix) - 1U) != 0) ||
            ((cursor[sizeof(confirm_prefix) - 1U] != '0') &&
             (cursor[sizeof(confirm_prefix) - 1U] != '1')))
        {
            return false;
        }
        const bool confirm = cursor[sizeof(confirm_prefix) - 1U] == '1';
        cursor += sizeof(confirm_prefix);
        if ((::strncmp(cursor, "|core=", 6U) != 0) ||
            (::strcmp(cursor + 6U, M32_MDFU_CORE_REVISION) != 0))
        {
            return false;
        }
        if (candidate_applied)
        {
            fail("duplicate_apply");
            return true;
        }
        if (confirm && (boot_write_img_confirmed() != 0))
        {
            fail("confirm");
            return true;
        }
        candidate_applied = true;
        Serial.print(protocol);
        Serial.print("|APPLIED|role=");
        Serial.print(roleName());
        Serial.print("|iteration=");
        Serial.print(static_cast<unsigned int>(iteration));
        Serial.print("|confirmed=");
        Serial.print(confirm ? 1 : 0);
        printSuffix();
        Serial.println();
        return true;
    }

    /** @brief candidate의 PROBE·session-bound BOOT 재조회·APPLY·STOP 명령을 처리합니다. */
    void processCommand()
    {
        if (::strcmp(command, "M32MDFU|1|PROBE") == 0)
        {
            ActiveImage image{};
            if (!activeImage(image))
            {
                fail("probe_header");
                return;
            }
            Serial.print(protocol);
            Serial.print("|READY|role=");
            Serial.print(roleName());
            Serial.print("|version=");
            Serial.print(image.major);
            Serial.print('.');
            Serial.print(image.minor);
            Serial.print('.');
            Serial.print(image.revision);
            Serial.print('+');
            Serial.print(static_cast<unsigned long>(image.build));
            Serial.print("|confirmed=");
            Serial.print(image.confirmed ? 1 : 0);
            Serial.print("|cdb_node_slots=3|cdb_local_slots=1|core=");
            Serial.println(M32_MDFU_CORE_REVISION);
            return;
        }
        if (hasSessionPrefix(boot_query_prefix) &&
            (::strcmp(command + ::strlen(boot_query_prefix) + nonce_length,
                      "|core=" M32_MDFU_CORE_REVISION) == 0))
        {
            reportBoot();
            return;
        }
        if (applyCandidate())
        {
            return;
        }
        if (hasSessionPrefix(stop_prefix) &&
            (::strcmp(command + ::strlen(stop_prefix) + nonce_length, "") == 0))
        {
            Serial.print(protocol);
            Serial.print("|STOPPED|role=");
            Serial.print(roleName());
            Serial.print("|cleanup=pass");
            printSuffix();
            Serial.println();
            return;
        }
        fail("command");
    }

    /** @brief CR/LF serial command를 overflow 없이 수집합니다. */
    void pollSerial()
    {
        while (Serial.available() > 0)
        {
            const int incoming = Serial.read();
            if (incoming == '\r')
            {
                continue;
            }
            if (incoming == '\n')
            {
                command[command_length] = '\0';
                processCommand();
                command_length = 0U;
                continue;
            }
            if ((incoming < 0) || (command_length + 1U >= sizeof(command)))
            {
                command_length = 0U;
                fail("command_length");
                continue;
            }
            command[command_length++] = static_cast<char>(incoming);
        }
    }
} // namespace

/** @brief 최소 candidate 상태와 저장된 session을 준비합니다. */
void setup()
{
    Serial.begin(115200);
    const int settings_error = settings_subsys_init();
    if ((settings_error != 0) && (settings_error != -EALREADY))
    {
        fail("settings_init", settings_error);
        return;
    }
    static_cast<void>(settings_load_subtree_direct("m32mdfu", loadSessionEntry, nullptr));
    ActiveImage image{};
    if (!activeImage(image) || (image.major != 2U))
    {
        fail("candidate_version");
        return;
    }
    reportBoot();
}

/** @brief candidate UART oracle를 bounded polling으로 처리합니다. */
void loop()
{
    pollSerial();
    delay(1);
}
```
