## CMakeLists.txt
```
# SPDX-License-Identifier: MIT

cmake_minimum_required(VERSION 3.20.0)

find_package(Zephyr REQUIRED HINTS $ENV{ZEPHYR_BASE})
project(nucode_m32_ble_power_contract)

get_filename_component(NUCODE_ROOT "${CMAKE_CURRENT_LIST_DIR}/../../.." ABSOLUTE)
target_sources(app PRIVATE
    src/main.cpp
    "${NUCODE_ROOT}/libraries/NUCODE_BLE/src/NUCODE_BLE_GAP.cpp"
    "${NUCODE_ROOT}/libraries/NUCODE_BLE/src/internal/gap/GapValues.cpp"
    "${NUCODE_ROOT}/libraries/NUCODE_BLE/src/internal/gap/GapAdvertising.cpp"
    "${NUCODE_ROOT}/libraries/NUCODE_BLE/src/internal/gap/GapExtendedAdvertising.cpp"
    "${NUCODE_ROOT}/libraries/NUCODE_BLE/src/internal/gap/GapPeriodicAdvertising.cpp"
    "${NUCODE_ROOT}/libraries/NUCODE_BLE/src/internal/gap/GapPawr.cpp"
    "${NUCODE_ROOT}/libraries/NUCODE_BLE/src/internal/gap/GapScanning.cpp"
    "${NUCODE_ROOT}/libraries/NUCODE_BLE/src/internal/gap/GapConnection.cpp"
    "${NUCODE_ROOT}/libraries/NUCODE_BLE/src/internal/NUCODE_BLE_Stack.cpp"
)
target_include_directories(app PRIVATE
    "${NUCODE_ROOT}/libraries/NUCODE_BLE/src"
)
```

## prj.conf
```kconfig
# SPDX-License-Identifier: MIT

CONFIG_CPP=y
CONFIG_STD_CPP17=y
CONFIG_CPP_EXCEPTIONS=n
CONFIG_CPP_RTTI=n

CONFIG_NUCODE_ARDUINO_CORE=y
CONFIG_NUCODE_ARDUINO_RUNTIME=n
CONFIG_NUCODE_ARDUINO_API=y
CONFIG_NUCODE_ARDUINO_GPIO=n
CONFIG_NUCODE_ARDUINO_INTERRUPTS=n
CONFIG_NUCODE_ARDUINO_TIME=n
CONFIG_NUCODE_ARDUINO_SERIAL=n
CONFIG_NUCODE_ARDUINO_WIRE=n
CONFIG_NUCODE_ARDUINO_SPI=n
CONFIG_NUCODE_ARDUINO_ADC=n
CONFIG_NUCODE_ARDUINO_PWM=n

CONFIG_BT=y
CONFIG_BT_PERIPHERAL=y
CONFIG_BT_CENTRAL=y
CONFIG_BT_MAX_CONN=2
CONFIG_BT_CTLR_SDC_PERIPHERAL_COUNT=1
CONFIG_BT_DEVICE_NAME_DYNAMIC=y
CONFIG_BT_DEVICE_NAME_MAX=32
CONFIG_BT_GATT_CLIENT=y
CONFIG_BT_TRANSMIT_POWER_CONTROL=y
CONFIG_BT_PATH_LOSS_MONITORING=y
CONFIG_BT_CTLR_CONN_RSSI=y

CONFIG_NUCODE_BLE_CORE=y
CONFIG_NUCODE_BLE_CORE_EVENT_QUEUE_SIZE=24
CONFIG_NUCODE_BLE_SCAN_RESULT_QUEUE_SIZE=8
CONFIG_HEAP_MEM_POOL_SIZE=4096
CONFIG_SYSTEM_WORKQUEUE_STACK_SIZE=2048
CONFIG_COMMON_LIBC_MALLOC_ARENA_SIZE=8192
```

## src/main.cpp
```c
/**
 * @file main.cpp
 * @brief M32 LE Power Control·RSSI·Path Loss 공개 API의 target link 계약입니다.
 *
 * SPDX-License-Identifier: MIT
 */

#include <NUCODE_BLE_GAP.h>

#include <cstdint>

static_assert(CONFIG_BT_MAX_CONN == 2);
static_assert(CONFIG_BT_TRANSMIT_POWER_CONTROL == 1);
static_assert(CONFIG_BT_PATH_LOSS_MONITORING == 1);
static_assert(CONFIG_BT_CTLR_CONN_RSSI == 1);

/** @brief Power/Path Loss event payload를 compile-time에 접근합니다. */
void onDetailedEvent(const nucode::ble::BLEEventInfo &information, void *context)
{
    auto *value = static_cast<volatile std::int8_t *>(context);
    if (value == nullptr)
    {
        return;
    }
    if (information.event == nucode::ble::BLEEvent::transmit_power_report)
    {
        *value = information.transmit_power.level_dbm;
    }
    else if (information.event == nucode::ble::BLEEvent::path_loss_changed)
    {
        *value = static_cast<std::int8_t>(information.path_loss.path_loss_db);
    }
}

int main()
{
    volatile std::int8_t observed = 0;
    nucode::ble::BLEConnectionHandle connection;
    nucode::ble::BLETransmitPowerLevel power;
    nucode::ble::BLEPathLossParameters path_loss;
    std::int8_t rssi = 0;

    BLEDevice.onEventInfo(onDetailedEvent, const_cast<std::int8_t *>(&observed));
    static_cast<void>(BLEConnection.localTransmitPower(
        connection, nucode::ble::BLETransmitPowerPhy::le_1m, power));
    static_cast<void>(BLEConnection.requestRemoteTransmitPower(
        connection, nucode::ble::BLETransmitPowerPhy::le_1m));
    static_cast<void>(BLEConnection.requestRemoteTransmitPowerChange(
        connection, nucode::ble::BLETransmitPowerPhy::le_1m, 3));
    static_cast<void>(BLEConnection.setTransmitPowerReporting(connection, true, true));
    static_cast<void>(BLEConnection.readRssi(connection, rssi));
    static_cast<void>(BLEConnection.configurePathLossMonitoring(connection, path_loss));
    static_cast<void>(BLEConnection.setPathLossMonitoring(connection, true));
    static_cast<void>(BLEConnection.setPathLossMonitoring(connection, false));
    return 0;
}
```
