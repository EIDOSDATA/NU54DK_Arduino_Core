## CMakeLists.txt
```
cmake_minimum_required(VERSION 3.20.0)
find_package(Zephyr REQUIRED HINTS $ENV{ZEPHYR_BASE})
project(m24uh LANGUAGES C CXX)

target_sources(app PRIVATE src/main.cpp)
```

## Kconfig
```
mainmenu "M24 UARTE onboard HIL"

source "Kconfig.zephyr"

config NUCODE_M24_UARTE_HIL_INSTANCE
	int "UARTE instance exercised by this image"
	range 20 30
	default 20
```

## prj.conf
```kconfig
CONFIG_CPP=y
CONFIG_STD_CPP17=y
CONFIG_CPP_EXCEPTIONS=n
CONFIG_CPP_RTTI=n

CONFIG_CONSOLE=n
CONFIG_SERIAL=n
CONFIG_PRINTK=n
CONFIG_LOG=n

CONFIG_NUCODE_ARDUINO_CORE=y
CONFIG_NUCODE_ARDUINO_RUNTIME=n
CONFIG_NUCODE_ARDUINO_API=y
CONFIG_NUCODE_ARDUINO_IO_OWNERSHIP=y
CONFIG_NUCODE_ARDUINO_IO_RESOURCE_SLOTS=64
CONFIG_NUCODE_ARDUINO_GPIO=y
CONFIG_NUCODE_ARDUINO_CONNECTOR_GPIO=y
CONFIG_NUCODE_ARDUINO_DAP_UART_GPIO_PINS=y
CONFIG_NUCODE_ARDUINO_INTERRUPTS=n
CONFIG_NUCODE_ARDUINO_TIME=n
CONFIG_NUCODE_ARDUINO_SERIAL=n
CONFIG_NUCODE_ARDUINO_SERIAL_FABRIC=y
CONFIG_NUCODE_ARDUINO_SERIAL_FABRIC_UARTE=y
CONFIG_NUCODE_ARDUINO_WIRE=n
CONFIG_NUCODE_ARDUINO_SPI=n
CONFIG_NUCODE_ARDUINO_ADC=n
CONFIG_NUCODE_ARDUINO_PWM=n

CONFIG_MAIN_STACK_SIZE=4096
```

## app.overlay
```dts
/** @brief DAP VCOM 대상 UARTE가 block IRQ를 단독 소유합니다. */
#include <nucode/nu54dk-arduino-pins.dtsi>

/ {
    chosen {
        /delete-property/ zephyr,console;
        /delete-property/ zephyr,shell-uart;
        /delete-property/ zephyr,uart-mcumgr;
        /delete-property/ zephyr,bt-mon-uart;
        /delete-property/ zephyr,bt-c2h-uart;
    };
};

&uart20 {
    status = "disabled";
};

&uart30 {
    status = "disabled";
};
```

## src/main.cpp
```c
/**
 * @file main.cpp
 * @brief DAP VCOM으로 UARTE20/21/22/30의 32-byte EasyDMA 왕복을 검증합니다.
 *
 * SPDX-License-Identifier: MIT
 */

#include <nucode/SerialFabric.h>

#include <variant.h>

#include <zephyr/kernel.h>

#include <cstddef>
#include <cstdint>

namespace
{
    using namespace nucode::arduino;

    inline constexpr std::uint8_t instance = CONFIG_NUCODE_M24_UARTE_HIL_INSTANCE;
    inline constexpr std::size_t packet_size = 32U;

    alignas(4) std::uint8_t workspace[packet_size * 2U]{};
    std::uint8_t *const receive_buffer = &workspace[0];
    std::uint8_t *const transmit_buffer = &workspace[packet_size];

    const SerialSignalPin p1_pins[] = {{SerialSignal::txd, PIN_P1_04},
                                       {SerialSignal::rxd, PIN_P1_05}};
    const SerialSignalPin p0_pins[] = {{SerialSignal::txd, PIN_P0_00},
                                       {SerialSignal::rxd, PIN_P0_01}};

    [[noreturn]] void halt()
    {
        while (true)
        {
            k_sleep(K_FOREVER);
        }
    }

    bool startReceive(UarteHandle &handle)
    {
        const auto result = handle.receiveAsync(receive_buffer, packet_size);
        return result == SerialFabricResult::success;
    }

    void sendReady(UarteHandle &handle)
    {
        for (std::size_t index = 0U; index < packet_size; ++index)
        {
            transmit_buffer[index] = static_cast<std::uint8_t>(0xA0U ^ instance ^ index);
        }
        if (handle.transmitAsync(transmit_buffer, packet_size) != SerialFabricResult::success)
        {
            halt();
        }
        while (true)
        {
            UarteEvent event{};
            if (!handle.takeEvent(event))
            {
                k_sleep(K_MSEC(1));
                continue;
            }
            if (event.type == UarteEventType::tx_complete && event.buffer == transmit_buffer &&
                event.transferred == packet_size)
            {
                return;
            }
            if (event.type == UarteEventType::error || event.type == UarteEventType::tx_cancelled)
            {
                halt();
            }
        }
    }
} // namespace

int main()
{
    if ((instance != 20U) && (instance != 21U) && (instance != 22U) && (instance != 30U))
    {
        halt();
    }
    auto *const handle = serialFabric().uarte(instance);
    if (handle == nullptr ||
        handle->configure({115200U, UarteParity::none, false}) != SerialFabricResult::success)
    {
        halt();
    }
    const bool p0 = instance == 30U;
    const SerialDmaWorkspace dma{workspace, sizeof(workspace)};
    const SerialFabricConfiguration configuration{
        p0 ? SerialRouteClass::p0_flexible : SerialRouteClass::p1_flexible,
        SerialElectricalProfile::dap_uart_bridge,
        p0 ? p0_pins : p1_pins,
        2U,
        &dma,
        1U,
    };
    if (handle->stage(configuration) != SerialFabricResult::success ||
        handle->activate() != SerialFabricResult::success)
    {
        halt();
    }
    sendReady(*handle);
    if (!startReceive(*handle))
    {
        halt();
    }

    while (true)
    {
        UarteEvent event{};
        if (!handle->takeEvent(event))
        {
            k_sleep(K_MSEC(1));
            continue;
        }
        if (event.type == UarteEventType::rx_complete && event.buffer == receive_buffer &&
            event.transferred == packet_size)
        {
            for (std::size_t index = 0U; index < packet_size; ++index)
            {
                transmit_buffer[index] = receive_buffer[packet_size - index - 1U];
            }
            while (handle->transmitAsync(transmit_buffer, packet_size) !=
                   SerialFabricResult::success)
            {
                k_sleep(K_MSEC(1));
            }
        }
        else if (event.type == UarteEventType::tx_complete)
        {
            while (!startReceive(*handle))
            {
                k_sleep(K_MSEC(1));
            }
        }
        else if (event.type == UarteEventType::error)
        {
            halt();
        }
    }
}
```
