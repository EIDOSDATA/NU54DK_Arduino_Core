## CMakeLists.txt
```
# SPDX-License-Identifier: MIT

cmake_minimum_required(VERSION 3.20.0)

find_package(Zephyr REQUIRED HINTS $ENV{ZEPHYR_BASE})
project(nucode_m19_ble_gap_contract)

get_filename_component(NUCODE_ROOT "${CMAKE_CURRENT_LIST_DIR}/../../.." ABSOLUTE)
target_sources(app PRIVATE
  src/main.cpp
  "${NUCODE_ROOT}/libraries/NUCODE_BLE/src/NUCODE_BLE.cpp"
  "${NUCODE_ROOT}/libraries/NUCODE_BLE/src/NUCODE_BLE_GAP.cpp"
  "${NUCODE_ROOT}/libraries/NUCODE_BLE/src/internal/gap/GapValues.cpp"
  "${NUCODE_ROOT}/libraries/NUCODE_BLE/src/internal/gap/GapAdvertising.cpp"
  "${NUCODE_ROOT}/libraries/NUCODE_BLE/src/internal/gap/GapExtendedAdvertising.cpp"
  "${NUCODE_ROOT}/libraries/NUCODE_BLE/src/internal/gap/GapPeriodicAdvertising.cpp"
  "${NUCODE_ROOT}/libraries/NUCODE_BLE/src/internal/gap/GapPawr.cpp"
  "${NUCODE_ROOT}/libraries/NUCODE_BLE/src/internal/gap/GapScanning.cpp"
  "${NUCODE_ROOT}/libraries/NUCODE_BLE/src/internal/gap/GapConnection.cpp"
  "${NUCODE_ROOT}/libraries/NUCODE_BLE/src/internal/NUCODE_BLE_Stack.cpp"
)
target_include_directories(app PRIVATE
  "${NUCODE_ROOT}/libraries/NUCODE_BLE/src"
)
```

## prj.conf
```kconfig
CONFIG_CPP=y
CONFIG_STD_CPP17=y
CONFIG_CPP_EXCEPTIONS=n
CONFIG_CPP_RTTI=n

CONFIG_NUCODE_ARDUINO_CORE=y
CONFIG_NUCODE_ARDUINO_RUNTIME=n
CONFIG_NUCODE_ARDUINO_API=y
CONFIG_NUCODE_ARDUINO_GPIO=n
CONFIG_NUCODE_ARDUINO_INTERRUPTS=n
CONFIG_NUCODE_ARDUINO_TIME=n
CONFIG_NUCODE_ARDUINO_SERIAL=n
CONFIG_NUCODE_ARDUINO_WIRE=n
CONFIG_NUCODE_ARDUINO_SPI=n
CONFIG_NUCODE_ARDUINO_ADC=n
CONFIG_NUCODE_ARDUINO_PWM=n

CONFIG_BT=y
CONFIG_BT_PERIPHERAL=y
CONFIG_BT_CENTRAL=y
CONFIG_BT_MAX_CONN=1
CONFIG_BT_DEVICE_NAME_DYNAMIC=y
CONFIG_BT_DEVICE_NAME_MAX=32
CONFIG_BT_GATT_CLIENT=y
CONFIG_BT_USER_PHY_UPDATE=y
CONFIG_BT_NUS=y
CONFIG_BT_NUS_CLIENT=y
CONFIG_BT_GATT_DM=y
CONFIG_HEAP_MEM_POOL_SIZE=4096
CONFIG_SYSTEM_WORKQUEUE_STACK_SIZE=2048

CONFIG_NUCODE_BLE_CORE=y
CONFIG_NUCODE_BLE_NUS=y
CONFIG_NUCODE_BLE_CORE_EVENT_QUEUE_SIZE=24
CONFIG_NUCODE_BLE_SCAN_RESULT_QUEUE_SIZE=8
CONFIG_COMMON_LIBC_MALLOC_ARENA_SIZE=8192
```

## src/main.cpp
```c
/**
 * @file main.cpp
 * @brief M19 BLE Core/GAP 공개 API의 target compile/link 계약을 검증합니다.
 *
 * SPDX-License-Identifier: MIT
 */

#include <NUCODE_BLE_GAP.h>

#include <cstdint>

/** @brief Core event callback signature를 link graph에 고정합니다. */
void onBleEvent(nucode::ble::BLEEvent event, void *context)
{
    auto *value = static_cast<volatile std::uint8_t *>(context);
    if (value != nullptr)
    {
        *value = static_cast<std::uint8_t>(event);
    }
}

/** @brief bounded scan 결과 callback signature를 고정합니다. */
void onScanResult(const nucode::ble::BLEScanResult &result, void *context)
{
    auto *value = static_cast<volatile std::int8_t *>(context);
    if (value != nullptr)
    {
        *value = result.rssi;
    }
}

int main()
{
    volatile std::uint8_t event = 0U;
    volatile std::int8_t rssi = 0;
    const nucode::ble::BLEUuid uuid16(0x180fU);
    const nucode::ble::BLEUuid second_uuid16(0x180aU);
    const nucode::ble::BLEUuid uuid32 = nucode::ble::BLEUuid::from32(0x12345678U);
    const nucode::ble::BLEUuid uuid128("12345678-1234-5678-1234-56789abcdef0");
    const nucode::ble::BLEAddress address("C0:12:34:56:78:9A",
                                          nucode::ble::BLEAddress::Type::random_address);

    BLEDevice.onEvent(onBleEvent, const_cast<std::uint8_t *>(&event));
    BLEScan.onResult(onScanResult, const_cast<std::int8_t *>(&rssi));
    static_cast<void>(BLEAdvertising.setConnectable(true));
    static_cast<void>(BLEAdvertising.setInterval(0x20U, 0x40U));
    static_cast<void>(BLEAdvertising.addServiceUuid(uuid16));
    static_cast<void>(BLEAdvertising.addServiceUuid(second_uuid16));
    static_cast<void>(BLEAdvertising.setServiceData(uuid32, nullptr, 0U));
    static_cast<void>(BLEScan.filterServiceUuid(uuid128));
    static_cast<void>(BLEScan.filterAddress(address));
    static_cast<void>(BLEConnection.peerAddress());
    static_cast<void>(BLEConnection.phy());
    static_cast<void>(BLEDevice.lastError());
    return 0;
}
```
