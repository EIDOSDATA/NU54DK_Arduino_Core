## CMakeLists.txt
```
cmake_minimum_required(VERSION 3.20.0)

find_package(Zephyr REQUIRED HINTS $ENV{ZEPHYR_BASE})
project(nucode_arduino_blink)

target_sources(app PRIVATE src/Blink.cpp)
```

## prj.conf
```kconfig
CONFIG_CPP=y
CONFIG_STD_CPP17=y
CONFIG_CPP_EXCEPTIONS=n
CONFIG_CPP_RTTI=n

CONFIG_NUCODE_ARDUINO_CORE=y
CONFIG_NUCODE_ARDUINO_API=y
CONFIG_NUCODE_ARDUINO_GPIO=y
CONFIG_NUCODE_ARDUINO_INTERRUPTS=y
CONFIG_NUCODE_ARDUINO_TIME=y
CONFIG_NUCODE_ARDUINO_SERIAL=y
CONFIG_GPIO=y

CONFIG_MAIN_STACK_SIZE=2048
CONFIG_HEAP_MEM_POOL_SIZE=0
CONFIG_COMMON_LIBC_MALLOC=y
CONFIG_COMMON_LIBC_MALLOC_ARENA_SIZE=8192
```

## src/Blink.cpp
```c
/**
 * @file Blink.cpp
 * @brief Arduino GPIO와 시간 API만 사용하는 NU54DK LED 점멸 예제입니다.
 *
 * SPDX-License-Identifier: MIT
 */

#include <Arduino.h>

/**
 * @brief 내장 LED를 출력으로 초기화합니다.
 */
void setup(void)
{
    pinMode(LED_BUILTIN, OUTPUT);
}

/**
 * @brief 내장 LED를 250 ms 간격으로 켜고 끕니다.
 */
void loop(void)
{
    digitalWrite(LED_BUILTIN, HIGH);
    delay(250UL);
    digitalWrite(LED_BUILTIN, LOW);
    delay(250UL);
}
```
