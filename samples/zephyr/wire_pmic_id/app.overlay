/** @brief Wire를 NU54DK Qwiic i2c22 controller에 연결합니다. */
/ {
	chosen {
		nucode,arduino-wire = &i2c22;
	};
};

/** @brief nRF54L15 NFC 전용 P1.2/P1.3 패드를 GPIO/TWIM 용도로 전환합니다. */
&uicr {
	nfct-pins-as-gpios;
};
