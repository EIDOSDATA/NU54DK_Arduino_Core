## CMakeLists.txt
```
cmake_minimum_required(VERSION 3.20.0)

find_package(Zephyr REQUIRED HINTS $ENV{ZEPHYR_BASE})
project(nucode_arduino_pwm_fade)

target_sources(app PRIVATE src/pwm_fade.cpp)
```

## prj.conf
```kconfig
CONFIG_CPP=y
CONFIG_STD_CPP17=y
CONFIG_CPP_EXCEPTIONS=n
CONFIG_CPP_RTTI=n

CONFIG_NUCODE_ARDUINO_CORE=y
CONFIG_NUCODE_ARDUINO_RUNTIME=y
CONFIG_NUCODE_ARDUINO_API=y
CONFIG_NUCODE_ARDUINO_GPIO=n
CONFIG_NUCODE_ARDUINO_INTERRUPTS=n
CONFIG_NUCODE_ARDUINO_TIME=y
CONFIG_NUCODE_ARDUINO_SERIAL=n
CONFIG_NUCODE_ARDUINO_WIRE=n
CONFIG_NUCODE_ARDUINO_SPI=n
CONFIG_NUCODE_ARDUINO_ADC=n
CONFIG_NUCODE_ARDUINO_PWM=y

CONFIG_MAIN_STACK_SIZE=4096
CONFIG_HEAP_MEM_POOL_SIZE=0
CONFIG_COMMON_LIBC_MALLOC_ARENA_SIZE=8192
```

## app.overlay
```dts
/** @brief PIN_PWM0을 board pwm_led1/P1.10 역할에 연결합니다. */
/ {
	chosen {
		nucode,arduino-pwm = &pwm_led1;
	};
};
```

## src/pwm_fade.cpp
```c
/**
 * @file pwm_fade.cpp
 * @brief NU54DK PIN_PWM0/P1.10의 8-bit PWM duty를 변화시킵니다.
 *
 * SPDX-License-Identifier: MIT
 */

#include <Arduino.h>

namespace
{
    int duty = 0;
    int step = 1;
} // namespace

/** @brief 0% edge에서 PWM 예제를 시작합니다. */
void setup(void)
{
    analogWrite(PIN_PWM0, 0);
}

/** @brief 고정 20 ms period에서 duty 0..255 edge를 왕복합니다. */
void loop(void)
{
    analogWrite(PIN_PWM0, duty);
    duty += step;
    if ((duty == 255) || (duty == 0))
    {
        step = -step;
    }
    delay(10U);
}
```
