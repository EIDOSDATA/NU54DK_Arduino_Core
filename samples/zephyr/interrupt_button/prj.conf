## CMakeLists.txt
```
cmake_minimum_required(VERSION 3.20.0)

find_package(Zephyr REQUIRED HINTS $ENV{ZEPHYR_BASE})
project(nucode_arduino_interrupt_button)

target_sources(app PRIVATE src/interrupt_button.cpp)
```

## prj.conf
```kconfig
CONFIG_CPP=y
CONFIG_STD_CPP17=y
CONFIG_CPP_EXCEPTIONS=n
CONFIG_CPP_RTTI=n

CONFIG_NUCODE_ARDUINO_CORE=y
CONFIG_NUCODE_ARDUINO_RUNTIME=y
CONFIG_NUCODE_ARDUINO_API=y
CONFIG_NUCODE_ARDUINO_GPIO=y
CONFIG_NUCODE_ARDUINO_INTERRUPTS=y
CONFIG_NUCODE_ARDUINO_TIME=y
CONFIG_NUCODE_ARDUINO_SERIAL=n

CONFIG_MAIN_STACK_SIZE=4096
CONFIG_HEAP_MEM_POOL_SIZE=0
CONFIG_COMMON_LIBC_MALLOC_ARENA_SIZE=8192
```

## src/interrupt_button.cpp
```c
/**
 * @file interrupt_button.cpp
 * @brief GPIO interrupt로 NU54DK 버튼 변화에 따라 LED를 갱신합니다.
 *
 * SPDX-License-Identifier: MIT
 */

#include <Arduino.h>

namespace
{
    /** @brief ISR에서 loop로 버튼 변화만 전달하는 최소 flag입니다. */
    volatile bool button_changed = false;

    /** @brief GPIO ISR에서 blocking 작업 없이 변화 flag만 설정합니다. */
    void onButtonChange(void)
    {
        button_changed = true;
    }

} // namespace

/** @brief 버튼 입력, LED 출력과 raw CHANGE interrupt를 구성합니다. */
void setup(void)
{
    pinMode(LED_BUILTIN, OUTPUT);
    pinMode(PIN_BUTTON0, INPUT_PULLUP);
    attachInterrupt(digitalPinToInterrupt(PIN_BUTTON0), onButtonChange, CHANGE);
    button_changed = true;
}

/** @brief 버튼 변화가 있을 때 thread 문맥에서 입력을 읽고 LED를 갱신합니다. */
void loop(void)
{
    if (button_changed)
    {
        button_changed = false;
        const PinStatus button_raw = digitalRead(PIN_BUTTON0);
        digitalWrite(LED_BUILTIN, (button_raw == LOW) ? LOW : HIGH);
    }

    delay(1UL);
}
```
