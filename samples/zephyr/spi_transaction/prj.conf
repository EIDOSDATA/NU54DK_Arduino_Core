## CMakeLists.txt
```
cmake_minimum_required(VERSION 3.20.0)

find_package(Zephyr REQUIRED HINTS $ENV{ZEPHYR_BASE})
project(nucode_arduino_spi_transaction)

target_sources(app PRIVATE src/spi_transaction.cpp)
```

## prj.conf
```kconfig
CONFIG_CPP=y
CONFIG_STD_CPP17=y
CONFIG_CPP_EXCEPTIONS=n
CONFIG_CPP_RTTI=n

CONFIG_NUCODE_ARDUINO_CORE=y
CONFIG_NUCODE_ARDUINO_RUNTIME=y
CONFIG_NUCODE_ARDUINO_API=y
CONFIG_NUCODE_ARDUINO_GPIO=n
CONFIG_NUCODE_ARDUINO_INTERRUPTS=n
CONFIG_NUCODE_ARDUINO_TIME=y
CONFIG_NUCODE_ARDUINO_SERIAL=y
CONFIG_NUCODE_ARDUINO_WIRE=n
CONFIG_NUCODE_ARDUINO_SPI=y
CONFIG_NUCODE_ARDUINO_ADC=n
CONFIG_NUCODE_ARDUINO_PWM=n

CONFIG_MAIN_STACK_SIZE=4096
CONFIG_HEAP_MEM_POOL_SIZE=0
CONFIG_COMMON_LIBC_MALLOC_ARENA_SIZE=8192
```

## src/spi_transaction.cpp
```c
/**
 * @file spi_transaction.cpp
 * @brief CS를 자동 생성하지 않는 SPI transaction build/HIL firmware입니다.
 *
 * SPDX-License-Identifier: MIT
 */

#include <Arduino.h>

#include <cstdint>

/** @brief mode 0, MSB-first, 4 MHz transaction에서 두 byte를 전송합니다. */
void setup(void)
{
    Serial.begin(115200U);
    SPI.begin();
    SPI.beginTransaction(SPISettings(4000000U, MSBFIRST, SPI_MODE0));
    std::uint8_t frame[] = {0x9FU, 0x00U};
    SPI.transfer(frame, sizeof(frame));
    SPI.endTransaction();
    Serial.println("NUCODE_M7_SPI_TRANSACTION_DONE");
}

/** @brief 단일 transaction 예제이므로 추가 전송은 수행하지 않습니다. */
void loop(void)
{
    delay(1000U);
}
```
