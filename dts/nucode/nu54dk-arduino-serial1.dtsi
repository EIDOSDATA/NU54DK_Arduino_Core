/**
 * @file nu54dk-arduino-serial1.dtsi
 * @brief Serial1이 소유하는 UARTE30 장치만 활성화합니다.
 * SPDX-License-Identifier: MIT
 */

&uart30 {
	status = "okay";
	current-speed = <115200>;
	pinctrl-0 = <&uart30_default>;
	pinctrl-1 = <&uart30_sleep>;
	pinctrl-names = "default", "sleep";
	zephyr,pm-device-runtime-auto;
};
