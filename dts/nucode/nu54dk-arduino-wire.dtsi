/**
 * @file nu54dk-arduino-wire.dtsi
 * @brief Wire가 소유하는 TWIM22 장치와 chosen만 활성화합니다.
 * SPDX-License-Identifier: MIT
 */

/ {
	chosen {
		nucode,arduino-wire = &i2c22;
	};
};

&i2c22 {
	status = "okay";
	pinctrl-0 = <&i2c22_default>;
	pinctrl-1 = <&i2c22_sleep>;
	pinctrl-names = "default", "sleep";
	zephyr,pm-device-runtime-auto;
};

/** @brief NFC 전용 P1.2/P1.3 패드를 Wire용 GPIO/TWIM으로 전환합니다. */
&uicr { nfct-pins-as-gpios; };
