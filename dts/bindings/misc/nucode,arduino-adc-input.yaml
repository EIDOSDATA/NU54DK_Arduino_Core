## dts/bindings/misc/nucode,arduino-adc-input.yaml
```yaml
# SPDX-License-Identifier: MIT

description: NU54DK Arduino analog 입력 역할 보관 노드

compatible: "nucode,arduino-adc-input"

include: base.yaml

properties:
  io-channels:
    type: phandle-array
    required: true
    description: Arduino analog 입력 역할에 연결할 ADC channel
```

## dts/bindings/misc/nucode,arduino-connector-gpios.yaml
```yaml
# SPDX-License-Identifier: MIT

description: NU54DK Arduino connector GPIO 역할 묶음

compatible: "nucode,arduino-connector-gpios"

include: base.yaml

child-binding:
  properties:
    gpios:
      type: phandle-array
      required: true
      description: Arduino connector GPIO 역할에 연결할 GPIO

    label:
      type: string
      description: Arduino connector GPIO 역할을 설명하는 이름
```

## dts/bindings/misc/nucode,arduino-pin-map.yaml
```yaml
# SPDX-License-Identifier: MIT

description: NU54DK Arduino canonical physical pin map

compatible: "nucode,arduino-pin-map"

include: base.yaml

child-binding:
  properties:
    gpios:
      type: phandle-array
      required: true
      description: Canonical Arduino physical GPIO pad

    nucode,capability-mask:
      type: int
      required: true
      description: Electrical and Arduino API capability bit mask

    nucode,policy:
      type: int
      required: true
      description: Fail-closed board access policy

    nucode,ownership:
      type: int
      required: true
      description: Boot-time board role owner

    nucode,route-mask:
      type: int
      required: true
      description: Board and SoC route metadata bit mask

    nucode,analog-channel:
      type: int
      description: SAADC AIN channel number when physically available
```

## tests/hil/nu54dk/fixtures/P2NativeTelemetry/Kconfig
```kconfig
config P2_NATIVE_TELEMETRY
	bool "P2 native 비교용 stack/heap 계측"
	default n
	help
	  Nordic native 비교 image에 Arduino P2와 같은 thread analyzer 및
	  libc/kernel heap 보고 코드를 포함합니다.
```

## tests/zephyr/ac01_contract/testcase.yaml
```yaml
tests:
  nucode.ac01.contract:
    tags:
      - nucode
      - arduino
      - ac01
      - gpio
      - interrupt
      - time
    harness: ztest
    sysbuild: false
    platform_allow:
      - nrf54l15dk/nrf54l15/cpuapp/nu54dk
    integration_platforms:
      - nrf54l15dk/nrf54l15/cpuapp/nu54dk
```

## tests/zephyr/ac01_hil/testcase.yaml
```yaml
tests:
  nucode.ac01.gpio_hil:
    tags:
      - nucode
      - arduino
      - ac01
      - gpio
      - hil
    harness: console
    harness_config:
      type: one_line
      regex:
        - "NUCODE_AC01_GPIO_HIL_PASS"
    sysbuild: false
    platform_allow:
      - nrf54l15dk/nrf54l15/cpuapp/nu54dk
    integration_platforms:
      - nrf54l15dk/nrf54l15/cpuapp/nu54dk
```

## tests/zephyr/ac02b_analog_contract/testcase.yaml
```yaml
tests:
  nucode.ac02b.analog_contract:
    tags:
      - nucode
      - arduino
      - ac02b
      - adc
      - pwm
      - tone
      - servo
    harness: ztest
    sysbuild: false
    platform_allow:
      - nrf54l15dk/nrf54l15/cpuapp/nu54dk
    integration_platforms:
      - nrf54l15dk/nrf54l15/cpuapp/nu54dk
```

## tests/zephyr/ac02b_b2_contract/testcase.yaml
```yaml
tests:
  nucode.ac02b.b2_contract:
    tags:
      - nucode
      - arduino
      - ac02b
      - serial
      - wire
      - spi
      - pm
    harness: ztest
    sysbuild: false
    platform_allow:
      - nrf54l15dk/nrf54l15/cpuapp/nu54dk
    integration_platforms:
      - nrf54l15dk/nrf54l15/cpuapp/nu54dk
```

## tests/zephyr/ac02b_hil_peer/testcase.yaml
```yaml
tests:
  nucode.ac02b.hil_peer:
    tags:
      - zephyr
      - hil
      - ac02b
    platform_allow:
      - nrf54l15dk/nrf54l15/cpuapp/nu54dk
    integration_platforms:
      - nrf54l15dk/nrf54l15/cpuapp/nu54dk
    build_only: true
```

## tests/zephyr/ac03_hil/testcase.yaml
```yaml
tests:
  nucode.ac03.storage_hil:
    tags:
      - nucode
      - arduino
      - ac03
      - hil
      - eeprom
      - littlefs
    build_only: true
    platform_allow:
      - nrf54l15dk/nrf54l15/cpuapp/nu54dk
    integration_platforms:
      - nrf54l15dk/nrf54l15/cpuapp/nu54dk
```

## tests/zephyr/ac03_storage_contract/testcase.yaml
```yaml
tests:
  nucode.ac03.storage_contract:
    tags:
      - nucode
      - arduino
      - ac03
      - eeprom
      - littlefs
      - storage
    harness: ztest
    sysbuild: false
    platform_allow:
      - nrf54l15dk/nrf54l15/cpuapp/nu54dk
    integration_platforms:
      - nrf54l15dk/nrf54l15/cpuapp/nu54dk
```

## tests/zephyr/m14_core_contract/testcase.yaml
```yaml
tests:
  nucode.m14.core_contract:
    tags:
      - nucode
      - arduino
      - m14
      - api
      - diagnostics
      - random
    harness: ztest
    sysbuild: false
    platform_allow:
      - nrf54l15dk/nrf54l15/cpuapp/nu54dk
    integration_platforms:
      - nrf54l15dk/nrf54l15/cpuapp/nu54dk
```

## tests/zephyr/m14_cpp_policy/testcase.yaml
```yaml
tests:
  nucode.m14.cpp_policy:
    tags:
      - nucode
      - arduino
      - m14
      - cpp
      - exception
      - rtti
    harness: ztest
    sysbuild: false
    platform_allow:
      - qemu_cortex_m3
    integration_platforms:
      - qemu_cortex_m3
```

## tests/zephyr/m14_pin_hil/testcase.yaml
```yaml
tests:
  nucode.m14.pin_hil:
    tags:
      - nucode
      - arduino
      - m14
      - hil
      - gpio
      - interrupt
    harness: console
    harness_config:
      type: multi_line
      regex:
        - "NUCODE_M14_PIN_HIL_READY:schema=1:action_timeout_ms=30000"
        - "NUCODE_M14_PIN_HIL_PASS"
    sysbuild: false
    platform_allow:
      - nrf54l15dk/nrf54l15/cpuapp/nu54dk
    integration_platforms:
      - nrf54l15dk/nrf54l15/cpuapp/nu54dk
```

## tests/zephyr/m14_variant_contract/testcase.yaml
```yaml
tests:
  nucode.m14.variant_contract:
    tags:
      - nucode
      - arduino
      - m14
      - variant
      - devicetree
    harness: ztest
    sysbuild: false
    platform_allow:
      - nrf54l15dk/nrf54l15/cpuapp/nu54dk
    integration_platforms:
      - nrf54l15dk/nrf54l15/cpuapp/nu54dk
```

## tests/zephyr/m15_board/testcase.yaml
```yaml
tests:
  nucode.m15.board:
    tags:
      - nucode
      - arduino
      - m15
      - board
      - watchdog
      - grtc
      - settings
      - power
      - pmic
    harness: ztest
    sysbuild: false
    platform_allow:
      - nrf54l15dk/nrf54l15/cpuapp/nu54dk
    integration_platforms:
      - nrf54l15dk/nrf54l15/cpuapp/nu54dk
```

## tests/zephyr/m15_hil/testcase.yaml
```yaml
tests:
  nucode.m15.auto_hil:
    tags:
      - nucode
      - arduino
      - hil
      - m15
    build_only: true
    platform_allow:
      - nrf54l15dk/nrf54l15/cpuapp/nu54dk
    integration_platforms:
      - nrf54l15dk/nrf54l15/cpuapp/nu54dk
```

## tests/zephyr/m15_wake/testcase.yaml
```yaml
tests:
  nucode.m15.wake:
    build_only: true
    tags:
      - nucode
      - arduino
      - m15
      - hil
      - power
      - system-off
      - wake
    sysbuild: false
    platform_allow:
      - nrf54l15dk/nrf54l15/cpuapp/nu54dk
    integration_platforms:
      - nrf54l15dk/nrf54l15/cpuapp/nu54dk
```

## tests/zephyr/m16_ble_hil/testcase.yaml
```yaml
tests:
  nucode.m16.ble_hil_peripheral:
    tags:
      - nucode
      - arduino
      - m16
      - bluetooth
      - hil
    build_only: true
    extra_args:
      - M16_ROLE=peripheral
    platform_allow:
      - nrf54l15dk/nrf54l15/cpuapp/nu54dk
    integration_platforms:
      - nrf54l15dk/nrf54l15/cpuapp/nu54dk
  nucode.m16.ble_hil_central:
    tags:
      - nucode
      - arduino
      - m16
      - bluetooth
      - hil
    build_only: true
    extra_args:
      - M16_ROLE=central
    platform_allow:
      - nrf54l15dk/nrf54l15/cpuapp/nu54dk
    integration_platforms:
      - nrf54l15dk/nrf54l15/cpuapp/nu54dk
```

## tests/zephyr/m17_sensor_direct/testcase.yaml
```yaml
tests:
  nucode.m17.sensor_direct:
    build_only: true
    platform_allow:
      - nrf54l15dk/nrf54l15/cpuapp/nu54dk
    tags:
      - m17
      - sensor
```

## tests/zephyr/m19_ble_gap_contract/testcase.yaml
```yaml
tests:
  nucode.m19.ble_gap_contract:
    tags:
      - nucode
      - arduino
      - m19
      - bluetooth
      - gap
    build_only: true
    sysbuild: false
    platform_allow:
      - nrf54l15dk/nrf54l15/cpuapp/nu54dk
    integration_platforms:
      - nrf54l15dk/nrf54l15/cpuapp/nu54dk
```

## tests/zephyr/m19_ble_gap_hil/testcase.yaml
```yaml
tests:
  nucode.m19.ble_gap_hil_peripheral:
    tags:
      - nucode
      - arduino
      - m19
      - bluetooth
      - hil
    build_only: true
    extra_args:
      - M19_ROLE=peripheral
    platform_allow:
      - nrf54l15dk/nrf54l15/cpuapp/nu54dk
    integration_platforms:
      - nrf54l15dk/nrf54l15/cpuapp/nu54dk
  nucode.m19.ble_gap_hil_central:
    tags:
      - nucode
      - arduino
      - m19
      - bluetooth
      - hil
    build_only: true
    extra_args:
      - M19_ROLE=central
    platform_allow:
      - nrf54l15dk/nrf54l15/cpuapp/nu54dk
    integration_platforms:
      - nrf54l15dk/nrf54l15/cpuapp/nu54dk
```

## tests/zephyr/m20_ble_gatt_contract/testcase.yaml
```yaml
tests:
  nucode.m20.ble_gatt_contract:
    tags:
      - nucode
      - arduino
      - m20
      - bluetooth
      - gatt
    build_only: true
    sysbuild: false
    platform_allow:
      - nrf54l15dk/nrf54l15/cpuapp/nu54dk
    integration_platforms:
      - nrf54l15dk/nrf54l15/cpuapp/nu54dk
```

## tests/zephyr/m20_ble_gatt_hil/testcase.yaml
```yaml
tests:
  nucode.m20.ble_gatt_hil_peripheral:
    tags:
      - nucode
      - arduino
      - m20
      - bluetooth
      - hil
    build_only: true
    extra_args:
      - M20_ROLE=peripheral
    platform_allow:
      - nrf54l15dk/nrf54l15/cpuapp/nu54dk
    integration_platforms:
      - nrf54l15dk/nrf54l15/cpuapp/nu54dk
  nucode.m20.ble_gatt_hil_central:
    tags:
      - nucode
      - arduino
      - m20
      - bluetooth
      - hil
    build_only: true
    extra_args:
      - M20_ROLE=central
    platform_allow:
      - nrf54l15dk/nrf54l15/cpuapp/nu54dk
    integration_platforms:
      - nrf54l15dk/nrf54l15/cpuapp/nu54dk
```
