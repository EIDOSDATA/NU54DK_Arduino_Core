## CMakeLists.txt
```
# SPDX-License-Identifier: MIT
cmake_minimum_required(VERSION 3.20.0)
find_package(Zephyr REQUIRED HINTS $ENV{ZEPHYR_BASE})
project(nucode_dtm)
get_filename_component(NUCODE_ROOT "${CMAKE_CURRENT_LIST_DIR}/../../../.." ABSOLUTE)
execute_process(COMMAND git -C "${NUCODE_ROOT}" rev-parse HEAD
    OUTPUT_VARIABLE NUCODE_DIAGNOSTIC_REVISION OUTPUT_STRIP_TRAILING_WHITESPACE
    COMMAND_ERROR_IS_FATAL ANY)
set(identity_input "")
foreach(identity_file CMakeLists.txt Kconfig prj.conf hci.conf app.overlay src/main.c src/protocol.h)
    file(SHA256 "${CMAKE_CURRENT_LIST_DIR}/${identity_file}" identity_hash)
    string(APPEND identity_input "${identity_file}:${identity_hash}\n")
endforeach()
string(SHA256 NUCODE_DIAGNOSTIC_SOURCE_HASH "${identity_input}")
target_sources(app PRIVATE src/main.c)
target_include_directories(app PRIVATE src)
target_compile_definitions(app PRIVATE
    NUCODE_DIAGNOSTIC_REVISION="${NUCODE_DIAGNOSTIC_REVISION}"
    NUCODE_DIAGNOSTIC_SOURCE_HASH="${NUCODE_DIAGNOSTIC_SOURCE_HASH}")
```

## Kconfig
```
# SPDX-License-Identifier: MIT
mainmenu "NU54DK bounded controller diagnostics"
config NUCODE_DIAG_H4
    bool "H4 command transport instead of DTM two-wire"
    default n
source "Kconfig.zephyr"
```

## prj.conf
```kconfig
CONFIG_CONSOLE=n
CONFIG_UART_CONSOLE=n
CONFIG_STDOUT_CONSOLE=n
CONFIG_PRINTK=n
CONFIG_BOOT_BANNER=n
CONFIG_NCS_BOOT_BANNER=n
CONFIG_ASSERT_VERBOSE=n
CONFIG_LOG=n
CONFIG_LOG_PRINTK=n
CONFIG_SERIAL=y
CONFIG_UART_USE_RUNTIME_CONFIGURE=y
CONFIG_ASSERT=y
CONFIG_REBOOT=y
CONFIG_WATCHDOG=y
CONFIG_BT=y
CONFIG_BT_HCI_RAW=y
CONFIG_BT_HCI_RAW_H4=y
CONFIG_BT_HCI_RAW_H4_ENABLE=y
CONFIG_BT_BUF_CMD_TX_SIZE=255
CONFIG_BT_BUF_EVT_RX_SIZE=255
CONFIG_BT_CTLR_PHY_CODED=y
CONFIG_BT_CTLR_DTM_HCI=y
CONFIG_BT_CTLR_DTM_HCI_RX_V3=n
CONFIG_BT_CTLR_EXTENDED_FEAT_SET=y
CONFIG_DTM_TWOWIRE_TO_HCI=y
```

## hci.conf
```kconfig
CONFIG_NUCODE_DIAG_H4=y
```

## app.overlay
```dts
/** @brief DAPLink VCOM을 binary 진단 UART로 독점하고 외부 LFXO 구성을 유지한다. */
&uart20
{
    current-speed = <19200>;
    /delete-property/ hw-flow-control;
};

&lfxo
{
    load-capacitors = "external";
    /delete-property/ load-capacitance-femtofarad;
};

&wdt31
{
    status = "okay";
};
```

## src/main.c
```c
/**
 * @file main.c
 * @brief 고정 NCS SDC를 이용한 유한 DTM 두 선식/H4 진단 application.
 * SPDX-License-Identifier: MIT
 */
#include <zephyr/kernel.h>
#include <zephyr/bluetooth/buf.h>
#include <zephyr/bluetooth/hci_raw.h>
#include <zephyr/drivers/uart.h>
#include <zephyr/drivers/watchdog.h>
#include <zephyr/sys/reboot.h>
#include <errno.h>
#include <bluetooth/dtm_twowire/dtm_twowire_to_hci.h>
#include "protocol.h"

#if defined(CONFIG_BT_HCI_HOST) || defined(CONFIG_NUCODE_ARDUINO_CORE)
#error "DTM owns RADIO, controller, buffers and UART exclusively"
#endif
#if defined(CONFIG_UART_CONSOLE) || defined(CONFIG_PRINTK) || defined(CONFIG_LOG)
#error "Binary diagnostic UART must not contain console or debug output"
#endif

/** @brief 3초 RF lease와 1초 controller 응답 제한은 Host 상태에 무관하게 적용한다. */
#define RF_LEASE_MS 3000
#define COMMAND_TIMEOUT_MS 1000

static K_FIFO_DEFINE(controller_events);
static const struct device *const transport = DEVICE_DT_GET(DT_CHOSEN(zephyr_console));
static const struct device *const watchdog = DEVICE_DT_GET(DT_ALIAS(watchdog0));
static int watchdog_channel;
static bool active;
static int64_t deadline;
/** @brief 읽기 전용 vendor identity는 source와 선택한 transport를 실물에서 대조한다. */
static const char source_identity[] = NUCODE_DIAGNOSTIC_REVISION NUCODE_DIAGNOSTIC_SOURCE_HASH;

/** @brief 복구 불가능한 오류에서는 재부팅하여 RADIO를 끄고 명령 대기로 돌아간다. */
static void fail_closed(void)
{
    sys_reboot(SYS_REBOOT_COLD);
}

/** @brief UART에는 오직 선택한 wire protocol byte만 전송한다. */
static void write_bytes(const uint8_t *bytes, size_t length)
{
    for (size_t index = 0; index < length; ++index)
    {
        uart_poll_out(transport, bytes[index]);
    }
}

/** @brief DTM event를 network byte 순서로 전달한다. */
static void write_twowire(uint16_t event)
{
    const uint8_t bytes[2] = {(uint8_t)(event >> 8), (uint8_t)event};
    write_bytes(bytes, sizeof(bytes));
}

/** @brief HCI command complete 오류를 일정한 frame으로 반환한다. */
static void write_hci_error(uint16_t opcode, uint8_t status)
{
    const uint8_t bytes[7] = {0x04,  0x0e, 0x04, 0x01, (uint8_t)opcode, (uint8_t)(opcode >> 8),
                              status};
    write_bytes(bytes, sizeof(bytes));
}

/** @brief 실제 controller의 matching command complete/status만 수신한다. */
static struct net_buf *execute(struct net_buf *command, uint16_t opcode)
{
    if (bt_send(command) != 0)
    {
        net_buf_unref(command);
        fail_closed();
        return NULL;
    }
    const int64_t until = k_uptime_get() + COMMAND_TIMEOUT_MS;
    while (k_uptime_get() < until)
    {
        struct net_buf *event = k_fifo_get(&controller_events, K_MSEC(20));
        if (event == NULL)
        {
            continue;
        }
        const uint8_t *p = event->data;
        bool matches = false;
        if (event->len >= 7 && p[0] == 0x04 && p[2] + 3 == event->len)
        {
            if (p[1] == 0x0e)
            {
                matches = ((uint16_t)p[4] | ((uint16_t)p[5] << 8)) == opcode;
            }
            else if (p[1] == 0x0f)
            {
                matches = ((uint16_t)p[5] | ((uint16_t)p[6] << 8)) == opcode;
            }
        }
        if (matches)
        {
            return event;
        }
        net_buf_unref(event);
    }
    fail_closed();
    return NULL;
}

/** @brief command buffer가 없으면 무기한 기다리지 않고 RADIO를 정지한다. */
static struct net_buf *allocate_command(void)
{
    struct net_buf *command = bt_buf_get_tx(BT_BUF_CMD, K_MSEC(100), NULL, 0);
    if (command == NULL)
    {
        fail_closed();
    }
    return command;
}

/** @brief Test End를 수행해 실제 수신 counter를 wire event로 반환한다. */
static void stop_test(bool report)
{
    struct net_buf *command = allocate_command();
    const uint8_t bytes[3] = {0x1f, 0x20, 0x00};
    net_buf_add_mem(command, bytes, sizeof(bytes));
    struct net_buf *event = execute(command, 0x201f);
    if (event->len != 9 || event->data[1] != 0x0e || event->data[6] != 0)
    {
        net_buf_unref(event);
        fail_closed();
        return;
    }
    active = false;
    if (report)
    {
        if (IS_ENABLED(CONFIG_NUCODE_DIAG_H4))
        {
            write_bytes(event->data, event->len);
        }
        else
        {
            const uint16_t count = (uint16_t)event->data[7] | ((uint16_t)event->data[8] << 8);
            write_twowire(0x8000 | MIN(count, 0x7fff));
        }
    }
    net_buf_unref(event);
}

/** @brief 최종 Test End 뒤 명시된 인계에서만 watchdog을 정상 해제하고 명령 처리를 끝냅니다. */
static void finish_handover(void)
{
    if (active)
    {
        if (IS_ENABLED(CONFIG_NUCODE_DIAG_H4))
        {
            write_hci_error(0xfc81, 0x0c);
        }
        else
        {
            write_twowire(1);
        }
        return;
    }
    if (wdt_disable(watchdog) != 0)
    {
        fail_closed();
        return;
    }
    if (IS_ENABLED(CONFIG_NUCODE_DIAG_H4))
    {
        write_hci_error(0xfc81, 0);
    }
    else
    {
        write_twowire(0);
    }
    for (;;)
    {
        k_sleep(K_MSEC(1000));
    }
}

/** @brief 표준 두 선식 setup과 TX/RX 명령을 고정 SDK 변환기로 처리한다. */
static void process_twowire(uint16_t word)
{
    if (word == 0x3e00)
    {
        finish_handover();
        return;
    }
    if ((word & 0xff00) == 0x3f00)
    {
        const uint8_t index = word & 0xff;
        write_twowire(index < sizeof(source_identity) - 1
                          ? ((uint16_t)(uint8_t)source_identity[index] << 1)
                          : 1);
        return;
    }
    const uint8_t kind = word >> 14;
    if (kind == 3 && (word & 0x3ffc) == 0)
    {
        stop_test(true);
        return;
    }
    if (active)
    {
        if (word <= 3)
        {
            stop_test(false);
        }
        else
        {
            write_twowire(1);
            return;
        }
    }
    struct net_buf *command = allocate_command();
    uint16_t response = 1;
    dtm_tw_to_hci_status_t status = dtm_tw_to_hci_process_tw_cmd(word, command, &response);
    if (status == DTM_TW_TO_HCI_STATUS_HCI_CMD)
    {
        uint16_t opcode;
        if (!diagnostic_hci_command_opcode(command->data, command->len, &opcode))
        {
            net_buf_unref(command);
            write_twowire(1);
            return;
        }
        struct net_buf *event = execute(command, opcode);
        status = dtm_tw_to_hci_process_hci_event(word, event, &response);
        net_buf_unref(event);
    }
    else
    {
        net_buf_unref(command);
    }
    if (status != DTM_TW_TO_HCI_STATUS_TW_EVENT)
    {
        response = 1;
    }
    if ((kind == 1 || kind == 2) && response == 0)
    {
        active = true;
        deadline = k_uptime_get() + RF_LEASE_MS;
    }
    write_twowire(response);
}

/** @brief H4 모드는 진단 whitelist를 검사한 뒤 실제 SDC response를 전달한다. */
static void process_h4(const uint8_t *bytes)
{
    const uint16_t opcode = (uint16_t)bytes[1] | ((uint16_t)bytes[2] << 8);
    if (opcode == 0xfc80 && bytes[3] == 0)
    {
        const uint8_t header[7] = {0x04, 0x0e, sizeof(source_identity) + 3, 0x01, 0x80, 0xfc, 0x00};
        write_bytes(header, sizeof(header));
        write_bytes((const uint8_t *)source_identity, sizeof(source_identity) - 1);
        return;
    }
    uint8_t status = diagnostic_hci_status(opcode, &bytes[4], bytes[3]);
    if (active && diagnostic_starts(opcode))
    {
        status = 0x0c;
    }
    if (status != 0)
    {
        write_hci_error(opcode, status);
        return;
    }
    if (opcode == 0xfc81)
    {
        finish_handover();
        return;
    }
    if (opcode == 0x201f)
    {
        stop_test(true);
        return;
    }
    struct net_buf *command = allocate_command();
    net_buf_add_mem(command, &bytes[1], bytes[3] + 3);
    struct net_buf *event = execute(command, opcode);
    const bool success = event->data[1] == 0x0e && event->data[6] == 0;
    if (success && diagnostic_starts(opcode))
    {
        active = true;
        deadline = k_uptime_get() + RF_LEASE_MS;
    }
    if (success && opcode == 0x0c03)
    {
        active = false;
    }
    write_bytes(event->data, event->len);
    net_buf_unref(event);
}

/** @brief raw controller와 전용 UART를 한 번 초기화하고 명령을 기다린다. */
int main(void)
{
    if (!device_is_ready(transport) || !device_is_ready(watchdog))
    {
        return -ENODEV;
    }
    const struct wdt_timeout_cfg timeout = {
        .window = {.min = 0, .max = 8000},
        .flags = WDT_FLAG_RESET_SOC,
    };
    watchdog_channel = wdt_install_timeout(watchdog, &timeout);
    if (watchdog_channel < 0 || wdt_setup(watchdog, WDT_OPT_PAUSE_HALTED_BY_DBG) != 0)
    {
        return -EIO;
    }
    const struct uart_config config = {
        .baudrate = IS_ENABLED(CONFIG_NUCODE_DIAG_H4) ? 115200 : 19200,
        .parity = UART_CFG_PARITY_NONE,
        .stop_bits = UART_CFG_STOP_BITS_1,
        .data_bits = UART_CFG_DATA_BITS_8,
        .flow_ctrl = UART_CFG_FLOW_CTRL_NONE,
    };
    if (uart_configure(transport, &config) != 0 || bt_enable_raw(&controller_events) != 0)
    {
        fail_closed();
    }
    struct diagnostic_parser parser = {0};
    for (;;)
    {
        (void)wdt_feed(watchdog, watchdog_channel);
        if (active && k_uptime_get() >= deadline)
        {
            stop_test(true);
        }
        uint8_t byte;
        if (uart_poll_in(transport, &byte) == 0 &&
            diagnostic_feed(&parser, IS_ENABLED(CONFIG_NUCODE_DIAG_H4), byte, k_uptime_get()))
        {
            if (IS_ENABLED(CONFIG_NUCODE_DIAG_H4))
            {
                process_h4(parser.bytes);
            }
            else
            {
                process_twowire(((uint16_t)parser.bytes[0] << 8) | parser.bytes[1]);
            }
        }
        k_sleep(K_USEC(100));
    }
    return 0;
}
```

## src/protocol.h
```c
/**
 * @file protocol.h
 * @brief DTM UART 프레임과 허용 HCI 명령의 길이·범위 검사.
 * SPDX-License-Identifier: MIT
 */
#ifndef NUCODE_DIAGNOSTIC_PROTOCOL_H
#define NUCODE_DIAGNOSTIC_PROTOCOL_H

#include <stdbool.h>
#include <stddef.h>
#include <stdint.h>

/** @brief 단일 command만 보관하는 고정 크기 수신 상태. */
struct diagnostic_parser
{
    uint8_t bytes[259];
    size_t used;
    int64_t last_ms;
};

/** @brief bt_buf_get_tx()가 붙인 H4 command indicator 뒤의 opcode와 길이를 검사합니다. */
static inline bool diagnostic_hci_command_opcode(const uint8_t *bytes, size_t length,
                                                 uint16_t *opcode)
{
    if (bytes == NULL || opcode == NULL || length < 4 || bytes[0] != 0x01 ||
        length != (size_t)bytes[3] + 4)
    {
        return false;
    }
    *opcode = (uint16_t)bytes[1] | ((uint16_t)bytes[2] << 8);
    return true;
}

/** @brief 프레임 간격 초과 입력은 버리고 새 프레임으로 시작한다. */
static inline bool diagnostic_feed(struct diagnostic_parser *parser, bool h4, uint8_t byte,
                                   int64_t now_ms)
{
    if (parser->used > 0 && now_ms - parser->last_ms > (h4 ? 20 : 5))
    {
        parser->used = 0;
    }
    parser->last_ms = now_ms;
    if (h4 && parser->used == 0 && byte != 0x01)
    {
        return false;
    }
    parser->bytes[parser->used++] = byte;
    if ((!h4 && parser->used == 2) ||
        (h4 && parser->used >= 4 && parser->used == (size_t)parser->bytes[3] + 4))
    {
        parser->used = 0;
        return true;
    }
    return false;
}

/** @brief 허용 진단 opcode인지 확인하고 잘못된 parameter에는 0x12를 반환한다. */
static inline uint8_t diagnostic_hci_status(uint16_t opcode, const uint8_t *p, uint8_t length)
{
    switch (opcode)
    {
    case 0x0c03:
    case 0x1001:
    case 0x1003:
    case 0x2003:
    case 0x201f:
    case 0xfc81:
        return length == 0 ? 0 : 0x12;
    case 0x201d:
        return length == 1 && p[0] <= 39 ? 0 : 0x12;
    case 0x201e:
        return length == 3 && p[0] <= 39 && p[2] <= 7 ? 0 : 0x12;
    case 0x2033:
        return length == 3 && p[0] <= 39 && p[1] >= 1 && p[1] <= 3 && p[2] <= 1 ? 0 : 0x12;
    case 0x2034:
        return length == 4 && p[0] <= 39 && p[2] <= 7 && p[3] >= 1 && p[3] <= 4 ? 0 : 0x12;
    default:
        return 0x01;
    }
}

/** @brief RADIO를 시작하는 명령을 식별한다. */
static inline bool diagnostic_starts(uint16_t opcode)
{
    return opcode == 0x201d || opcode == 0x201e || opcode == 0x2033 || opcode == 0x2034;
}

#endif
```
