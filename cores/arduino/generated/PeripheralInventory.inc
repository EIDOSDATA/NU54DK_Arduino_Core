/* Auto-generated by tools/peripheral/verify_m23_inventory.py; do not edit. */
/* SPDX-License-Identifier: MIT */
	{"uarte00", PeripheralKind::uarte, 0U, "serial00", "uart00", "header-p2", "zephyr-uart-nrfx-uarte", "", "", "M24", PeripheralRouteState::candidate, PeripheralSourceState::absent, PeripheralExposureState::none, PeripheralVerificationState::pass, PeripheralVerificationState::not_run, PeripheralVerificationState::not_run, PeripheralVerificationState::not_run, PeripheralVerificationState::not_run, static_cast<PeripheralDmaCapability>(3U), 16U},
	{"uarte20", PeripheralKind::uarte, 20U, "serial20", "uart20", "console-p1.4-p1.7", "zephyr-uart-nrfx-uarte", "Serial", "HardwareSerial", "M24", PeripheralRouteState::verified, PeripheralSourceState::implemented, PeripheralExposureState::public_api, PeripheralVerificationState::pass, PeripheralVerificationState::pass, PeripheralVerificationState::pass, PeripheralVerificationState::pass, PeripheralVerificationState::not_run, static_cast<PeripheralDmaCapability>(3U), 16U},
	{"uarte21", PeripheralKind::uarte, 21U, "serial21", "uart21", "header-p1", "zephyr-uart-nrfx-uarte", "", "", "M24", PeripheralRouteState::candidate, PeripheralSourceState::absent, PeripheralExposureState::none, PeripheralVerificationState::pass, PeripheralVerificationState::not_run, PeripheralVerificationState::not_run, PeripheralVerificationState::not_run, PeripheralVerificationState::not_run, static_cast<PeripheralDmaCapability>(3U), 16U},
	{"uarte22", PeripheralKind::uarte, 22U, "serial22", "uart22", "header-p1", "zephyr-uart-nrfx-uarte", "", "", "M24", PeripheralRouteState::candidate, PeripheralSourceState::absent, PeripheralExposureState::none, PeripheralVerificationState::pass, PeripheralVerificationState::not_run, PeripheralVerificationState::not_run, PeripheralVerificationState::not_run, PeripheralVerificationState::not_run, static_cast<PeripheralDmaCapability>(3U), 16U},
	{"uarte30", PeripheralKind::uarte, 30U, "serial30", "uart30", "dap-vcom-p0.0-p0.3", "zephyr-uart-nrfx-uarte", "Serial1", "Nu54HardwareSerial", "M24", PeripheralRouteState::verified, PeripheralSourceState::implemented, PeripheralExposureState::public_api, PeripheralVerificationState::pass, PeripheralVerificationState::pass, PeripheralVerificationState::pass, PeripheralVerificationState::pass, PeripheralVerificationState::partial, static_cast<PeripheralDmaCapability>(3U), 16U},
	{"spim00", PeripheralKind::spim, 0U, "serial00", "spi00", "header-p2.1-p2.4", "zephyr-spi-nrfx-spim", "SPI", "SPIClass", "M24", PeripheralRouteState::verified, PeripheralSourceState::implemented, PeripheralExposureState::public_api, PeripheralVerificationState::pass, PeripheralVerificationState::pass, PeripheralVerificationState::pass, PeripheralVerificationState::pass, PeripheralVerificationState::partial, static_cast<PeripheralDmaCapability>(7U), 16U},
	{"spim20", PeripheralKind::spim, 20U, "serial20", "spi20", "header-p1-console-conflict", "zephyr-spi-nrfx-spim", "", "", "M24", PeripheralRouteState::candidate, PeripheralSourceState::absent, PeripheralExposureState::none, PeripheralVerificationState::pass, PeripheralVerificationState::not_run, PeripheralVerificationState::not_run, PeripheralVerificationState::not_run, PeripheralVerificationState::not_run, static_cast<PeripheralDmaCapability>(3U), 16U},
	{"spim21", PeripheralKind::spim, 21U, "serial21", "spi21", "header-p1", "zephyr-spi-nrfx-spim", "", "", "M24", PeripheralRouteState::candidate, PeripheralSourceState::absent, PeripheralExposureState::none, PeripheralVerificationState::pass, PeripheralVerificationState::not_run, PeripheralVerificationState::not_run, PeripheralVerificationState::not_run, PeripheralVerificationState::not_run, static_cast<PeripheralDmaCapability>(3U), 16U},
	{"spim22", PeripheralKind::spim, 22U, "serial22", "spi22", "header-p1-wire-conflict", "zephyr-spi-nrfx-spim", "", "", "M24", PeripheralRouteState::candidate, PeripheralSourceState::absent, PeripheralExposureState::none, PeripheralVerificationState::pass, PeripheralVerificationState::not_run, PeripheralVerificationState::not_run, PeripheralVerificationState::not_run, PeripheralVerificationState::not_run, static_cast<PeripheralDmaCapability>(3U), 16U},
	{"spim30", PeripheralKind::spim, 30U, "serial30", "spi30", "header-p0-dap-conflict", "zephyr-spi-nrfx-spim", "", "", "M24", PeripheralRouteState::candidate, PeripheralSourceState::absent, PeripheralExposureState::none, PeripheralVerificationState::pass, PeripheralVerificationState::not_run, PeripheralVerificationState::not_run, PeripheralVerificationState::not_run, PeripheralVerificationState::not_run, static_cast<PeripheralDmaCapability>(3U), 16U},
	{"spis00", PeripheralKind::spis, 0U, "serial00", "spi00", "header-p2", "nrfx-spis", "", "", "M24", PeripheralRouteState::candidate, PeripheralSourceState::absent, PeripheralExposureState::none, PeripheralVerificationState::pass, PeripheralVerificationState::not_run, PeripheralVerificationState::not_run, PeripheralVerificationState::not_run, PeripheralVerificationState::not_run, static_cast<PeripheralDmaCapability>(1U), 16U},
	{"spis20", PeripheralKind::spis, 20U, "serial20", "spi20", "header-p1-console-conflict", "nrfx-spis", "", "", "M24", PeripheralRouteState::candidate, PeripheralSourceState::absent, PeripheralExposureState::none, PeripheralVerificationState::pass, PeripheralVerificationState::not_run, PeripheralVerificationState::not_run, PeripheralVerificationState::not_run, PeripheralVerificationState::not_run, static_cast<PeripheralDmaCapability>(1U), 16U},
	{"spis21", PeripheralKind::spis, 21U, "serial21", "spi21", "header-p1", "nrfx-spis", "", "", "M24", PeripheralRouteState::candidate, PeripheralSourceState::absent, PeripheralExposureState::none, PeripheralVerificationState::pass, PeripheralVerificationState::not_run, PeripheralVerificationState::not_run, PeripheralVerificationState::not_run, PeripheralVerificationState::not_run, static_cast<PeripheralDmaCapability>(1U), 16U},
	{"spis22", PeripheralKind::spis, 22U, "serial22", "spi22", "header-p1-wire-conflict", "nrfx-spis", "", "", "M24", PeripheralRouteState::candidate, PeripheralSourceState::absent, PeripheralExposureState::none, PeripheralVerificationState::pass, PeripheralVerificationState::not_run, PeripheralVerificationState::not_run, PeripheralVerificationState::not_run, PeripheralVerificationState::not_run, static_cast<PeripheralDmaCapability>(1U), 16U},
	{"spis30", PeripheralKind::spis, 30U, "serial30", "spi30", "header-p0-dap-conflict", "nrfx-spis", "", "", "M24", PeripheralRouteState::candidate, PeripheralSourceState::absent, PeripheralExposureState::none, PeripheralVerificationState::pass, PeripheralVerificationState::not_run, PeripheralVerificationState::not_run, PeripheralVerificationState::not_run, PeripheralVerificationState::not_run, static_cast<PeripheralDmaCapability>(1U), 16U},
	{"twim20", PeripheralKind::twim, 20U, "serial20", "i2c20", "header-p1-console-conflict", "zephyr-i2c-nrfx-twim", "", "", "M24", PeripheralRouteState::candidate, PeripheralSourceState::absent, PeripheralExposureState::none, PeripheralVerificationState::pass, PeripheralVerificationState::not_run, PeripheralVerificationState::not_run, PeripheralVerificationState::not_run, PeripheralVerificationState::not_run, static_cast<PeripheralDmaCapability>(3U), 16U},
	{"twim21", PeripheralKind::twim, 21U, "serial21", "i2c21", "header-p1", "zephyr-i2c-nrfx-twim", "", "", "M24", PeripheralRouteState::candidate, PeripheralSourceState::absent, PeripheralExposureState::none, PeripheralVerificationState::pass, PeripheralVerificationState::not_run, PeripheralVerificationState::not_run, PeripheralVerificationState::not_run, PeripheralVerificationState::not_run, static_cast<PeripheralDmaCapability>(3U), 16U},
	{"twim22", PeripheralKind::twim, 22U, "serial22", "i2c22", "header-p1.2-p1.3", "zephyr-i2c-nrfx-twim", "Wire", "TwoWire", "M24", PeripheralRouteState::verified, PeripheralSourceState::implemented, PeripheralExposureState::public_api, PeripheralVerificationState::pass, PeripheralVerificationState::pass, PeripheralVerificationState::pass, PeripheralVerificationState::pass, PeripheralVerificationState::partial, static_cast<PeripheralDmaCapability>(7U), 16U},
	{"twim30", PeripheralKind::twim, 30U, "serial30", "i2c30", "header-p0-dap-conflict", "zephyr-i2c-nrfx-twim", "", "", "M24", PeripheralRouteState::candidate, PeripheralSourceState::absent, PeripheralExposureState::none, PeripheralVerificationState::pass, PeripheralVerificationState::not_run, PeripheralVerificationState::not_run, PeripheralVerificationState::not_run, PeripheralVerificationState::not_run, static_cast<PeripheralDmaCapability>(3U), 16U},
	{"twis20", PeripheralKind::twis, 20U, "serial20", "i2c20", "header-p1-console-conflict", "nrfx-twis", "", "", "M24", PeripheralRouteState::candidate, PeripheralSourceState::absent, PeripheralExposureState::none, PeripheralVerificationState::pass, PeripheralVerificationState::not_run, PeripheralVerificationState::not_run, PeripheralVerificationState::not_run, PeripheralVerificationState::not_run, static_cast<PeripheralDmaCapability>(1U), 16U},
	{"twis21", PeripheralKind::twis, 21U, "serial21", "i2c21", "header-p1", "nrfx-twis", "", "", "M24", PeripheralRouteState::candidate, PeripheralSourceState::absent, PeripheralExposureState::none, PeripheralVerificationState::pass, PeripheralVerificationState::not_run, PeripheralVerificationState::not_run, PeripheralVerificationState::not_run, PeripheralVerificationState::not_run, static_cast<PeripheralDmaCapability>(1U), 16U},
	{"twis22", PeripheralKind::twis, 22U, "serial22", "i2c22", "header-p1-wire-route", "nrfx-twis", "", "", "M24", PeripheralRouteState::candidate, PeripheralSourceState::absent, PeripheralExposureState::none, PeripheralVerificationState::pass, PeripheralVerificationState::not_run, PeripheralVerificationState::not_run, PeripheralVerificationState::not_run, PeripheralVerificationState::not_run, static_cast<PeripheralDmaCapability>(1U), 16U},
	{"twis30", PeripheralKind::twis, 30U, "serial30", "i2c30", "header-p0-dap-conflict", "nrfx-twis", "", "", "M24", PeripheralRouteState::candidate, PeripheralSourceState::absent, PeripheralExposureState::none, PeripheralVerificationState::pass, PeripheralVerificationState::not_run, PeripheralVerificationState::not_run, PeripheralVerificationState::not_run, PeripheralVerificationState::not_run, static_cast<PeripheralDmaCapability>(1U), 16U},
	{"gpio0", PeripheralKind::gpio, 0U, "", "gpio0", "header-p0-conditional-dap", "zephyr-gpio-nrfx", "", "pinMode,digitalRead,digitalWrite", "M25", PeripheralRouteState::verified, PeripheralSourceState::implemented, PeripheralExposureState::public_api, PeripheralVerificationState::pass, PeripheralVerificationState::pass, PeripheralVerificationState::pass, PeripheralVerificationState::partial, PeripheralVerificationState::partial, static_cast<PeripheralDmaCapability>(0U), 0U},
	{"gpio1", PeripheralKind::gpio, 1U, "", "gpio1", "header-p1-mixed-policy", "zephyr-gpio-nrfx", "", "pinMode,digitalRead,digitalWrite", "M25", PeripheralRouteState::verified, PeripheralSourceState::implemented, PeripheralExposureState::public_api, PeripheralVerificationState::pass, PeripheralVerificationState::pass, PeripheralVerificationState::pass, PeripheralVerificationState::partial, PeripheralVerificationState::partial, static_cast<PeripheralDmaCapability>(0U), 0U},
	{"gpio2", PeripheralKind::gpio, 2U, "", "gpio2", "header-p2-mixed-policy", "zephyr-gpio-nrfx", "", "pinMode,digitalRead,digitalWrite", "M25", PeripheralRouteState::verified, PeripheralSourceState::implemented, PeripheralExposureState::public_api, PeripheralVerificationState::pass, PeripheralVerificationState::pass, PeripheralVerificationState::pass, PeripheralVerificationState::partial, PeripheralVerificationState::partial, static_cast<PeripheralDmaCapability>(0U), 0U},
	{"gpiote20", PeripheralKind::gpiote, 20U, "", "gpiote20", "gpio1-events", "zephyr-gpio-nrfx", "", "attachInterrupt", "M25", PeripheralRouteState::verified, PeripheralSourceState::internal, PeripheralExposureState::public_api, PeripheralVerificationState::pass, PeripheralVerificationState::pass, PeripheralVerificationState::pass, PeripheralVerificationState::partial, PeripheralVerificationState::not_run, static_cast<PeripheralDmaCapability>(0U), 0U},
	{"gpiote30", PeripheralKind::gpiote, 30U, "", "gpiote30", "gpio0-events", "zephyr-gpio-nrfx", "", "attachInterrupt", "M25", PeripheralRouteState::verified, PeripheralSourceState::internal, PeripheralExposureState::public_api, PeripheralVerificationState::pass, PeripheralVerificationState::pass, PeripheralVerificationState::pass, PeripheralVerificationState::partial, PeripheralVerificationState::not_run, static_cast<PeripheralDmaCapability>(0U), 0U},
	{"egu10", PeripheralKind::egu, 10U, "", "egu10", "internal-event", "nrfx-egu", "", "", "M25", PeripheralRouteState::not_required, PeripheralSourceState::absent, PeripheralExposureState::none, PeripheralVerificationState::pass, PeripheralVerificationState::not_run, PeripheralVerificationState::not_run, PeripheralVerificationState::not_run, PeripheralVerificationState::not_run, static_cast<PeripheralDmaCapability>(0U), 0U},
	{"egu20", PeripheralKind::egu, 20U, "", "egu20", "internal-event", "nrfx-egu", "", "", "M25", PeripheralRouteState::not_required, PeripheralSourceState::absent, PeripheralExposureState::none, PeripheralVerificationState::pass, PeripheralVerificationState::not_run, PeripheralVerificationState::not_run, PeripheralVerificationState::not_run, PeripheralVerificationState::not_run, static_cast<PeripheralDmaCapability>(0U), 0U},
	{"dppic00", PeripheralKind::dppic, 0U, "", "dppic00", "domain-00", "nrfx-dppi", "", "", "M25", PeripheralRouteState::not_required, PeripheralSourceState::absent, PeripheralExposureState::none, PeripheralVerificationState::pass, PeripheralVerificationState::not_run, PeripheralVerificationState::not_run, PeripheralVerificationState::not_run, PeripheralVerificationState::not_run, static_cast<PeripheralDmaCapability>(0U), 0U},
	{"dppic10", PeripheralKind::dppic, 10U, "", "dppic10", "domain-10", "nrfx-dppi", "", "", "M25", PeripheralRouteState::not_required, PeripheralSourceState::absent, PeripheralExposureState::none, PeripheralVerificationState::pass, PeripheralVerificationState::not_run, PeripheralVerificationState::not_run, PeripheralVerificationState::not_run, PeripheralVerificationState::not_run, static_cast<PeripheralDmaCapability>(0U), 0U},
	{"dppic20", PeripheralKind::dppic, 20U, "", "dppic20", "domain-20", "nrfx-dppi", "", "", "M25", PeripheralRouteState::not_required, PeripheralSourceState::absent, PeripheralExposureState::none, PeripheralVerificationState::pass, PeripheralVerificationState::not_run, PeripheralVerificationState::not_run, PeripheralVerificationState::not_run, PeripheralVerificationState::not_run, static_cast<PeripheralDmaCapability>(0U), 0U},
	{"dppic30", PeripheralKind::dppic, 30U, "", "dppic30", "domain-30", "nrfx-dppi", "", "", "M25", PeripheralRouteState::not_required, PeripheralSourceState::absent, PeripheralExposureState::none, PeripheralVerificationState::pass, PeripheralVerificationState::not_run, PeripheralVerificationState::not_run, PeripheralVerificationState::not_run, PeripheralVerificationState::not_run, static_cast<PeripheralDmaCapability>(0U), 0U},
	{"ppib00", PeripheralKind::ppib, 0U, "", "ppib00", "domain-00-bridge", "nrfx-ppib", "", "", "M25", PeripheralRouteState::not_required, PeripheralSourceState::absent, PeripheralExposureState::none, PeripheralVerificationState::pass, PeripheralVerificationState::not_run, PeripheralVerificationState::not_run, PeripheralVerificationState::not_run, PeripheralVerificationState::not_run, static_cast<PeripheralDmaCapability>(0U), 0U},
	{"ppib01", PeripheralKind::ppib, 1U, "", "ppib01", "domain-00-bridge", "nrfx-ppib", "", "", "M25", PeripheralRouteState::not_required, PeripheralSourceState::absent, PeripheralExposureState::none, PeripheralVerificationState::pass, PeripheralVerificationState::not_run, PeripheralVerificationState::not_run, PeripheralVerificationState::not_run, PeripheralVerificationState::not_run, static_cast<PeripheralDmaCapability>(0U), 0U},
	{"ppib10", PeripheralKind::ppib, 10U, "", "ppib10", "domain-10-bridge", "nrfx-ppib", "", "", "M25", PeripheralRouteState::not_required, PeripheralSourceState::absent, PeripheralExposureState::none, PeripheralVerificationState::pass, PeripheralVerificationState::not_run, PeripheralVerificationState::not_run, PeripheralVerificationState::not_run, PeripheralVerificationState::not_run, static_cast<PeripheralDmaCapability>(0U), 0U},
	{"ppib11", PeripheralKind::ppib, 11U, "", "ppib11", "domain-10-bridge", "nrfx-ppib", "", "", "M25", PeripheralRouteState::not_required, PeripheralSourceState::absent, PeripheralExposureState::none, PeripheralVerificationState::pass, PeripheralVerificationState::not_run, PeripheralVerificationState::not_run, PeripheralVerificationState::not_run, PeripheralVerificationState::not_run, static_cast<PeripheralDmaCapability>(0U), 0U},
	{"ppib20", PeripheralKind::ppib, 20U, "", "ppib20", "domain-20-bridge", "nrfx-ppib", "", "", "M25", PeripheralRouteState::not_required, PeripheralSourceState::absent, PeripheralExposureState::none, PeripheralVerificationState::pass, PeripheralVerificationState::not_run, PeripheralVerificationState::not_run, PeripheralVerificationState::not_run, PeripheralVerificationState::not_run, static_cast<PeripheralDmaCapability>(0U), 0U},
	{"ppib21", PeripheralKind::ppib, 21U, "", "ppib21", "domain-20-bridge", "nrfx-ppib", "", "", "M25", PeripheralRouteState::not_required, PeripheralSourceState::absent, PeripheralExposureState::none, PeripheralVerificationState::pass, PeripheralVerificationState::not_run, PeripheralVerificationState::not_run, PeripheralVerificationState::not_run, PeripheralVerificationState::not_run, static_cast<PeripheralDmaCapability>(0U), 0U},
	{"ppib22", PeripheralKind::ppib, 22U, "", "ppib22", "domain-20-bridge", "nrfx-ppib", "", "", "M25", PeripheralRouteState::not_required, PeripheralSourceState::absent, PeripheralExposureState::none, PeripheralVerificationState::pass, PeripheralVerificationState::not_run, PeripheralVerificationState::not_run, PeripheralVerificationState::not_run, PeripheralVerificationState::not_run, static_cast<PeripheralDmaCapability>(0U), 0U},
	{"ppib30", PeripheralKind::ppib, 30U, "", "ppib30", "domain-30-bridge", "nrfx-ppib", "", "", "M25", PeripheralRouteState::not_required, PeripheralSourceState::absent, PeripheralExposureState::none, PeripheralVerificationState::pass, PeripheralVerificationState::not_run, PeripheralVerificationState::not_run, PeripheralVerificationState::not_run, PeripheralVerificationState::not_run, static_cast<PeripheralDmaCapability>(0U), 0U},
	{"timer00", PeripheralKind::timer, 0U, "", "timer00", "domain-00", "nrfx-timer", "", "", "M25", PeripheralRouteState::not_required, PeripheralSourceState::absent, PeripheralExposureState::none, PeripheralVerificationState::pass, PeripheralVerificationState::not_run, PeripheralVerificationState::not_run, PeripheralVerificationState::not_run, PeripheralVerificationState::not_run, static_cast<PeripheralDmaCapability>(0U), 0U},
	{"timer10", PeripheralKind::timer, 10U, "", "timer10", "domain-10", "nrfx-timer", "", "", "M25", PeripheralRouteState::not_required, PeripheralSourceState::absent, PeripheralExposureState::none, PeripheralVerificationState::pass, PeripheralVerificationState::not_run, PeripheralVerificationState::not_run, PeripheralVerificationState::not_run, PeripheralVerificationState::not_run, static_cast<PeripheralDmaCapability>(0U), 0U},
	{"timer20", PeripheralKind::timer, 20U, "", "timer20", "domain-20", "nrfx-timer", "", "", "M25", PeripheralRouteState::not_required, PeripheralSourceState::absent, PeripheralExposureState::none, PeripheralVerificationState::pass, PeripheralVerificationState::not_run, PeripheralVerificationState::not_run, PeripheralVerificationState::not_run, PeripheralVerificationState::not_run, static_cast<PeripheralDmaCapability>(0U), 0U},
	{"timer21", PeripheralKind::timer, 21U, "", "timer21", "domain-20", "nrfx-timer", "", "", "M25", PeripheralRouteState::not_required, PeripheralSourceState::absent, PeripheralExposureState::none, PeripheralVerificationState::pass, PeripheralVerificationState::not_run, PeripheralVerificationState::not_run, PeripheralVerificationState::not_run, PeripheralVerificationState::not_run, static_cast<PeripheralDmaCapability>(0U), 0U},
	{"timer22", PeripheralKind::timer, 22U, "", "timer22", "domain-20", "nrfx-timer", "", "", "M25", PeripheralRouteState::not_required, PeripheralSourceState::absent, PeripheralExposureState::none, PeripheralVerificationState::pass, PeripheralVerificationState::not_run, PeripheralVerificationState::not_run, PeripheralVerificationState::not_run, PeripheralVerificationState::not_run, static_cast<PeripheralDmaCapability>(0U), 0U},
	{"timer23", PeripheralKind::timer, 23U, "", "timer23", "domain-20", "nrfx-timer", "", "", "M25", PeripheralRouteState::not_required, PeripheralSourceState::absent, PeripheralExposureState::none, PeripheralVerificationState::pass, PeripheralVerificationState::not_run, PeripheralVerificationState::not_run, PeripheralVerificationState::not_run, PeripheralVerificationState::not_run, static_cast<PeripheralDmaCapability>(0U), 0U},
	{"timer24", PeripheralKind::timer, 24U, "", "timer24", "domain-20", "nrfx-timer", "", "", "M25", PeripheralRouteState::not_required, PeripheralSourceState::absent, PeripheralExposureState::none, PeripheralVerificationState::pass, PeripheralVerificationState::not_run, PeripheralVerificationState::not_run, PeripheralVerificationState::not_run, PeripheralVerificationState::not_run, static_cast<PeripheralDmaCapability>(0U), 0U},
	{"grtc", PeripheralKind::grtc, 0U, "", "grtc", "system-counter", "nrfx-grtc+zephyr-counter", "", "millis,micros,BoardSystem.counter,BoardSystem.alarm", "M25", PeripheralRouteState::not_required, PeripheralSourceState::partial, PeripheralExposureState::public_api, PeripheralVerificationState::pass, PeripheralVerificationState::pass, PeripheralVerificationState::pass, PeripheralVerificationState::pass, PeripheralVerificationState::not_run, static_cast<PeripheralDmaCapability>(0U), 0U},
	{"saadc", PeripheralKind::saadc, 0U, "", "adc", "ain0-ain7-policy-limited", "zephyr-adc-nrfx-saadc", "", "analogRead", "M25", PeripheralRouteState::partial, PeripheralSourceState::partial, PeripheralExposureState::public_api, PeripheralVerificationState::pass, PeripheralVerificationState::pass, PeripheralVerificationState::pass, PeripheralVerificationState::pass, PeripheralVerificationState::partial, static_cast<PeripheralDmaCapability>(7U), 16U},
	{"pwm20", PeripheralKind::pwm, 20U, "", "pwm20", "header-p1-runtime", "zephyr-pwm-nrfx", "", "analogWrite", "M25", PeripheralRouteState::verified, PeripheralSourceState::partial, PeripheralExposureState::public_api, PeripheralVerificationState::pass, PeripheralVerificationState::pass, PeripheralVerificationState::pass, PeripheralVerificationState::pass, PeripheralVerificationState::partial, static_cast<PeripheralDmaCapability>(7U), 15U},
	{"pwm21", PeripheralKind::pwm, 21U, "", "pwm21", "header-p1-runtime", "zephyr-pwm-nrfx", "", "tone,noTone", "M25", PeripheralRouteState::verified, PeripheralSourceState::partial, PeripheralExposureState::public_api, PeripheralVerificationState::pass, PeripheralVerificationState::pass, PeripheralVerificationState::pass, PeripheralVerificationState::not_run, PeripheralVerificationState::not_run, static_cast<PeripheralDmaCapability>(7U), 15U},
	{"pwm22", PeripheralKind::pwm, 22U, "", "pwm22", "header-p1-runtime", "zephyr-pwm-nrfx", "", "Servo", "M25", PeripheralRouteState::verified, PeripheralSourceState::partial, PeripheralExposureState::public_api, PeripheralVerificationState::pass, PeripheralVerificationState::pass, PeripheralVerificationState::pass, PeripheralVerificationState::not_run, PeripheralVerificationState::not_run, static_cast<PeripheralDmaCapability>(7U), 15U},
	{"pdm20", PeripheralKind::pdm, 20U, "", "pdm20", "header-p1", "nrfx-pdm", "", "", "M25", PeripheralRouteState::candidate, PeripheralSourceState::absent, PeripheralExposureState::none, PeripheralVerificationState::pass, PeripheralVerificationState::not_run, PeripheralVerificationState::not_run, PeripheralVerificationState::not_run, PeripheralVerificationState::not_run, static_cast<PeripheralDmaCapability>(1U), 16U},
	{"pdm21", PeripheralKind::pdm, 21U, "", "pdm21", "header-p1", "nrfx-pdm", "", "", "M25", PeripheralRouteState::candidate, PeripheralSourceState::absent, PeripheralExposureState::none, PeripheralVerificationState::pass, PeripheralVerificationState::not_run, PeripheralVerificationState::not_run, PeripheralVerificationState::not_run, PeripheralVerificationState::not_run, static_cast<PeripheralDmaCapability>(1U), 16U},
	{"i2s20", PeripheralKind::i2s, 20U, "", "i2s20", "header-p1", "zephyr-i2s-nrfx", "", "", "M25", PeripheralRouteState::candidate, PeripheralSourceState::absent, PeripheralExposureState::none, PeripheralVerificationState::pass, PeripheralVerificationState::not_run, PeripheralVerificationState::not_run, PeripheralVerificationState::not_run, PeripheralVerificationState::not_run, static_cast<PeripheralDmaCapability>(3U), 16U},
	{"qdec20", PeripheralKind::qdec, 20U, "", "qdec20", "header-p1", "nrfx-qdec", "", "", "M25", PeripheralRouteState::candidate, PeripheralSourceState::absent, PeripheralExposureState::none, PeripheralVerificationState::pass, PeripheralVerificationState::not_run, PeripheralVerificationState::not_run, PeripheralVerificationState::not_run, PeripheralVerificationState::not_run, static_cast<PeripheralDmaCapability>(0U), 0U},
	{"qdec21", PeripheralKind::qdec, 21U, "", "qdec21", "header-p1", "nrfx-qdec", "", "", "M25", PeripheralRouteState::candidate, PeripheralSourceState::absent, PeripheralExposureState::none, PeripheralVerificationState::pass, PeripheralVerificationState::not_run, PeripheralVerificationState::not_run, PeripheralVerificationState::not_run, PeripheralVerificationState::not_run, static_cast<PeripheralDmaCapability>(0U), 0U},
	{"comp", PeripheralKind::comp, 0U, "comparator106", "comp", "analog-input-policy", "nrfx-comp", "", "", "M26", PeripheralRouteState::candidate, PeripheralSourceState::absent, PeripheralExposureState::none, PeripheralVerificationState::pass, PeripheralVerificationState::not_run, PeripheralVerificationState::not_run, PeripheralVerificationState::not_run, PeripheralVerificationState::not_run, static_cast<PeripheralDmaCapability>(0U), 0U},
	{"lpcomp", PeripheralKind::lpcomp, 0U, "comparator106", "comp", "analog-input-policy", "nrfx-lpcomp", "", "", "M26", PeripheralRouteState::candidate, PeripheralSourceState::absent, PeripheralExposureState::none, PeripheralVerificationState::pass, PeripheralVerificationState::not_run, PeripheralVerificationState::not_run, PeripheralVerificationState::not_run, PeripheralVerificationState::not_run, static_cast<PeripheralDmaCapability>(0U), 0U},
	{"temp", PeripheralKind::temp, 0U, "", "temp", "on-chip", "zephyr-sensor-nrf-temp", "", "", "M26", PeripheralRouteState::not_required, PeripheralSourceState::absent, PeripheralExposureState::none, PeripheralVerificationState::pass, PeripheralVerificationState::not_run, PeripheralVerificationState::not_run, PeripheralVerificationState::not_run, PeripheralVerificationState::not_run, static_cast<PeripheralDmaCapability>(0U), 0U},
	{"wdt30", PeripheralKind::wdt, 30U, "", "wdt30", "secure-domain", "zephyr-watchdog-nrfx", "", "", "M26", PeripheralRouteState::not_required, PeripheralSourceState::absent, PeripheralExposureState::none, PeripheralVerificationState::pass, PeripheralVerificationState::not_run, PeripheralVerificationState::not_run, PeripheralVerificationState::not_run, PeripheralVerificationState::not_run, static_cast<PeripheralDmaCapability>(0U), 0U},
	{"wdt31", PeripheralKind::wdt, 31U, "", "wdt31", "application-domain", "zephyr-watchdog-nrfx", "", "BoardSystem.watchdog", "M26", PeripheralRouteState::not_required, PeripheralSourceState::partial, PeripheralExposureState::public_api, PeripheralVerificationState::pass, PeripheralVerificationState::pass, PeripheralVerificationState::pass, PeripheralVerificationState::pass, PeripheralVerificationState::not_run, static_cast<PeripheralDmaCapability>(0U), 0U},
	{"nfct", PeripheralKind::nfct, 0U, "", "nfct", "p1.2-p1.3-wire-conflict", "nrfx-nfct", "", "", "M26", PeripheralRouteState::candidate, PeripheralSourceState::absent, PeripheralExposureState::none, PeripheralVerificationState::pass, PeripheralVerificationState::not_run, PeripheralVerificationState::not_run, PeripheralVerificationState::not_run, PeripheralVerificationState::not_run, static_cast<PeripheralDmaCapability>(1U), 9U},
	{"radio", PeripheralKind::radio, 0U, "", "radio", "on-chip-antenna-network", "nordic-sdc+zephyr-bluetooth", "", "NUCODE_BLE", "M26", PeripheralRouteState::not_required, PeripheralSourceState::partial, PeripheralExposureState::public_api, PeripheralVerificationState::pass, PeripheralVerificationState::pass, PeripheralVerificationState::pass, PeripheralVerificationState::pass, PeripheralVerificationState::not_run, static_cast<PeripheralDmaCapability>(3U), 0U},
	{"cracen", PeripheralKind::cracen, 0U, "security", "", "secure-system", "nrf-security-psa-cracen", "", "", "M26", PeripheralRouteState::not_required, PeripheralSourceState::internal, PeripheralExposureState::internal, PeripheralVerificationState::pass, PeripheralVerificationState::partial, PeripheralVerificationState::not_run, PeripheralVerificationState::not_run, PeripheralVerificationState::not_run, static_cast<PeripheralDmaCapability>(3U), 0U},
	{"kmu", PeripheralKind::kmu, 0U, "security", "", "secure-system", "nrf-security-kmu", "", "", "M26", PeripheralRouteState::not_required, PeripheralSourceState::absent, PeripheralExposureState::none, PeripheralVerificationState::pass, PeripheralVerificationState::not_run, PeripheralVerificationState::not_run, PeripheralVerificationState::not_run, PeripheralVerificationState::not_run, static_cast<PeripheralDmaCapability>(0U), 0U},
	{"rng", PeripheralKind::rng, 0U, "security", "", "secure-system", "nrf-security-psa-rng", "", "", "M26", PeripheralRouteState::not_required, PeripheralSourceState::internal, PeripheralExposureState::internal, PeripheralVerificationState::pass, PeripheralVerificationState::partial, PeripheralVerificationState::not_run, PeripheralVerificationState::not_run, PeripheralVerificationState::not_run, static_cast<PeripheralDmaCapability>(0U), 0U},
	{"tampc", PeripheralKind::tampc, 0U, "security", "", "secure-system", "nrfx-tampc", "", "", "M26", PeripheralRouteState::not_required, PeripheralSourceState::absent, PeripheralExposureState::none, PeripheralVerificationState::pass, PeripheralVerificationState::not_run, PeripheralVerificationState::not_run, PeripheralVerificationState::not_run, PeripheralVerificationState::not_run, static_cast<PeripheralDmaCapability>(0U), 0U},
	{"power", PeripheralKind::power, 0U, "system", "power", "soc-system", "zephyr-pm+nrf-power", "", "BoardSystem.systemOff", "M26", PeripheralRouteState::not_required, PeripheralSourceState::internal, PeripheralExposureState::public_api, PeripheralVerificationState::pass, PeripheralVerificationState::pass, PeripheralVerificationState::pass, PeripheralVerificationState::pass, PeripheralVerificationState::not_run, static_cast<PeripheralDmaCapability>(0U), 0U},
	{"clock", PeripheralKind::clock, 0U, "system", "clock", "soc-system", "zephyr-clock-control-nrf", "", "", "M26", PeripheralRouteState::not_required, PeripheralSourceState::internal, PeripheralExposureState::internal, PeripheralVerificationState::pass, PeripheralVerificationState::pass, PeripheralVerificationState::partial, PeripheralVerificationState::partial, PeripheralVerificationState::not_run, static_cast<PeripheralDmaCapability>(0U), 0U},
	{"cache", PeripheralKind::cache, 0U, "system", "", "cpuapp-system", "zephyr-cache-management", "", "", "M26", PeripheralRouteState::not_required, PeripheralSourceState::internal, PeripheralExposureState::internal, PeripheralVerificationState::pass, PeripheralVerificationState::pass, PeripheralVerificationState::not_run, PeripheralVerificationState::not_run, PeripheralVerificationState::not_run, static_cast<PeripheralDmaCapability>(0U), 0U},
	{"vpr", PeripheralKind::vpr, 0U, "", "cpuflpr_vpr", "cpuflpr", "zephyr-vpr-coprocessor", "", "", "M26", PeripheralRouteState::not_required, PeripheralSourceState::absent, PeripheralExposureState::none, PeripheralVerificationState::pass, PeripheralVerificationState::not_run, PeripheralVerificationState::not_run, PeripheralVerificationState::not_run, PeripheralVerificationState::not_run, static_cast<PeripheralDmaCapability>(0U), 0U},
	{"sqspi", PeripheralKind::sqspi, 0U, "", "", "vpr-softperipheral-board-audit", "nrf-vpr-sqspi", "", "", "M26", PeripheralRouteState::candidate, PeripheralSourceState::absent, PeripheralExposureState::none, PeripheralVerificationState::pass, PeripheralVerificationState::not_run, PeripheralVerificationState::not_run, PeripheralVerificationState::not_run, PeripheralVerificationState::not_run, static_cast<PeripheralDmaCapability>(1U), 0U},
