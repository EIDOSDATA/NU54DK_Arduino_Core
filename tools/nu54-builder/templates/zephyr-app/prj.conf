## CMakeLists.txt
```
cmake_minimum_required(VERSION 3.20.0)

find_package(Zephyr REQUIRED HINTS $ENV{ZEPHYR_BASE})

# NCS security CMake가 남기는 string cache가 다음 configure에서 Kconfig override로
# 오인되지 않도록 application scope에서 제거한다.
unset(CONFIG_MBEDTLS_CONFIG_FILE CACHE)
unset(CONFIG_TF_PSA_CRYPTO_CONFIG_FILE CACHE)
unset(CONFIG_TF_PSA_CRYPTO_USER_CONFIG_FILE CACHE)

project(nucode_arduino_sketch)

# 최초 configure-only에서도 Zephyr app target이 유효하도록 항상 bootstrap을 둔다.
target_sources(app PRIVATE src/bootstrap.cpp)
target_compile_definitions(app PRIVATE
  ARDUINO=10607
  ARDUINO_ARCH_ZEPHYR
  ARDUINO_NUCODE_NU54DK
)

# Build Adapter가 원자적으로 갱신하며, 실제 sketch/library source는 Zephyr가 컴파일한다.
include("${CMAKE_CURRENT_SOURCE_DIR}/sources.cmake")

if(NUCODE_ARDUINO_SKETCH_SOURCES)
  target_sources(app PRIVATE ${NUCODE_ARDUINO_SKETCH_SOURCES})
endif()

if(NUCODE_ARDUINO_INCLUDE_DIRS)
  target_include_directories(app PRIVATE ${NUCODE_ARDUINO_INCLUDE_DIRS})
endif()
```

## prj.conf
```kconfig
CONFIG_CPP=y
CONFIG_STD_CPP17=y
CONFIG_CPP_EXCEPTIONS=n
CONFIG_CPP_RTTI=n

CONFIG_NUCODE_ARDUINO_CORE=y
CONFIG_NUCODE_ARDUINO_API=y
CONFIG_NUCODE_ARDUINO_GPIO=y
CONFIG_NUCODE_ARDUINO_INTERRUPTS=y
CONFIG_NUCODE_ARDUINO_TIME=y
CONFIG_NUCODE_ARDUINO_SERIAL=y
CONFIG_NUCODE_ARDUINO_WIRE=y
CONFIG_NUCODE_ARDUINO_SPI=y
CONFIG_NUCODE_ARDUINO_ADC=y
CONFIG_NUCODE_ARDUINO_PWM=y
CONFIG_GPIO=y

CONFIG_MAIN_STACK_SIZE=2048
CONFIG_HEAP_MEM_POOL_SIZE=0
CONFIG_COMMON_LIBC_MALLOC=y
CONFIG_COMMON_LIBC_MALLOC_ARENA_SIZE=8192
```

## app.overlay
```dts
/**
 * @file app.overlay
 * @brief NU54DK Arduino Builder의 최소 platform overlay입니다.
 *
 * SPDX-License-Identifier: MIT
 */

#include <nucode/nu54dk-lfxo-external-caps.dtsi>

/** @note 주변장치 역할은 선택한 구성 profile overlay에서 제공합니다. */
```

## src/bootstrap.cpp
```c
/**
 * @file bootstrap.cpp
 * @brief source manifest가 비어 있는 configure-only 단계의 app target을 유지합니다.
 *
 * SPDX-License-Identifier: MIT
 */

namespace
{
    /** @brief translation unit이 비지 않도록 유지하는 내부 상수입니다. */
    [[maybe_unused]] constexpr unsigned int kNu54AdapterBootstrap = 0x54U;
} // namespace
```
